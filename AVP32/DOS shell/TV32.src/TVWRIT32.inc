TPointX             equ 0
TPointY             equ 4
TViewSizeX          equ 12
TViewSizeY          equ 16
TViewState          equ 24
TViewOwner          equ 46
TViewOriginY        equ 30
TViewOriginX        equ 26
TViewCursorY        equ 38
TViewCursorX        equ 34
TViewNext           equ 8
TViewOptions        equ 20
TGroupClipAY        equ 62
TGroupClipAX        equ 58
TGroupClipBY        equ 70
TGroupClipBX        equ 66
TGroupLast          equ 54
TGroupBuffer        equ 78
TGroupLockFlag      equ 82
MsEventWhereX       equ 5
MsEventWhereY       equ 9
TFrameSizeX         equ 12
TFrameOwner         equ 46
TDrawBufferData     equ 0
TEditorCurPtr       equ 76
TEditorGapLen       equ 70
TEditorBuffer       equ 62
TEditorSelStart     equ 72
TEditorSelEnd       equ 74
TEditorBufSize      equ 66
TEditorBufLen       equ 68
TTerminalBuffer     equ 123
TTerminalBufSize    equ 119
TTerminalQueBack    equ 131
sfVisible           equ 1
sfCursorVis         equ 2
sfCursorIns         equ 4
sfFocused           equ 64
sfShadow            equ 8
sfExposed           equ 2048
ofFramed            equ 8
