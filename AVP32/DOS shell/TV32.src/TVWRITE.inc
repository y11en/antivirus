TPointX             equ 0
TPointY             equ 2
TViewSizeX          equ 6
TViewSizeY          equ 8
TViewState          equ 14
TViewOwner          equ 28
TViewOriginY        equ 18
TViewOriginX        equ 16
TViewCursorY        equ 22
TViewCursorX        equ 20
TViewNext           equ 2
TViewOptions        equ 10
TGroupClipAY        equ 42
TGroupClipAX        equ 40
TGroupClipBY        equ 46
TGroupClipBX        equ 44
TGroupLast          equ 36
TGroupBuffer        equ 50
TGroupLockFlag      equ 54
MsEventWhereX       equ 3
MsEventWhereY       equ 5
TFrameSizeX         equ 6
TFrameOwner         equ 28
TDrawBufferData     equ 0
TEditorCurPtr       equ 58
TEditorGapLen       equ 52
TEditorBuffer       equ 44
TEditorSelStart     equ 54
TEditorSelEnd       equ 56
TEditorBufSize      equ 48
TEditorBufLen       equ 50
TTerminalBuffer     equ 91
TTerminalBufSize    equ 89
TTerminalQueBack    equ 97
sfVisible           equ 1
sfCursorVis         equ 2
sfCursorIns         equ 4
sfFocused           equ 64
sfShadow            equ 8
sfExposed           equ 2048
ofFramed            equ 8
