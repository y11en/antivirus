/*!
 * (C) "Kaspersky Lab"
 *
 * \file stub/gsoapstubs.cpp
 * \author Generated by createsoapheader.pl
 * \brief SOAP stub router
 */

#include "stdsoap2.h"
#include "soapH.h"

#include "std/gsoap/stubrouter.h"

typedef int (* tr_InitiateRemoteConnectionFuncDef)( struct soap *soap,  char *remoteName, char *localName, int *result );

int tr_InitiateRemoteConnection( struct soap *soap,  char *remoteName, char *localName, int *result )
{
	void *funcPtr = KLSTRT::GetFunctionPtrByName(L"tr_InitiateRemoteConnection");
	if ( funcPtr==NULL ) return SOAP_NO_METHOD;
	else return ((tr_InitiateRemoteConnectionFuncDef)funcPtr)(soap,remoteName,localName,result);
}

typedef int (* tr_CreateReverseConnectionFuncDef)( struct soap *soap,  char *remoteClientConnName, char *connName,
			char *remoteClientLoc, char *authClientName, int gatewayConnFlag,
			int connPingTimeout, int connPriority, 
			SOAPPermissions *permissions, SOAPConnectionOptions *options,
			int *result );

int tr_CreateReverseConnection( struct soap *soap,  char *remoteClientConnName, char *connName,
			char *remoteClientLoc, char *authClientName, int gatewayConnFlag,
			int connPingTimeout, int connPriority, 
			SOAPPermissions *permissions, SOAPConnectionOptions *options,
			int *result )
{
	void *funcPtr = KLSTRT::GetFunctionPtrByName(L"tr_CreateReverseConnection");
	if ( funcPtr==NULL ) return SOAP_NO_METHOD;
	else return ((tr_CreateReverseConnectionFuncDef)funcPtr)(soap,remoteClientConnName,connName,remoteClientLoc,authClientName,gatewayConnFlag,connPingTimeout,connPriority,permissions,options,result);
}

typedef int (* tr_ReverseConnectionReplyFuncDef)( struct soap *soap,  char *remoteServerConnName, 
			char *clientConnName, int pingTimeout, 
			SOAPPermissions *permissions, SOAPConnectionOptions *options,
			int *result );

int tr_ReverseConnectionReply( struct soap *soap,  char *remoteServerConnName, 
			char *clientConnName, int pingTimeout, 
			SOAPPermissions *permissions, SOAPConnectionOptions *options,
			int *result )
{
	void *funcPtr = KLSTRT::GetFunctionPtrByName(L"tr_ReverseConnectionReply");
	if ( funcPtr==NULL ) return SOAP_NO_METHOD;
	else return ((tr_ReverseConnectionReplyFuncDef)funcPtr)(soap,remoteServerConnName,clientConnName,pingTimeout,permissions,options,result);
}

typedef int (* tr_PingMethodFuncDef)( struct soap *soap,  char *remoteClientConnName, int *result );

int tr_PingMethod( struct soap *soap,  char *remoteClientConnName, int *result )
{
	void *funcPtr = KLSTRT::GetFunctionPtrByName(L"tr_PingMethod");
	if ( funcPtr==NULL ) return SOAP_NO_METHOD;
	else return ((tr_PingMethodFuncDef)funcPtr)(soap,remoteClientConnName,result);
}

typedef int (* tr_AuthenticationHandshakeFuncDef)( struct soap *soap,  xsd__wstring inClientIdentity, xsd__hexBinary inString, 
							   int connPriority,
							   struct tr_AuthHandshakeResult &r );

int tr_AuthenticationHandshake( struct soap *soap,  xsd__wstring inClientIdentity, xsd__hexBinary inString, 
							   int connPriority,
							   struct tr_AuthHandshakeResult &r )
{
	void *funcPtr = KLSTRT::GetFunctionPtrByName(L"tr_AuthenticationHandshake");
	if ( funcPtr==NULL ) return SOAP_NO_METHOD;
	else return ((tr_AuthenticationHandshakeFuncDef)funcPtr)(soap,inClientIdentity,inString,connPriority,r);
}

typedef int (* tr_CreateGatewayConnectionFuncDef)( struct soap *soap,  xsd__wstring localName, struct TransportLocList *processNamesList, 
							   int nextProcessPos, int connectTimeout, int *result );

int tr_CreateGatewayConnection( struct soap *soap,  xsd__wstring localName, struct TransportLocList *processNamesList, 
							   int nextProcessPos, int connectTimeout, int *result )
{
	void *funcPtr = KLSTRT::GetFunctionPtrByName(L"tr_CreateGatewayConnection");
	if ( funcPtr==NULL ) return SOAP_NO_METHOD;
	else return ((tr_CreateGatewayConnectionFuncDef)funcPtr)(soap,localName,processNamesList,nextProcessPos,connectTimeout,result);
}

typedef int (* tr_TestMethodFuncDef)( struct soap *soap, int num, char *str, int *result);

int tr_TestMethod( struct soap *soap, int num, char *str, int *result)
{
	void *funcPtr = KLSTRT::GetFunctionPtrByName(L"tr_TestMethod");
	if ( funcPtr==NULL ) return SOAP_NO_METHOD;
	else return ((tr_TestMethodFuncDef)funcPtr)(soap,num,str,result);
}

typedef int (* tr_TestMethod1FuncDef)( struct soap *soap, int num, char *str, struct tr_TestMethod1Result &r);

int tr_TestMethod1( struct soap *soap, int num, char *str, struct tr_TestMethod1Result &r)
{
	void *funcPtr = KLSTRT::GetFunctionPtrByName(L"tr_TestMethod1");
	if ( funcPtr==NULL ) return SOAP_NO_METHOD;
	else return ((tr_TestMethod1FuncDef)funcPtr)(soap,num,str,r);
}

typedef int (* tr_TrafficControlNotifyFuncDef)( struct soap *soap, int error, int *result);

int tr_TrafficControlNotify( struct soap *soap, int error, int *result)
{
	void *funcPtr = KLSTRT::GetFunctionPtrByName(L"tr_TrafficControlNotify");
	if ( funcPtr==NULL ) return SOAP_NO_METHOD;
	else return ((tr_TrafficControlNotifyFuncDef)funcPtr)(soap,error,result);
}

typedef int (* ev_RemoteSubscribeFuncDef)( struct soap *soap,  xsd__int subsId, xsd__wstring localCompName, 
		SOAPComponentId *subscriber, SOAPComponentId *publisher, 
		xsd__wstring eventType, param__params eventBodyFilter, int sendToAgentSubs,
		int useOnlyLocalConnsFlag,
		int *result );

int ev_RemoteSubscribe( struct soap *soap,  xsd__int subsId, xsd__wstring localCompName, 
		SOAPComponentId *subscriber, SOAPComponentId *publisher, 
		xsd__wstring eventType, param__params eventBodyFilter, int sendToAgentSubs,
		int useOnlyLocalConnsFlag,
		int *result )
{
	void *funcPtr = KLSTRT::GetFunctionPtrByName(L"ev_RemoteSubscribe");
	if ( funcPtr==NULL ) return SOAP_NO_METHOD;
	else return ((ev_RemoteSubscribeFuncDef)funcPtr)(soap,subsId,localCompName,subscriber,publisher,eventType,eventBodyFilter,sendToAgentSubs,useOnlyLocalConnsFlag,result);
}

typedef int (* ev_RemoteUnsubscribeFuncDef)( struct soap *soap,  xsd__int remoteSubsId, int *result );

int ev_RemoteUnsubscribe( struct soap *soap,  xsd__int remoteSubsId, int *result )
{
	void *funcPtr = KLSTRT::GetFunctionPtrByName(L"ev_RemoteUnsubscribe");
	if ( funcPtr==NULL ) return SOAP_NO_METHOD;
	else return ((ev_RemoteUnsubscribeFuncDef)funcPtr)(soap,remoteSubsId,result);
}

typedef int (* ev_PublishEventFuncDef)( struct soap *soap,  SOAPComponentId *eventPublisher, xsd__wstring	eventType, 
					param__params eventBody, time_t eventBirthTime, int eventLifeTime,
					struct SOAPComponentIdsList *processedCompsList, 
					struct SOAPSubsIdsList *remoteSubsIdsList,
					int *result );

int ev_PublishEvent( struct soap *soap,  SOAPComponentId *eventPublisher, xsd__wstring	eventType, 
					param__params eventBody, time_t eventBirthTime, int eventLifeTime,
					struct SOAPComponentIdsList *processedCompsList, 
					struct SOAPSubsIdsList *remoteSubsIdsList,
					int *result )
{
	void *funcPtr = KLSTRT::GetFunctionPtrByName(L"ev_PublishEvent");
	if ( funcPtr==NULL ) return SOAP_NO_METHOD;
	else return ((ev_PublishEventFuncDef)funcPtr)(soap,eventPublisher,eventType,eventBody,eventBirthTime,eventLifeTime,processedCompsList,remoteSubsIdsList,result);
}

typedef int (* klspl_GetPermissionsFuncDef)( struct soap *soap, 
						xsd__long		groupId,
						struct klspl_GetPermissionsResponse
							&r );

int klspl_GetPermissions( struct soap *soap, 
						xsd__long		groupId,
						struct klspl_GetPermissionsResponse
							&r )
{
	void *funcPtr = KLSTRT::GetFunctionPtrByName(L"klspl_GetPermissions");
	if ( funcPtr==NULL ) return SOAP_NO_METHOD;
	else return ((klspl_GetPermissionsFuncDef)funcPtr)(soap,groupId,r);
}

typedef int (* klspl_SetPermissionsFuncDef)( struct soap *soap, 
						xsd__long		groupId,
						struct klspl_permissions_t	perms,
						xsd__boolean	bCheckUserRights,
						struct klspl_SetPermissionsResponse
							&r );

int klspl_SetPermissions( struct soap *soap, 
						xsd__long		groupId,
						struct klspl_permissions_t	perms,
						xsd__boolean	bCheckUserRights,
						struct klspl_SetPermissionsResponse
							&r )
{
	void *funcPtr = KLSTRT::GetFunctionPtrByName(L"klspl_SetPermissions");
	if ( funcPtr==NULL ) return SOAP_NO_METHOD;
	else return ((klspl_SetPermissionsFuncDef)funcPtr)(soap,groupId,perms,bCheckUserRights,r);
}

typedef int (* klprci_GetTasksParamsFuncDef)( struct soap *soap, 
						xsd__wstring	ID,
						xsd__int		idtask,
						param__params	filter,
						struct klprci_GetTasksParamsResponse
							&r);

int klprci_GetTasksParams( struct soap *soap, 
						xsd__wstring	ID,
						xsd__int		idtask,
						param__params	filter,
						struct klprci_GetTasksParamsResponse
							&r)
{
	void *funcPtr = KLSTRT::GetFunctionPtrByName(L"klprci_GetTasksParams");
	if ( funcPtr==NULL ) return SOAP_NO_METHOD;
	else return ((klprci_GetTasksParamsFuncDef)funcPtr)(soap,ID,idtask,filter,r);
}

typedef int (* klprci_GetPingTimeoutFuncDef)( struct soap *soap, xsd__wstring ID,
							 struct klprci_GetPingTimeoutResponse &r);

int klprci_GetPingTimeout	( struct soap *soap, xsd__wstring ID,
							 struct klprci_GetPingTimeoutResponse &r)
{
	void *funcPtr = KLSTRT::GetFunctionPtrByName(L"klprci_GetPingTimeout");
	if ( funcPtr==NULL ) return SOAP_NO_METHOD;
	else return ((klprci_GetPingTimeoutFuncDef)funcPtr)(soap,ID,r);
}

typedef int (* klprci_GetStateFuncDef)( struct soap *soap, xsd__wstring ID,
							 struct klprci_GetStateResponse &r);

int klprci_GetState			( struct soap *soap, xsd__wstring ID,
							 struct klprci_GetStateResponse &r)
{
	void *funcPtr = KLSTRT::GetFunctionPtrByName(L"klprci_GetState");
	if ( funcPtr==NULL ) return SOAP_NO_METHOD;
	else return ((klprci_GetStateFuncDef)funcPtr)(soap,ID,r);
}

typedef int (* klprci_GetStatisticsFuncDef)( struct soap *soap, xsd__wstring ID,
							 param__params	statisticsIn,
							 struct klprci_GetStatisticsResponse &r);

int klprci_GetStatistics	( struct soap *soap, xsd__wstring ID,
							 param__params	statisticsIn,
							 struct klprci_GetStatisticsResponse &r)
{
	void *funcPtr = KLSTRT::GetFunctionPtrByName(L"klprci_GetStatistics");
	if ( funcPtr==NULL ) return SOAP_NO_METHOD;
	else return ((klprci_GetStatisticsFuncDef)funcPtr)(soap,ID,statisticsIn,r);
}

typedef int (* klprci_StopFuncDef)( struct soap *soap, xsd__wstring ID,
							 struct klprci_StopResponse &r);

int klprci_Stop				( struct soap *soap, xsd__wstring ID,
							 struct klprci_StopResponse &r)
{
	void *funcPtr = KLSTRT::GetFunctionPtrByName(L"klprci_Stop");
	if ( funcPtr==NULL ) return SOAP_NO_METHOD;
	else return ((klprci_StopFuncDef)funcPtr)(soap,ID,r);
}

typedef int (* klprci_SuspendFuncDef)( struct soap *soap, xsd__wstring ID,
							 struct klprci_SuspendResponse &r);

int klprci_Suspend			( struct soap *soap, xsd__wstring ID,
							 struct klprci_SuspendResponse &r)
{
	void *funcPtr = KLSTRT::GetFunctionPtrByName(L"klprci_Suspend");
	if ( funcPtr==NULL ) return SOAP_NO_METHOD;
	else return ((klprci_SuspendFuncDef)funcPtr)(soap,ID,r);
}

typedef int (* klprci_ResumeFuncDef)( struct soap *soap, xsd__wstring ID,
							 struct klprci_ResumeResponse &r);

int klprci_Resume			( struct soap *soap, xsd__wstring ID,
							 struct klprci_ResumeResponse &r)
{
	void *funcPtr = KLSTRT::GetFunctionPtrByName(L"klprci_Resume");
	if ( funcPtr==NULL ) return SOAP_NO_METHOD;
	else return ((klprci_ResumeFuncDef)funcPtr)(soap,ID,r);
}

typedef int (* klprci_RunTaskFuncDef)( struct soap *soap, xsd__wstring ID,
							 xsd__wstring name,
							 param__params settings,
							 xsd__wstring asyncID,
							 xsd__int timeout,
							 struct klprci_RunTaskResponse &r);

int klprci_RunTask			( struct soap *soap, xsd__wstring ID,
							 xsd__wstring name,
							 param__params settings,
							 xsd__wstring asyncID,
							 xsd__int timeout,
							 struct klprci_RunTaskResponse &r)
{
	void *funcPtr = KLSTRT::GetFunctionPtrByName(L"klprci_RunTask");
	if ( funcPtr==NULL ) return SOAP_NO_METHOD;
	else return ((klprci_RunTaskFuncDef)funcPtr)(soap,ID,name,settings,asyncID,timeout,r);
}

typedef int (* klprci_RunMethodFuncDef)( struct soap *soap,         xsd__wstring ID,
                             xsd__wstring name,
							 param__params settings,
							 xsd__int timeout,
							 struct klprci_RunMethodResponse &r);

int klprci_RunMethod( struct soap *soap,         xsd__wstring ID,
                             xsd__wstring name,
							 param__params settings,
							 xsd__int timeout,
							 struct klprci_RunMethodResponse &r)
{
	void *funcPtr = KLSTRT::GetFunctionPtrByName(L"klprci_RunMethod");
	if ( funcPtr==NULL ) return SOAP_NO_METHOD;
	else return ((klprci_RunMethodFuncDef)funcPtr)(soap,ID,name,settings,timeout,r);
}

typedef int (* klprci_GetTasksListFuncDef)( struct soap *soap, xsd__wstring ID,
							 struct klprci_GetTasksListResponse &r);

int klprci_GetTasksList		( struct soap *soap, xsd__wstring ID,
							 struct klprci_GetTasksListResponse &r)
{
	void *funcPtr = KLSTRT::GetFunctionPtrByName(L"klprci_GetTasksList");
	if ( funcPtr==NULL ) return SOAP_NO_METHOD;
	else return ((klprci_GetTasksListFuncDef)funcPtr)(soap,ID,r);
}

typedef int (* klprci_GetTaskNameFuncDef)( struct soap *soap, xsd__wstring ID,
							 xsd__int idTask,
							struct klprci_GetTaskNameResponse
							 &r);

int klprci_GetTaskName		( struct soap *soap, xsd__wstring ID,
							 xsd__int idTask,
							struct klprci_GetTaskNameResponse
							 &r)
{
	void *funcPtr = KLSTRT::GetFunctionPtrByName(L"klprci_GetTaskName");
	if ( funcPtr==NULL ) return SOAP_NO_METHOD;
	else return ((klprci_GetTaskNameFuncDef)funcPtr)(soap,ID,idTask,r);
}

typedef int (* klprci_TaskStopFuncDef)( struct soap *soap, xsd__wstring ID,
							 xsd__int idTask,
							 struct klprci_TaskStopResponse &r);

int klprci_TaskStop			( struct soap *soap, xsd__wstring ID,
							 xsd__int idTask,
							 struct klprci_TaskStopResponse &r)
{
	void *funcPtr = KLSTRT::GetFunctionPtrByName(L"klprci_TaskStop");
	if ( funcPtr==NULL ) return SOAP_NO_METHOD;
	else return ((klprci_TaskStopFuncDef)funcPtr)(soap,ID,idTask,r);
}

typedef int (* klprci_TaskSuspendFuncDef)( struct soap *soap, xsd__wstring ID,
							 xsd__int idTask,
							 struct klprci_TaskSuspendResponse &r);

int klprci_TaskSuspend		( struct soap *soap, xsd__wstring ID,
							 xsd__int idTask,
							 struct klprci_TaskSuspendResponse &r)
{
	void *funcPtr = KLSTRT::GetFunctionPtrByName(L"klprci_TaskSuspend");
	if ( funcPtr==NULL ) return SOAP_NO_METHOD;
	else return ((klprci_TaskSuspendFuncDef)funcPtr)(soap,ID,idTask,r);
}

typedef int (* klprci_TaskResumeFuncDef)( struct soap *soap, xsd__wstring ID,
							 xsd__int idTask,
							 struct klprci_TaskResumeResponse &r);

int klprci_TaskResume		( struct soap *soap, xsd__wstring ID,
							 xsd__int idTask,
							 struct klprci_TaskResumeResponse &r)
{
	void *funcPtr = KLSTRT::GetFunctionPtrByName(L"klprci_TaskResume");
	if ( funcPtr==NULL ) return SOAP_NO_METHOD;
	else return ((klprci_TaskResumeFuncDef)funcPtr)(soap,ID,idTask,r);
}

typedef int (* klprci_TaskGetStateFuncDef)( struct soap *soap, xsd__wstring ID,
							 xsd__int idTask,
							 struct klprci_GetTaskStateResponse& r);

int klprci_TaskGetState		( struct soap *soap, xsd__wstring ID,
							 xsd__int idTask,
							 struct klprci_GetTaskStateResponse& r)
{
	void *funcPtr = KLSTRT::GetFunctionPtrByName(L"klprci_TaskGetState");
	if ( funcPtr==NULL ) return SOAP_NO_METHOD;
	else return ((klprci_TaskGetStateFuncDef)funcPtr)(soap,ID,idTask, r);
}

typedef int (* klprci_TaskGetCompletionFuncDef)( struct soap *soap, xsd__wstring ID,
							 xsd__int idTask,
							 struct klprci_GetTaskCompletionResponse& r);

int klprci_TaskGetCompletion( struct soap *soap, xsd__wstring ID,
							 xsd__int idTask,
							 struct klprci_GetTaskCompletionResponse& r)
{
	void *funcPtr = KLSTRT::GetFunctionPtrByName(L"klprci_TaskGetCompletion");
	if ( funcPtr==NULL ) return SOAP_NO_METHOD;
	else return ((klprci_TaskGetCompletionFuncDef)funcPtr)(soap,ID,idTask, r);
}

typedef int (* klprci_TaskReloadFuncDef)( struct soap *soap, 
                        xsd__wstring    ID,
						xsd__int        idTask,
                        param__params   settings,
						struct klprci_TaskReloadResponse& r);

int klprci_TaskReload( struct soap *soap, 
                        xsd__wstring    ID,
						xsd__int        idTask,
                        param__params   settings,
						struct klprci_TaskReloadResponse& r)
{
	void *funcPtr = KLSTRT::GetFunctionPtrByName(L"klprci_TaskReload");
	if ( funcPtr==NULL ) return SOAP_NO_METHOD;
	else return ((klprci_TaskReloadFuncDef)funcPtr)(soap,ID,idTask,settings, r);
}

typedef int (* KLPRES_ResetSubscriptionsIteratorFuncDef)( struct soap *soap, xsd__wstring sServerObjectID,
									  SOAPComponentId cidFilter,
                                      xsd__int  nTimeout,
									  struct KLPRES_RESET_SUBSCRIPTIONS_ITERATOR_RESPONSE &rc);

int KLPRES_ResetSubscriptionsIterator( struct soap *soap, xsd__wstring sServerObjectID,
									  SOAPComponentId cidFilter,
                                      xsd__int  nTimeout,
									  struct KLPRES_RESET_SUBSCRIPTIONS_ITERATOR_RESPONSE &rc)
{
	void *funcPtr = KLSTRT::GetFunctionPtrByName(L"KLPRES_ResetSubscriptionsIterator");
	if ( funcPtr==NULL ) return SOAP_NO_METHOD;
	else return ((KLPRES_ResetSubscriptionsIteratorFuncDef)funcPtr)(soap,sServerObjectID,cidFilter,nTimeout,rc);
}

typedef int (* KLPRES_ReleaseSubscriptionsIteratorFuncDef)( struct soap *soap, xsd__wstring sServerObjectID,
									  xsd__wstring sSubscrIteratorId,
									  struct KLPRES_RELEASE_SUBSCRIPTIONS_ITERATOR_RESPONSE &rc);

int KLPRES_ReleaseSubscriptionsIterator( struct soap *soap, xsd__wstring sServerObjectID,
									  xsd__wstring sSubscrIteratorId,
									  struct KLPRES_RELEASE_SUBSCRIPTIONS_ITERATOR_RESPONSE &rc)
{
	void *funcPtr = KLSTRT::GetFunctionPtrByName(L"KLPRES_ReleaseSubscriptionsIterator");
	if ( funcPtr==NULL ) return SOAP_NO_METHOD;
	else return ((KLPRES_ReleaseSubscriptionsIteratorFuncDef)funcPtr)(soap,sServerObjectID,sSubscrIteratorId,rc);
}

typedef int (* KLPRES_GetNextSubscriptionFuncDef)( struct soap *soap,  xsd__wstring sServerObjectID,
							    xsd__wstring sSubscrIteratorId,
							    struct KLPRES_GET_NEXT_SUBSCRIPTION_RESPONSE &rc);

int KLPRES_GetNextSubscription( struct soap *soap,  xsd__wstring sServerObjectID,
							    xsd__wstring sSubscrIteratorId,
							    struct KLPRES_GET_NEXT_SUBSCRIPTION_RESPONSE &rc)
{
	void *funcPtr = KLSTRT::GetFunctionPtrByName(L"KLPRES_GetNextSubscription");
	if ( funcPtr==NULL ) return SOAP_NO_METHOD;
	else return ((KLPRES_GetNextSubscriptionFuncDef)funcPtr)(soap,sServerObjectID,sSubscrIteratorId,rc);
}

typedef int (* KLPRES_AddSubscriptionFuncDef)( struct soap *soap, xsd__wstring sServerObjectID,
						   xsd__wstring sSubscriptionID,
						   bool bPersistent, 
						   param__params parSubscription,
						   struct KLPRES_ADD_SUBSCRIPTION_RESPONSE &rc);

int KLPRES_AddSubscription( struct soap *soap, xsd__wstring sServerObjectID,
						   xsd__wstring sSubscriptionID,
						   bool bPersistent, 
						   param__params parSubscription,
						   struct KLPRES_ADD_SUBSCRIPTION_RESPONSE &rc)
{
	void *funcPtr = KLSTRT::GetFunctionPtrByName(L"KLPRES_AddSubscription");
	if ( funcPtr==NULL ) return SOAP_NO_METHOD;
	else return ((KLPRES_AddSubscriptionFuncDef)funcPtr)(soap,sServerObjectID,sSubscriptionID,bPersistent,parSubscription,rc);
}

typedef int (* KLPRES_UpdateSubscriptionFuncDef)( struct soap *soap, xsd__wstring sServerObjectID,
							  xsd__wstring sSubscriptionID,
							  param__params parSubscription,
							  struct param_error& rc);

int KLPRES_UpdateSubscription( struct soap *soap, xsd__wstring sServerObjectID,
							  xsd__wstring sSubscriptionID,
							  param__params parSubscription,
							  struct param_error& rc)
{
	void *funcPtr = KLSTRT::GetFunctionPtrByName(L"KLPRES_UpdateSubscription");
	if ( funcPtr==NULL ) return SOAP_NO_METHOD;
	else return ((KLPRES_UpdateSubscriptionFuncDef)funcPtr)(soap,sServerObjectID,sSubscriptionID,parSubscription, rc);
}

typedef int (* KLPRES_PauseSubscriptionFuncDef)( struct soap *soap, xsd__wstring sServerObjectID,
							  xsd__wstring sSubscriptionID,
							  struct param_error& rc);

int KLPRES_PauseSubscription( struct soap *soap, xsd__wstring sServerObjectID,
							  xsd__wstring sSubscriptionID,
							  struct param_error& rc)
{
	void *funcPtr = KLSTRT::GetFunctionPtrByName(L"KLPRES_PauseSubscription");
	if ( funcPtr==NULL ) return SOAP_NO_METHOD;
	else return ((KLPRES_PauseSubscriptionFuncDef)funcPtr)(soap,sServerObjectID,sSubscriptionID, rc);
}

typedef int (* KLPRES_ResumeSubscriptionFuncDef)( struct soap *soap, xsd__wstring sServerObjectID,
							  xsd__wstring sSubscriptionID,
							  struct param_error& rc);

int KLPRES_ResumeSubscription( struct soap *soap, xsd__wstring sServerObjectID,
							  xsd__wstring sSubscriptionID,
							  struct param_error& rc)
{
	void *funcPtr = KLSTRT::GetFunctionPtrByName(L"KLPRES_ResumeSubscription");
	if ( funcPtr==NULL ) return SOAP_NO_METHOD;
	else return ((KLPRES_ResumeSubscriptionFuncDef)funcPtr)(soap,sServerObjectID,sSubscriptionID, rc);
}

typedef int (* KLPRES_RemoveSubscriptionFuncDef)( struct soap *soap, xsd__wstring sServerObjectID,
							  xsd__wstring sSubscriptionID, 
							  struct param_error& rc);

int KLPRES_RemoveSubscription( struct soap *soap, xsd__wstring sServerObjectID,
							  xsd__wstring sSubscriptionID, 
							  struct param_error& rc)
{
	void *funcPtr = KLSTRT::GetFunctionPtrByName(L"KLPRES_RemoveSubscription");
	if ( funcPtr==NULL ) return SOAP_NO_METHOD;
	else return ((KLPRES_RemoveSubscriptionFuncDef)funcPtr)(soap,sServerObjectID,sSubscriptionID, rc);
}

typedef int (* KLPRES_ResetEventsIteratorFuncDef)( struct soap *soap, xsd__wstring sServerObjectID,
							   xsd__wstring sSubscriptionID,
							   struct param_error &rc);

int KLPRES_ResetEventsIterator( struct soap *soap, xsd__wstring sServerObjectID,
							   xsd__wstring sSubscriptionID,
							   struct param_error &rc)
{
	void *funcPtr = KLSTRT::GetFunctionPtrByName(L"KLPRES_ResetEventsIterator");
	if ( funcPtr==NULL ) return SOAP_NO_METHOD;
	else return ((KLPRES_ResetEventsIteratorFuncDef)funcPtr)(soap,sServerObjectID,sSubscriptionID,rc);
}

typedef int (* KLPRES_SetEventsIteratorFuncDef)( struct soap *soap, xsd__wstring sServerObjectID,
							 xsd__wstring sSubscriptionID,
							 long eventID,
							 struct param_error &rc);

int KLPRES_SetEventsIterator( struct soap *soap, xsd__wstring sServerObjectID,
							 xsd__wstring sSubscriptionID,
							 long eventID,
							 struct param_error &rc)
{
	void *funcPtr = KLSTRT::GetFunctionPtrByName(L"KLPRES_SetEventsIterator");
	if ( funcPtr==NULL ) return SOAP_NO_METHOD;
	else return ((KLPRES_SetEventsIteratorFuncDef)funcPtr)(soap,sServerObjectID,sSubscriptionID,eventID,rc);
}

typedef int (* KLPRES_ResetEventsIteratorExFuncDef)( struct soap *soap, xsd__wstring sServerObjectID,
								 xsd__wstring sSubscriptionID,
								 struct KLPRES_RESET_EVENTS_ITERATOR_EX_RESPONSE &rc);

int KLPRES_ResetEventsIteratorEx( struct soap *soap, xsd__wstring sServerObjectID,
								 xsd__wstring sSubscriptionID,
								 struct KLPRES_RESET_EVENTS_ITERATOR_EX_RESPONSE &rc)
{
	void *funcPtr = KLSTRT::GetFunctionPtrByName(L"KLPRES_ResetEventsIteratorEx");
	if ( funcPtr==NULL ) return SOAP_NO_METHOD;
	else return ((KLPRES_ResetEventsIteratorExFuncDef)funcPtr)(soap,sServerObjectID,sSubscriptionID,rc);
}

typedef int (* KLPRES_SetEventsIteratorExFuncDef)( struct soap *soap, xsd__wstring sServerObjectID,
							   xsd__wstring sSubscriptionID,
							   long eventID,
							   struct KLPRES_SET_EVENTS_ITERATOR_EX_RESPONSE &rc);

int KLPRES_SetEventsIteratorEx( struct soap *soap, xsd__wstring sServerObjectID,
							   xsd__wstring sSubscriptionID,
							   long eventID,
							   struct KLPRES_SET_EVENTS_ITERATOR_EX_RESPONSE &rc)
{
	void *funcPtr = KLSTRT::GetFunctionPtrByName(L"KLPRES_SetEventsIteratorEx");
	if ( funcPtr==NULL ) return SOAP_NO_METHOD;
	else return ((KLPRES_SetEventsIteratorExFuncDef)funcPtr)(soap,sServerObjectID,sSubscriptionID,eventID,rc);
}

typedef int (* KLPRES_MoveToEventWithIndexFuncDef)( struct soap *soap, xsd__wstring sServerObjectID,
							    xsd__wstring sSubscriptionID,
							    long nIndex,
								struct param_error &rc);

int KLPRES_MoveToEventWithIndex( struct soap *soap, xsd__wstring sServerObjectID,
							    xsd__wstring sSubscriptionID,
							    long nIndex,
								struct param_error &rc)
{
	void *funcPtr = KLSTRT::GetFunctionPtrByName(L"KLPRES_MoveToEventWithIndex");
	if ( funcPtr==NULL ) return SOAP_NO_METHOD;
	else return ((KLPRES_MoveToEventWithIndexFuncDef)funcPtr)(soap,sServerObjectID,sSubscriptionID,nIndex,rc);
}

typedef int (* KLPRES_GetEventsCountFuncDef)( struct soap *soap, xsd__wstring sServerObjectID,
						  xsd__wstring sSubscriptionID,
						  struct KLPRES_GET_EVENTS_COUNT_RESPONSE &rc);

int KLPRES_GetEventsCount( struct soap *soap, xsd__wstring sServerObjectID,
						  xsd__wstring sSubscriptionID,
						  struct KLPRES_GET_EVENTS_COUNT_RESPONSE &rc)
{
	void *funcPtr = KLSTRT::GetFunctionPtrByName(L"KLPRES_GetEventsCount");
	if ( funcPtr==NULL ) return SOAP_NO_METHOD;
	else return ((KLPRES_GetEventsCountFuncDef)funcPtr)(soap,sServerObjectID,sSubscriptionID,rc);
}

typedef int (* KLPRES_GetNextEventsChunkFuncDef)( struct soap *soap, xsd__wstring sServerObjectID,
							  xsd__wstring sSubscriptionID,
							  struct KLPRES_GET_NEXT_EVENTS_CHUNK_RESPONSE &rc);

int KLPRES_GetNextEventsChunk( struct soap *soap, xsd__wstring sServerObjectID,
							  xsd__wstring sSubscriptionID,
							  struct KLPRES_GET_NEXT_EVENTS_CHUNK_RESPONSE &rc)
{
	void *funcPtr = KLSTRT::GetFunctionPtrByName(L"KLPRES_GetNextEventsChunk");
	if ( funcPtr==NULL ) return SOAP_NO_METHOD;
	else return ((KLPRES_GetNextEventsChunkFuncDef)funcPtr)(soap,sServerObjectID,sSubscriptionID,rc);
}

typedef int (* KLPRES_ClearEventsListFuncDef)( struct soap *soap, xsd__wstring sServerObjectID,
						   xsd__wstring sSubscriptionID, 
						   struct param_error& rc);

int KLPRES_ClearEventsList( struct soap *soap, xsd__wstring sServerObjectID,
						   xsd__wstring sSubscriptionID, 
						   struct param_error& rc)
{
	void *funcPtr = KLSTRT::GetFunctionPtrByName(L"KLPRES_ClearEventsList");
	if ( funcPtr==NULL ) return SOAP_NO_METHOD;
	else return ((KLPRES_ClearEventsListFuncDef)funcPtr)(soap,sServerObjectID,sSubscriptionID, rc);
}

typedef int (* KLPRES_DeleteEventsFuncDef)( struct soap *soap, xsd__wstring sServerObjectID,
						xsd__wstring sSubscriptionID, 
						long nStopEventID, 
						struct param_error& rc);

int KLPRES_DeleteEvents( struct soap *soap, xsd__wstring sServerObjectID,
						xsd__wstring sSubscriptionID, 
						long nStopEventID, 
						struct param_error& rc)
{
	void *funcPtr = KLSTRT::GetFunctionPtrByName(L"KLPRES_DeleteEvents");
	if ( funcPtr==NULL ) return SOAP_NO_METHOD;
	else return ((KLPRES_DeleteEventsFuncDef)funcPtr)(soap,sServerObjectID,sSubscriptionID,nStopEventID, rc);
}

typedef int (* KLPRES_DeleteOneEventByIDFuncDef)( struct soap *soap, xsd__wstring sServerObjectID,
							  xsd__wstring sSubscriptionID, 
							  long nEventID, 
						      struct param_error& rc);

int KLPRES_DeleteOneEventByID( struct soap *soap, xsd__wstring sServerObjectID,
							  xsd__wstring sSubscriptionID, 
							  long nEventID, 
						      struct param_error& rc)
{
	void *funcPtr = KLSTRT::GetFunctionPtrByName(L"KLPRES_DeleteOneEventByID");
	if ( funcPtr==NULL ) return SOAP_NO_METHOD;
	else return ((KLPRES_DeleteOneEventByIDFuncDef)funcPtr)(soap,sServerObjectID,sSubscriptionID,nEventID, rc);
}

typedef int (* KLPRES_DeleteRangesFuncDef)( struct soap *soap, xsd__wstring sServerObjectID,
						xsd__wstring sSubscriptionID, 
						param__params parRanges, 
                        struct param_error& rc);

int KLPRES_DeleteRanges( struct soap *soap, xsd__wstring sServerObjectID,
						xsd__wstring sSubscriptionID, 
						param__params parRanges, 
                        struct param_error& rc)
{
	void *funcPtr = KLSTRT::GetFunctionPtrByName(L"KLPRES_DeleteRanges");
	if ( funcPtr==NULL ) return SOAP_NO_METHOD;
	else return ((KLPRES_DeleteRangesFuncDef)funcPtr)(soap,sServerObjectID,sSubscriptionID,parRanges, rc);
}

typedef int (* KLPRES_RemoveExpiredEventsFuncDef)( struct soap *soap, xsd__wstring sServerObjectID,
							   xsd__wstring sSubscriptionID, 
							   struct param_error& rc);

int KLPRES_RemoveExpiredEvents( struct soap *soap, xsd__wstring sServerObjectID,
							   xsd__wstring sSubscriptionID, 
							   struct param_error& rc)
{
	void *funcPtr = KLSTRT::GetFunctionPtrByName(L"KLPRES_RemoveExpiredEvents");
	if ( funcPtr==NULL ) return SOAP_NO_METHOD;
	else return ((KLPRES_RemoveExpiredEventsFuncDef)funcPtr)(soap,sServerObjectID,sSubscriptionID, rc);
}

typedef int (* KLPRES_GetEventStorageFileSizeFuncDef)( struct soap *soap, xsd__wstring sServerObjectID,
									xsd__wstring sSubscriptionID, 
									struct KLPRES_GET_EVENT_STORAGE_FILE_SIZE_RESPONSE& rc);

int KLPRES_GetEventStorageFileSize( struct soap *soap, xsd__wstring sServerObjectID,
									xsd__wstring sSubscriptionID, 
									struct KLPRES_GET_EVENT_STORAGE_FILE_SIZE_RESPONSE& rc)
{
	void *funcPtr = KLSTRT::GetFunctionPtrByName(L"KLPRES_GetEventStorageFileSize");
	if ( funcPtr==NULL ) return SOAP_NO_METHOD;
	else return ((KLPRES_GetEventStorageFileSizeFuncDef)funcPtr)(soap,sServerObjectID,sSubscriptionID, rc);
}

typedef int (* KLPRTS_ResetTasksIteratorFuncDef)( struct soap *soap, xsd__wstring sServerObjectID,
							  SOAPComponentId cidFilter, 
							  xsd__wstring sTaskNameFilter,
							  struct KLPRTS_RESET_TASKS_ITERATOR_RESPONSE &rc);

int KLPRTS_ResetTasksIterator( struct soap *soap, xsd__wstring sServerObjectID,
							  SOAPComponentId cidFilter, 
							  xsd__wstring sTaskNameFilter,
							  struct KLPRTS_RESET_TASKS_ITERATOR_RESPONSE &rc)
{
	void *funcPtr = KLSTRT::GetFunctionPtrByName(L"KLPRTS_ResetTasksIterator");
	if ( funcPtr==NULL ) return SOAP_NO_METHOD;
	else return ((KLPRTS_ResetTasksIteratorFuncDef)funcPtr)(soap,sServerObjectID,cidFilter,sTaskNameFilter,rc);
}

typedef int (* KLPRTS_GetTaskByIDFuncDef)( struct soap *soap, xsd__wstring sServerObjectID,
					   xsd__wstring TaskID, 
					   struct KLPRTS_GET_TASK_BY_ID_RESPONSE &rc);

int KLPRTS_GetTaskByID( struct soap *soap, xsd__wstring sServerObjectID,
					   xsd__wstring TaskID, 
					   struct KLPRTS_GET_TASK_BY_ID_RESPONSE &rc)
{
	void *funcPtr = KLSTRT::GetFunctionPtrByName(L"KLPRTS_GetTaskByID");
	if ( funcPtr==NULL ) return SOAP_NO_METHOD;
	else return ((KLPRTS_GetTaskByIDFuncDef)funcPtr)(soap,sServerObjectID,TaskID,rc);
}

typedef int (* KLPRTS_GetTaskByIDWithPolicyAppliedFuncDef)( struct soap *soap, xsd__wstring sServerObjectID,
					   xsd__wstring TaskID, 
					   struct KLPRTS_GET_TASK_BY_ID_WPA_RESPONSE &rc);

int KLPRTS_GetTaskByIDWithPolicyApplied( struct soap *soap, xsd__wstring sServerObjectID,
					   xsd__wstring TaskID, 
					   struct KLPRTS_GET_TASK_BY_ID_WPA_RESPONSE &rc)
{
	void *funcPtr = KLSTRT::GetFunctionPtrByName(L"KLPRTS_GetTaskByIDWithPolicyApplied");
	if ( funcPtr==NULL ) return SOAP_NO_METHOD;
	else return ((KLPRTS_GetTaskByIDWithPolicyAppliedFuncDef)funcPtr)(soap,sServerObjectID,TaskID,rc);
}

typedef int (* KLPRTS_AddTaskFuncDef)( struct soap *soap, xsd__wstring sServerObjectID,
				   param__params parTaskParams, 
				   struct KLPRTS_ADD_TASK_RESPONSE &rc);

int KLPRTS_AddTask( struct soap *soap, xsd__wstring sServerObjectID,
				   param__params parTaskParams, 
				   struct KLPRTS_ADD_TASK_RESPONSE &rc)
{
	void *funcPtr = KLSTRT::GetFunctionPtrByName(L"KLPRTS_AddTask");
	if ( funcPtr==NULL ) return SOAP_NO_METHOD;
	else return ((KLPRTS_AddTaskFuncDef)funcPtr)(soap,sServerObjectID,parTaskParams,rc);
}

typedef int (* KLPRTS_UpdateTaskFuncDef)( struct soap *soap, xsd__wstring sServerObjectID,
					  xsd__wstring TaskID, 
					  param__params parTaskParams, 
					  struct param_error& rc);

int KLPRTS_UpdateTask( struct soap *soap, xsd__wstring sServerObjectID,
					  xsd__wstring TaskID, 
					  param__params parTaskParams, 
					  struct param_error& rc)
{
	void *funcPtr = KLSTRT::GetFunctionPtrByName(L"KLPRTS_UpdateTask");
	if ( funcPtr==NULL ) return SOAP_NO_METHOD;
	else return ((KLPRTS_UpdateTaskFuncDef)funcPtr)(soap,sServerObjectID,TaskID,parTaskParams, rc);
}

typedef int (* KLPRTS_DeleteTaskFuncDef)( struct soap *soap, xsd__wstring sServerObjectID, 
					  xsd__wstring TaskID, 
					  struct param_error& rc);

int KLPRTS_DeleteTask( struct soap *soap, xsd__wstring sServerObjectID, 
					  xsd__wstring TaskID, 
					  struct param_error& rc)
{
	void *funcPtr = KLSTRT::GetFunctionPtrByName(L"KLPRTS_DeleteTask");
	if ( funcPtr==NULL ) return SOAP_NO_METHOD;
	else return ((KLPRTS_DeleteTaskFuncDef)funcPtr)(soap,sServerObjectID,TaskID, rc);
}

typedef int (* KLPRTS_SetTaskStartEventFuncDef)( struct soap *soap, xsd__wstring sServerObjectID,
							 xsd__wstring TaskID, 
							 SOAPComponentId cidEventFilter, 
							 xsd__wstring sEventType, 
							 param__params parBodyFilter, 
							 struct param_error& rc);

int KLPRTS_SetTaskStartEvent( struct soap *soap, xsd__wstring sServerObjectID,
							 xsd__wstring TaskID, 
							 SOAPComponentId cidEventFilter, 
							 xsd__wstring sEventType, 
							 param__params parBodyFilter, 
							 struct param_error& rc)
{
	void *funcPtr = KLSTRT::GetFunctionPtrByName(L"KLPRTS_SetTaskStartEvent");
	if ( funcPtr==NULL ) return SOAP_NO_METHOD;
	else return ((KLPRTS_SetTaskStartEventFuncDef)funcPtr)(soap,sServerObjectID,TaskID,cidEventFilter,sEventType,parBodyFilter, rc);
}

typedef int (* KLPRTS_GetTaskStartEventFuncDef)( struct soap *soap, xsd__wstring sServerObjectID,
							 xsd__wstring TaskID, 
							 struct KLPRTS_GET_TASK_START_EVENT_RESPONSE  &rc);

int KLPRTS_GetTaskStartEvent( struct soap *soap, xsd__wstring sServerObjectID,
							 xsd__wstring TaskID, 
							 struct KLPRTS_GET_TASK_START_EVENT_RESPONSE  &rc)
{
	void *funcPtr = KLSTRT::GetFunctionPtrByName(L"KLPRTS_GetTaskStartEvent");
	if ( funcPtr==NULL ) return SOAP_NO_METHOD;
	else return ((KLPRTS_GetTaskStartEventFuncDef)funcPtr)(soap,sServerObjectID,TaskID,rc);
}

typedef int (* KLPRTS_UpdateTask2FuncDef)( struct soap *soap, xsd__wstring sServerObjectID,
					   xsd__wstring TaskID, 
					   param__params parTaskParams, 
					   struct param_error& rc);

int KLPRTS_UpdateTask2( struct soap *soap, xsd__wstring sServerObjectID,
					   xsd__wstring TaskID, 
					   param__params parTaskParams, 
					   struct param_error& rc)
{
	void *funcPtr = KLSTRT::GetFunctionPtrByName(L"KLPRTS_UpdateTask2");
	if ( funcPtr==NULL ) return SOAP_NO_METHOD;
	else return ((KLPRTS_UpdateTask2FuncDef)funcPtr)(soap,sServerObjectID,TaskID,parTaskParams, rc);
}

typedef int (* KLPRTS_ReplaceTaskFuncDef)( struct soap *soap, xsd__wstring sServerObjectID,
					   xsd__wstring TaskID, 
					   param__params parTaskParams, 
					   struct param_error& rc);

int KLPRTS_ReplaceTask( struct soap *soap, xsd__wstring sServerObjectID,
					   xsd__wstring TaskID, 
					   param__params parTaskParams, 
					   struct param_error& rc)
{
	void *funcPtr = KLSTRT::GetFunctionPtrByName(L"KLPRTS_ReplaceTask");
	if ( funcPtr==NULL ) return SOAP_NO_METHOD;
	else return ((KLPRTS_ReplaceTaskFuncDef)funcPtr)(soap,sServerObjectID,TaskID,parTaskParams, rc);
}

typedef int (* klsssrv_CloseFuncDef)( struct soap *soap, 
                    xsd__wstring    wstrIdSSS,
                    xsd__wstring    wstrProxyId,
                    struct klsssrv_CloseResponse
                    & r);

int klsssrv_Close( struct soap *soap, 
                    xsd__wstring    wstrIdSSS,
                    xsd__wstring    wstrProxyId,
                    struct klsssrv_CloseResponse
                    & r)
{
	void *funcPtr = KLSTRT::GetFunctionPtrByName(L"klsssrv_Close");
	if ( funcPtr==NULL ) return SOAP_NO_METHOD;
	else return ((klsssrv_CloseFuncDef)funcPtr)(soap,wstrIdSSS,wstrProxyId, r);
}

typedef int (* klsssrv_CreateSettingsStorageFuncDef)( struct soap *soap, 
                    xsd__wstring    wstrIdSSS,
                    xsd__wstring    wstrLocation,
					xsd__int        nCreationFlags,
					xsd__int        nAccessFlags,
                    param__params   options,
                    struct klsssrv_CreateSettingsStorageResponse
                    & r);

int klsssrv_CreateSettingsStorage( struct soap *soap, 
                    xsd__wstring    wstrIdSSS,
                    xsd__wstring    wstrLocation,
					xsd__int        nCreationFlags,
					xsd__int        nAccessFlags,
                    param__params   options,
                    struct klsssrv_CreateSettingsStorageResponse
                    & r)
{
	void *funcPtr = KLSTRT::GetFunctionPtrByName(L"klsssrv_CreateSettingsStorage");
	if ( funcPtr==NULL ) return SOAP_NO_METHOD;
	else return ((klsssrv_CreateSettingsStorageFuncDef)funcPtr)(soap,wstrIdSSS,wstrLocation,nCreationFlags,nAccessFlags,options, r);
}

typedef int (* klsssrv_ReadFuncDef)( struct soap *soap, 
                    xsd__wstring   wstrIdSSS,
                    xsd__wstring   wstrProxyId,
                    xsd__wstring   wstrName,
                    xsd__wstring   wstrVersion,
                    xsd__wstring   wstrSection,
                    param__params  extra,
                    struct klsssrv_ReadResponse
                    & r);

int klsssrv_Read( struct soap *soap, 
                    xsd__wstring   wstrIdSSS,
                    xsd__wstring   wstrProxyId,
                    xsd__wstring   wstrName,
                    xsd__wstring   wstrVersion,
                    xsd__wstring   wstrSection,
                    param__params  extra,
                    struct klsssrv_ReadResponse
                    & r)
{
	void *funcPtr = KLSTRT::GetFunctionPtrByName(L"klsssrv_Read");
	if ( funcPtr==NULL ) return SOAP_NO_METHOD;
	else return ((klsssrv_ReadFuncDef)funcPtr)(soap,wstrIdSSS,wstrProxyId,wstrName,wstrVersion,wstrSection,extra, r);
}

typedef int (* klsssrv_WriteFuncDef)( struct soap *soap, 
                    xsd__wstring   wstrIdSSS,
                    xsd__wstring   wstrProxyId,
                    xsd__wstring   wstrName,
                    xsd__wstring   wstrVersion,
                    xsd__wstring   wstrSection,
                    xsd__int       nFlags,
                    param__params  data,
                    struct klsssrv_WriteResponse
                    & r);

int klsssrv_Write( struct soap *soap, 
                    xsd__wstring   wstrIdSSS,
                    xsd__wstring   wstrProxyId,
                    xsd__wstring   wstrName,
                    xsd__wstring   wstrVersion,
                    xsd__wstring   wstrSection,
                    xsd__int       nFlags,
                    param__params  data,
                    struct klsssrv_WriteResponse
                    & r)
{
	void *funcPtr = KLSTRT::GetFunctionPtrByName(L"klsssrv_Write");
	if ( funcPtr==NULL ) return SOAP_NO_METHOD;
	else return ((klsssrv_WriteFuncDef)funcPtr)(soap,wstrIdSSS,wstrProxyId,wstrName,wstrVersion,wstrSection,nFlags,data, r);
}

typedef int (* klsssrv_CreateSectionFuncDef)( struct soap *soap, 
                    xsd__wstring   wstrIdSSS,
                    xsd__wstring   wstrProxyId,
                    xsd__wstring   wstrName,
                    xsd__wstring   wstrVersion,
                    xsd__wstring   wstrSection,
                    struct klsssrv_CreateSectionResponse
                    & r);

int klsssrv_CreateSection( struct soap *soap, 
                    xsd__wstring   wstrIdSSS,
                    xsd__wstring   wstrProxyId,
                    xsd__wstring   wstrName,
                    xsd__wstring   wstrVersion,
                    xsd__wstring   wstrSection,
                    struct klsssrv_CreateSectionResponse
                    & r)
{
	void *funcPtr = KLSTRT::GetFunctionPtrByName(L"klsssrv_CreateSection");
	if ( funcPtr==NULL ) return SOAP_NO_METHOD;
	else return ((klsssrv_CreateSectionFuncDef)funcPtr)(soap,wstrIdSSS,wstrProxyId,wstrName,wstrVersion,wstrSection, r);
}

typedef int (* klsssrv_DeleteSectionFuncDef)( struct soap *soap, 
                    xsd__wstring   wstrIdSSS,
                    xsd__wstring   wstrProxyId,
                    xsd__wstring   wstrName,
                    xsd__wstring   wstrVersion,
                    xsd__wstring   wstrSection,
                    struct klsssrv_DeleteSectionResponse
                    & r);

int klsssrv_DeleteSection( struct soap *soap, 
                    xsd__wstring   wstrIdSSS,
                    xsd__wstring   wstrProxyId,
                    xsd__wstring   wstrName,
                    xsd__wstring   wstrVersion,
                    xsd__wstring   wstrSection,
                    struct klsssrv_DeleteSectionResponse
                    & r)
{
	void *funcPtr = KLSTRT::GetFunctionPtrByName(L"klsssrv_DeleteSection");
	if ( funcPtr==NULL ) return SOAP_NO_METHOD;
	else return ((klsssrv_DeleteSectionFuncDef)funcPtr)(soap,wstrIdSSS,wstrProxyId,wstrName,wstrVersion,wstrSection, r);
}

typedef int (* klsssrv_SetTimeoutFuncDef)( struct soap *soap, 
                    xsd__wstring    wstrIdSSS,
                    xsd__wstring    wstrProxyId,
                    xsd__int        lTimeout,
                    struct klsssrv_SetTimeoutResponse
                    & r);

int klsssrv_SetTimeout( struct soap *soap, 
                    xsd__wstring    wstrIdSSS,
                    xsd__wstring    wstrProxyId,
                    xsd__int        lTimeout,
                    struct klsssrv_SetTimeoutResponse
                    & r)
{
	void *funcPtr = KLSTRT::GetFunctionPtrByName(L"klsssrv_SetTimeout");
	if ( funcPtr==NULL ) return SOAP_NO_METHOD;
	else return ((klsssrv_SetTimeoutFuncDef)funcPtr)(soap,wstrIdSSS,wstrProxyId,lTimeout, r);
}

typedef int (* klsssrv_GetNamesFuncDef)( struct soap *soap, 
                    xsd__wstring   wstrIdSSS,
                    xsd__wstring   wstrProxyId,
                    xsd__wstring   wstrName,
                    xsd__wstring   wstrVersion,
                    struct klsssrv_GetNamesResponse
                    & r);

int klsssrv_GetNames( struct soap *soap, 
                    xsd__wstring   wstrIdSSS,
                    xsd__wstring   wstrProxyId,
                    xsd__wstring   wstrName,
                    xsd__wstring   wstrVersion,
                    struct klsssrv_GetNamesResponse
                    & r)
{
	void *funcPtr = KLSTRT::GetFunctionPtrByName(L"klsssrv_GetNames");
	if ( funcPtr==NULL ) return SOAP_NO_METHOD;
	else return ((klsssrv_GetNamesFuncDef)funcPtr)(soap,wstrIdSSS,wstrProxyId,wstrName,wstrVersion, r);
}

typedef int (* klsssrv_AttrReadFuncDef)( struct soap *soap, 
                    xsd__wstring   wstrIdSSS,
                    xsd__wstring   wstrProxyId,
                    xsd__wstring   wstrName,
                    xsd__wstring   wstrVersion,
                    xsd__wstring   wstrSection,
                    xsd__wstring   wstrAttr,
                    struct klsssrv_AttrReadResponse
                    & r);

int klsssrv_AttrRead( struct soap *soap, 
                    xsd__wstring   wstrIdSSS,
                    xsd__wstring   wstrProxyId,
                    xsd__wstring   wstrName,
                    xsd__wstring   wstrVersion,
                    xsd__wstring   wstrSection,
                    xsd__wstring   wstrAttr,
                    struct klsssrv_AttrReadResponse
                    & r)
{
	void *funcPtr = KLSTRT::GetFunctionPtrByName(L"klsssrv_AttrRead");
	if ( funcPtr==NULL ) return SOAP_NO_METHOD;
	else return ((klsssrv_AttrReadFuncDef)funcPtr)(soap,wstrIdSSS,wstrProxyId,wstrName,wstrVersion,wstrSection,wstrAttr, r);
}

typedef int (* klagent_StartTaskStorageTaskFuncDef)( struct soap *soap, 
							xsd__wstring	idTask,
							xsd__wstring	luid,
							xsd__int		lTimeout,
							struct klagent_StartTaskStorageTaskResponse
							 &r);

int klagent_StartTaskStorageTask( struct soap *soap, 
							xsd__wstring	idTask,
							xsd__wstring	luid,
							xsd__int		lTimeout,
							struct klagent_StartTaskStorageTaskResponse
							 &r)
{
	void *funcPtr = KLSTRT::GetFunctionPtrByName(L"klagent_StartTaskStorageTask");
	if ( funcPtr==NULL ) return SOAP_NO_METHOD;
	else return ((klagent_StartTaskStorageTaskFuncDef)funcPtr)(soap,idTask,luid,lTimeout,r);
}

typedef int (* klagent_StartComponentExFuncDef)( struct soap *soap, 
				SOAPComponentId		componentId,
				param__params		startParams,
				xsd__wstring		asyncId,
				xsd__int			flags,
				xsd__int			asyncTimeout,
				xsd__int			timeoutStop,
				xsd__int			logonType,
				xsd__wstring		user,
				xsd__wstring		domain,
				xsd__wstring		password,
				param__params		extraInParams,
				struct klagent_StartComponentExResponse &r);

int klagent_StartComponentEx( struct soap *soap, 
				SOAPComponentId		componentId,
				param__params		startParams,
				xsd__wstring		asyncId,
				xsd__int			flags,
				xsd__int			asyncTimeout,
				xsd__int			timeoutStop,
				xsd__int			logonType,
				xsd__wstring		user,
				xsd__wstring		domain,
				xsd__wstring		password,
				param__params		extraInParams,
				struct klagent_StartComponentExResponse &r)
{
	void *funcPtr = KLSTRT::GetFunctionPtrByName(L"klagent_StartComponentEx");
	if ( funcPtr==NULL ) return SOAP_NO_METHOD;
	else return ((klagent_StartComponentExFuncDef)funcPtr)(soap,componentId,startParams,asyncId,flags,asyncTimeout,timeoutStop,logonType,user,domain,password,extraInParams,r);
}

typedef int (* klagent_GetStartedComponentsListFuncDef)( struct soap *soap,  SOAPComponentId filter, 
							struct klagent_GetStartedComponentsListResponse &r );

int klagent_GetStartedComponentsList( struct soap *soap,  SOAPComponentId filter, 
							struct klagent_GetStartedComponentsListResponse &r )
{
	void *funcPtr = KLSTRT::GetFunctionPtrByName(L"klagent_GetStartedComponentsList");
	if ( funcPtr==NULL ) return SOAP_NO_METHOD;
	else return ((klagent_GetStartedComponentsListFuncDef)funcPtr)(soap,filter,r);
}

typedef int (* klagent_IsComponentStartedFuncDef)( struct soap *soap,  SOAPComponentId componentId, 
						  struct klagent_IsComponentStartedResponse &r );

int klagent_IsComponentStarted( struct soap *soap,  SOAPComponentId componentId, 
						  struct klagent_IsComponentStartedResponse &r )
{
	void *funcPtr = KLSTRT::GetFunctionPtrByName(L"klagent_IsComponentStarted");
	if ( funcPtr==NULL ) return SOAP_NO_METHOD;
	else return ((klagent_IsComponentStartedFuncDef)funcPtr)(soap,componentId,r);
}

typedef int (* klagent_GetComponentStartParametersFuncDef)( struct soap *soap,  SOAPComponentId componentId, 
						struct klagent_GetComponentStartParametersResponse &r );

int klagent_GetComponentStartParameters( struct soap *soap,  SOAPComponentId componentId, 
						struct klagent_GetComponentStartParametersResponse &r )
{
	void *funcPtr = KLSTRT::GetFunctionPtrByName(L"klagent_GetComponentStartParameters");
	if ( funcPtr==NULL ) return SOAP_NO_METHOD;
	else return ((klagent_GetComponentStartParametersFuncDef)funcPtr)(soap,componentId,r);
}

typedef int (* klagent_GetComponentPortFuncDef)( struct soap *soap, 	SOAPComponentId componentId, 
									struct klagent_GetComponentPortResponse &r );

int klagent_GetComponentPort( struct soap *soap, 	SOAPComponentId componentId, 
									struct klagent_GetComponentPortResponse &r )
{
	void *funcPtr = KLSTRT::GetFunctionPtrByName(L"klagent_GetComponentPort");
	if ( funcPtr==NULL ) return SOAP_NO_METHOD;
	else return ((klagent_GetComponentPortFuncDef)funcPtr)(soap,componentId,r);
}

typedef int (* klevprop_ResetIteratorFuncDef)( struct soap *soap, 
        xsd__int		            type,
        param__params		        paramIteratorDescr,
		klevprop_wstring_array		fields,
		klevprop_field_order_array	fields_to_order,
		xsd__int					lifetime,
		struct klevprop_ResetIteratorResponse&r);

int klevprop_ResetIterator( struct soap *soap, 
        xsd__int		            type,
        param__params		        paramIteratorDescr,
		klevprop_wstring_array		fields,
		klevprop_field_order_array	fields_to_order,
		xsd__int					lifetime,
		struct klevprop_ResetIteratorResponse&r)
{
	void *funcPtr = KLSTRT::GetFunctionPtrByName(L"klevprop_ResetIterator");
	if ( funcPtr==NULL ) return SOAP_NO_METHOD;
	else return ((klevprop_ResetIteratorFuncDef)funcPtr)(soap,type,paramIteratorDescr,fields,fields_to_order,lifetime,r);
}

typedef int (* klevprop_GetRecordCountFuncDef)( struct soap *soap, 
		xsd__wstring	iteratorId,
		struct klevprop_GetRecordCountResponse&r);

int klevprop_GetRecordCount( struct soap *soap, 
		xsd__wstring	iteratorId,
		struct klevprop_GetRecordCountResponse&r)
{
	void *funcPtr = KLSTRT::GetFunctionPtrByName(L"klevprop_GetRecordCount");
	if ( funcPtr==NULL ) return SOAP_NO_METHOD;
	else return ((klevprop_GetRecordCountFuncDef)funcPtr)(soap,iteratorId,r);
}

typedef int (* klevprop_GetRecordRangeFuncDef)( struct soap *soap, 
		xsd__wstring	iteratorId,
		xsd__int		nStart,
        xsd__int		nEnd,
		struct klevprop_GetRecordRangeResponse&r);

int klevprop_GetRecordRange( struct soap *soap, 
		xsd__wstring	iteratorId,
		xsd__int		nStart,
        xsd__int		nEnd,
		struct klevprop_GetRecordRangeResponse&r)
{
	void *funcPtr = KLSTRT::GetFunctionPtrByName(L"klevprop_GetRecordRange");
	if ( funcPtr==NULL ) return SOAP_NO_METHOD;
	else return ((klevprop_GetRecordRangeFuncDef)funcPtr)(soap,iteratorId,nStart,nEnd,r);
}

typedef int (* klevprop_FindRecordByFirstCharsFuncDef)( struct soap *soap, 
		xsd__wstring	iteratorId,
        xsd__wstring	wstrFieldToSearch,
        xsd__wstring	wstrFirstChars,
		struct klevprop_FindRecordByFirstCharsResponse
        &r);

int klevprop_FindRecordByFirstChars( struct soap *soap, 
		xsd__wstring	iteratorId,
        xsd__wstring	wstrFieldToSearch,
        xsd__wstring	wstrFirstChars,
		struct klevprop_FindRecordByFirstCharsResponse
        &r)
{
	void *funcPtr = KLSTRT::GetFunctionPtrByName(L"klevprop_FindRecordByFirstChars");
	if ( funcPtr==NULL ) return SOAP_NO_METHOD;
	else return ((klevprop_FindRecordByFirstCharsFuncDef)funcPtr)(soap,iteratorId,wstrFieldToSearch,wstrFirstChars,r);
}

typedef int (* klevprop_DeletePropertiesFuncDef)( struct soap *soap, 
		klevprop_int_array	id_array,
		struct klevprop_DeletePropertiesResponse&r);

int klevprop_DeleteProperties( struct soap *soap, 
		klevprop_int_array	id_array,
		struct klevprop_DeletePropertiesResponse&r)
{
	void *funcPtr = KLSTRT::GetFunctionPtrByName(L"klevprop_DeleteProperties");
	if ( funcPtr==NULL ) return SOAP_NO_METHOD;
	else return ((klevprop_DeletePropertiesFuncDef)funcPtr)(soap,id_array,r);
}

typedef int (* klevprop_InitiateDeleteFuncDef)( struct soap *soap, 
		param__params	paramSettings,
		struct klevprop_InitiateDeleteResponse&r);

int klevprop_InitiateDelete( struct soap *soap, 
		param__params	paramSettings,
		struct klevprop_InitiateDeleteResponse&r)
{
	void *funcPtr = KLSTRT::GetFunctionPtrByName(L"klevprop_InitiateDelete");
	if ( funcPtr==NULL ) return SOAP_NO_METHOD;
	else return ((klevprop_InitiateDeleteFuncDef)funcPtr)(soap,paramSettings,r);
}

typedef int (* klevprop_CancelDeleteFuncDef)( struct soap *soap, 
		param__params	paramSettings,
		struct klevprop_CancelDeleteResponse&r);

int klevprop_CancelDelete( struct soap *soap, 
		param__params	paramSettings,
		struct klevprop_CancelDeleteResponse&r)
{
	void *funcPtr = KLSTRT::GetFunctionPtrByName(L"klevprop_CancelDelete");
	if ( funcPtr==NULL ) return SOAP_NO_METHOD;
	else return ((klevprop_CancelDeleteFuncDef)funcPtr)(soap,paramSettings,r);
}

typedef int (* klevprop_ReleaseIteratorFuncDef)( struct soap *soap, 
		xsd__wstring	iteratorId,
		struct klevprop_ReleaseIteratorResponse&r);

int klevprop_ReleaseIterator( struct soap *soap, 
		xsd__wstring	iteratorId,
		struct klevprop_ReleaseIteratorResponse&r)
{
	void *funcPtr = KLSTRT::GetFunctionPtrByName(L"klevprop_ReleaseIterator");
	if ( funcPtr==NULL ) return SOAP_NO_METHOD;
	else return ((klevprop_ReleaseIteratorFuncDef)funcPtr)(soap,iteratorId,r);
}

typedef int (* klevproc_ProcessFuncDef)( struct soap *soap, 
		param__params		parEventInfoArray,
		xsd__wstring		deliveryId,
		xsd__wstring		domain,
		xsd__wstring		hostName,
		xsd__wstring		agentId,
		struct klevproc_ProcessResponse&r);

int klevproc_Process( struct soap *soap, 
		param__params		parEventInfoArray,
		xsd__wstring		deliveryId,
		xsd__wstring		domain,
		xsd__wstring		hostName,
		xsd__wstring		agentId,
		struct klevproc_ProcessResponse&r)
{
	void *funcPtr = KLSTRT::GetFunctionPtrByName(L"klevproc_Process");
	if ( funcPtr==NULL ) return SOAP_NO_METHOD;
	else return ((klevproc_ProcessFuncDef)funcPtr)(soap,parEventInfoArray,deliveryId,domain,hostName,agentId,r);
}

typedef int (* klevpnp_GetDefaultSettingsFuncDef)( struct soap *soap, 
		void* _,
		struct klevpnp_GetDefaultSettingsResponse&r);

int klevpnp_GetDefaultSettings( struct soap *soap, 
		void* _,
		struct klevpnp_GetDefaultSettingsResponse&r)
{
	void *funcPtr = KLSTRT::GetFunctionPtrByName(L"klevpnp_GetDefaultSettings");
	if ( funcPtr==NULL ) return SOAP_NO_METHOD;
	else return ((klevpnp_GetDefaultSettingsFuncDef)funcPtr)(soap, _,r);
}

typedef int (* klevpnp_SetDefaultSettingsFuncDef)( struct soap *soap, 
		param__params	    paramDefaultSettings,
		struct klevpnp_SetDefaultSettingsResponse&r);

int klevpnp_SetDefaultSettings( struct soap *soap, 
		param__params	    paramDefaultSettings,
		struct klevpnp_SetDefaultSettingsResponse&r)
{
	void *funcPtr = KLSTRT::GetFunctionPtrByName(L"klevpnp_SetDefaultSettings");
	if ( funcPtr==NULL ) return SOAP_NO_METHOD;
	else return ((klevpnp_SetDefaultSettingsFuncDef)funcPtr)(soap,paramDefaultSettings,r);
}

typedef int (* klevpnp_TestNotificationFuncDef)( struct soap *soap, 
    param__params    paramSettings,
	struct klevpnp_TestNotificationResponse&r);

int klevpnp_TestNotification( struct soap *soap, 
    param__params    paramSettings,
	struct klevpnp_TestNotificationResponse&r)
{
	void *funcPtr = KLSTRT::GetFunctionPtrByName(L"klevpnp_TestNotification");
	if ( funcPtr==NULL ) return SOAP_NO_METHOD;
	else return ((klevpnp_TestNotificationFuncDef)funcPtr)(soap,paramSettings,r);
}

typedef int (* klevpnp_SetNotificationLimitsFuncDef)( struct soap *soap, 
    param__params    paramSettings,
	struct klevpnp_SetNotificationLimitsResponse&r);

int klevpnp_SetNotificationLimits( struct soap *soap, 
    param__params    paramSettings,
	struct klevpnp_SetNotificationLimitsResponse&r)
{
	void *funcPtr = KLSTRT::GetFunctionPtrByName(L"klevpnp_SetNotificationLimits");
	if ( funcPtr==NULL ) return SOAP_NO_METHOD;
	else return ((klevpnp_SetNotificationLimitsFuncDef)funcPtr)(soap,paramSettings,r);
}

typedef int (* klevpnp_GetNotificationLimitsFuncDef)( struct soap *soap, 
    void* _,
	struct klevpnp_GetNotificationLimitsResponse&r);

int klevpnp_GetNotificationLimits( struct soap *soap, 
    void* _,
	struct klevpnp_GetNotificationLimitsResponse&r)
{
	void *funcPtr = KLSTRT::GetFunctionPtrByName(L"klevpnp_GetNotificationLimits");
	if ( funcPtr==NULL ) return SOAP_NO_METHOD;
	else return ((klevpnp_GetNotificationLimitsFuncDef)funcPtr)(soap, _,r);
}

typedef int (* klevpnp_GetCommonPropertiesFuncDef)( struct soap *soap, 
		void* _,
		struct klevpnp_GetCommonPropertiesResponse&r);

int klevpnp_GetCommonProperties( struct soap *soap, 
		void* _,
		struct klevpnp_GetCommonPropertiesResponse&r)
{
	void *funcPtr = KLSTRT::GetFunctionPtrByName(L"klevpnp_GetCommonProperties");
	if ( funcPtr==NULL ) return SOAP_NO_METHOD;
	else return ((klevpnp_GetCommonPropertiesFuncDef)funcPtr)(soap, _,r);
}

typedef int (* klevpnp_GetGroupPropertiesFuncDef)( struct soap *soap, 
		xsd__int			nGroupId,
		struct klevpnp_GetGroupPropertiesResponse&r);

int klevpnp_GetGroupProperties( struct soap *soap, 
		xsd__int			nGroupId,
		struct klevpnp_GetGroupPropertiesResponse&r)
{
	void *funcPtr = KLSTRT::GetFunctionPtrByName(L"klevpnp_GetGroupProperties");
	if ( funcPtr==NULL ) return SOAP_NO_METHOD;
	else return ((klevpnp_GetGroupPropertiesFuncDef)funcPtr)(soap,nGroupId,r);
}

typedef int (* klevpnp_GetTaskPropertiesFuncDef)( struct soap *soap, 
		xsd__wstring			wstrTaskId,
		struct klevpnp_GetTaskPropertiesResponse&r);

int klevpnp_GetTaskProperties( struct soap *soap, 
		xsd__wstring			wstrTaskId,
		struct klevpnp_GetTaskPropertiesResponse&r)
{
	void *funcPtr = KLSTRT::GetFunctionPtrByName(L"klevpnp_GetTaskProperties");
	if ( funcPtr==NULL ) return SOAP_NO_METHOD;
	else return ((klevpnp_GetTaskPropertiesFuncDef)funcPtr)(soap,wstrTaskId,r);
}

typedef int (* klevpnp_SetCommonPropertiesFuncDef)( struct soap *soap, 
		klevpnp_notification_descr_array	notificationDescrArray,
		struct klevpnp_SetCommonPropertiesResponse&r);

int klevpnp_SetCommonProperties( struct soap *soap, 
		klevpnp_notification_descr_array	notificationDescrArray,
		struct klevpnp_SetCommonPropertiesResponse&r)
{
	void *funcPtr = KLSTRT::GetFunctionPtrByName(L"klevpnp_SetCommonProperties");
	if ( funcPtr==NULL ) return SOAP_NO_METHOD;
	else return ((klevpnp_SetCommonPropertiesFuncDef)funcPtr)(soap,notificationDescrArray,r);
}

typedef int (* klevpnp_SetGroupPropertiesFuncDef)( struct soap *soap, 
		xsd__int							nGroupId,
		klevpnp_notification_descr_array	notificationDescrArray,
		struct klevpnp_SetGroupPropertiesResponse&r);

int klevpnp_SetGroupProperties( struct soap *soap, 
		xsd__int							nGroupId,
		klevpnp_notification_descr_array	notificationDescrArray,
		struct klevpnp_SetGroupPropertiesResponse&r)
{
	void *funcPtr = KLSTRT::GetFunctionPtrByName(L"klevpnp_SetGroupProperties");
	if ( funcPtr==NULL ) return SOAP_NO_METHOD;
	else return ((klevpnp_SetGroupPropertiesFuncDef)funcPtr)(soap,nGroupId,notificationDescrArray,r);
}

typedef int (* klevpnp_SetTaskPropertiesFuncDef)( struct soap *soap, 
		xsd__wstring			wstrTaskId,
		klevpnp_notification_descr_array	notificationDescrArray,
		struct klevpnp_SetTaskPropertiesResponse&r);

int klevpnp_SetTaskProperties( struct soap *soap, 
		xsd__wstring			wstrTaskId,
		klevpnp_notification_descr_array	notificationDescrArray,
		struct klevpnp_SetTaskPropertiesResponse&r)
{
	void *funcPtr = KLSTRT::GetFunctionPtrByName(L"klevpnp_SetTaskProperties");
	if ( funcPtr==NULL ) return SOAP_NO_METHOD;
	else return ((klevpnp_SetTaskPropertiesFuncDef)funcPtr)(soap,wstrTaskId,notificationDescrArray,r);
}

typedef int (* klnag_RemoveStoresFuncDef)( struct soap *soap, 
                    struct klnag_StoresList stores,
					struct klnag_RemoveStoresResponse&r);

int klnag_RemoveStores( struct soap *soap, 
                    struct klnag_StoresList stores,
					struct klnag_RemoveStoresResponse&r)
{
	void *funcPtr = KLSTRT::GetFunctionPtrByName(L"klnag_RemoveStores");
	if ( funcPtr==NULL ) return SOAP_NO_METHOD;
	else return ((klnag_RemoveStoresFuncDef)funcPtr)(soap,stores,r);
}

typedef int (* klnag_StartNewIntegrationFuncDef)( struct soap *soap, 
                    xsd__wstring    hostid,
					struct klnag_StartNewIntegrationResponse&r);

int klnag_StartNewIntegration( struct soap *soap, 
                    xsd__wstring    hostid,
					struct klnag_StartNewIntegrationResponse&r)
{
	void *funcPtr = KLSTRT::GetFunctionPtrByName(L"klnag_StartNewIntegration");
	if ( funcPtr==NULL ) return SOAP_NO_METHOD;
	else return ((klnag_StartNewIntegrationFuncDef)funcPtr)(soap,hostid,r);
}

typedef int (* klnag_NotifySSChangeFuncDef)( struct soap *soap, 
					xsd__wstring	product,
					xsd__wstring	version,
                    xsd__wstring	section,
                    xsd__int        ss_type,
					struct klnag_NotifySSChangeResponse&r);

int klnag_NotifySSChange( struct soap *soap, 
					xsd__wstring	product,
					xsd__wstring	version,
                    xsd__wstring	section,
                    xsd__int        ss_type,
					struct klnag_NotifySSChangeResponse&r)
{
	void *funcPtr = KLSTRT::GetFunctionPtrByName(L"klnag_NotifySSChange");
	if ( funcPtr==NULL ) return SOAP_NO_METHOD;
	else return ((klnag_NotifySSChangeFuncDef)funcPtr)(soap,product,version,section,ss_type,r);
}

typedef int (* klnag_OnPingFuncDef)( struct soap *soap, 
					param__params info,
					struct klnag_OnPingResponse&r);

int klnag_OnPing( struct soap *soap, 
					param__params info,
					struct klnag_OnPingResponse&r)
{
	void *funcPtr = KLSTRT::GetFunctionPtrByName(L"klnag_OnPing");
	if ( funcPtr==NULL ) return SOAP_NO_METHOD;
	else return ((klnag_OnPingFuncDef)funcPtr)(soap,info,r);
}

typedef int (* klnag_WatchdogPingFuncDef)( struct soap *soap, 
				  struct klnag_WatchdogPingResponse&r);

int klnag_WatchdogPing( struct soap *soap, 
				  struct klnag_WatchdogPingResponse&r)
{
	void *funcPtr = KLSTRT::GetFunctionPtrByName(L"klnag_WatchdogPing");
	if ( funcPtr==NULL ) return SOAP_NO_METHOD;
	else return ((klnag_WatchdogPingFuncDef)funcPtr)(soap,r);
}

typedef int (* klnag_GetRunTimeInfoFuncDef)( struct soap *soap, 
					param__params filter,
					struct klnag_GetRunTimeInfoResponse&r);

int klnag_GetRunTimeInfo( struct soap *soap, 
					param__params filter,
					struct klnag_GetRunTimeInfoResponse&r)
{
	void *funcPtr = KLSTRT::GetFunctionPtrByName(L"klnag_GetRunTimeInfo");
	if ( funcPtr==NULL ) return SOAP_NO_METHOD;
	else return ((klnag_GetRunTimeInfoFuncDef)funcPtr)(soap,filter,r);
}

typedef int (* klnag_GetStaticInfoFuncDef)( struct soap *soap, 
					param__params filter,
					struct klnag_GetStaticInfoResponse&r);

int klnag_GetStaticInfo( struct soap *soap, 
					param__params filter,
					struct klnag_GetStaticInfoResponse&r)
{
	void *funcPtr = KLSTRT::GetFunctionPtrByName(L"klnag_GetStaticInfo");
	if ( funcPtr==NULL ) return SOAP_NO_METHOD;
	else return ((klnag_GetStaticInfoFuncDef)funcPtr)(soap,filter,r);
}

typedef int (* klnag_GetStatisticsFuncDef)( struct soap *soap, 
					param__params filter,
					struct klnag_GetStatisticsResponse&r);

int klnag_GetStatistics( struct soap *soap, 
					param__params filter,
					struct klnag_GetStatisticsResponse&r)
{
	void *funcPtr = KLSTRT::GetFunctionPtrByName(L"klnag_GetStatistics");
	if ( funcPtr==NULL ) return SOAP_NO_METHOD;
	else return ((klnag_GetStatisticsFuncDef)funcPtr)(soap,filter,r);
}

typedef int (* klnag_GetInstancePortFuncDef)( struct soap *soap, 
					xsd__wstring	product,
					xsd__wstring	version,
					xsd__wstring	component,
					xsd__wstring	instance,
					struct klnag_GetInstancePortResponse&r);

int klnag_GetInstancePort( struct soap *soap, 
					xsd__wstring	product,
					xsd__wstring	version,
					xsd__wstring	component,
					xsd__wstring	instance,
					struct klnag_GetInstancePortResponse&r)
{
	void *funcPtr = KLSTRT::GetFunctionPtrByName(L"klnag_GetInstancePort");
	if ( funcPtr==NULL ) return SOAP_NO_METHOD;
	else return ((klnag_GetInstancePortFuncDef)funcPtr)(soap,product,version,component,instance,r);
}

typedef int (* klnag_StartProductFuncDef)( struct soap *soap, 
                        xsd__wstring productname,
                        xsd__wstring productversion,
                        param__params extraparams,
                        struct klnag_StartProductResponse &r);

int klnag_StartProduct( struct soap *soap, 
                        xsd__wstring productname,
                        xsd__wstring productversion,
                        param__params extraparams,
                        struct klnag_StartProductResponse &r)
{
	void *funcPtr = KLSTRT::GetFunctionPtrByName(L"klnag_StartProduct");
	if ( funcPtr==NULL ) return SOAP_NO_METHOD;
	else return ((klnag_StartProductFuncDef)funcPtr)(soap,productname,productversion,extraparams,r);
}

typedef int (* klnag_StopProductFuncDef)( struct soap *soap, 
                        xsd__wstring productname,
                        xsd__wstring productversion,
                        param__params extraparams,
                        struct klnag_StopProductResponse &r);

int klnag_StopProduct( struct soap *soap, 
                        xsd__wstring productname,
                        xsd__wstring productversion,
                        param__params extraparams,
                        struct klnag_StopProductResponse &r)
{
	void *funcPtr = KLSTRT::GetFunctionPtrByName(L"klnag_StopProduct");
	if ( funcPtr==NULL ) return SOAP_NO_METHOD;
	else return ((klnag_StopProductFuncDef)funcPtr)(soap,productname,productversion,extraparams,r);
}

typedef int (* klnag_OnStartRemoteInstallTaskFuncDef)( struct soap *soap, 
						xsd__int		taskId,
                        struct klnag_OnStartRemoteInstallTaskResponse &r);

int klnag_OnStartRemoteInstallTask( struct soap *soap, 
						xsd__int		taskId,
                        struct klnag_OnStartRemoteInstallTaskResponse &r)
{
	void *funcPtr = KLSTRT::GetFunctionPtrByName(L"klnag_OnStartRemoteInstallTask");
	if ( funcPtr==NULL ) return SOAP_NO_METHOD;
	else return ((klnag_OnStartRemoteInstallTaskFuncDef)funcPtr)(soap,taskId,r);
}

typedef int (* klnag_OnInstallerNotificationFuncDef)( struct soap *soap, 
                        param__params info, 
                        struct klnag_OnInstallerNotificationResponse& r);

int klnag_OnInstallerNotification( struct soap *soap, 
                        param__params info, 
                        struct klnag_OnInstallerNotificationResponse& r)
{
	void *funcPtr = KLSTRT::GetFunctionPtrByName(L"klnag_OnInstallerNotification");
	if ( funcPtr==NULL ) return SOAP_NO_METHOD;
	else return ((klnag_OnInstallerNotificationFuncDef)funcPtr)(soap,info, r);
}

typedef int (* klnag_GetHostPublicKeyFuncDef)( struct soap *soap, 
                        struct klnag_GetHostPublicKeyResponse& r);

int klnag_GetHostPublicKey( struct soap *soap, 
                        struct klnag_GetHostPublicKeyResponse& r)
{
	void *funcPtr = KLSTRT::GetFunctionPtrByName(L"klnag_GetHostPublicKey");
	if ( funcPtr==NULL ) return SOAP_NO_METHOD;
	else return ((klnag_GetHostPublicKeyFuncDef)funcPtr)(soap, r);
}

typedef int (* klnag_PutGlobalKeysFuncDef)( struct soap *soap, 
                        xsd__base64Binary   key1,
                        xsd__base64Binary   key2, 
                        struct klnag_PutGlobalKeysResponse& r);

int klnag_PutGlobalKeys( struct soap *soap, 
                        xsd__base64Binary   key1,
                        xsd__base64Binary   key2, 
                        struct klnag_PutGlobalKeysResponse& r)
{
	void *funcPtr = KLSTRT::GetFunctionPtrByName(L"klnag_PutGlobalKeys");
	if ( funcPtr==NULL ) return SOAP_NO_METHOD;
	else return ((klnag_PutGlobalKeysFuncDef)funcPtr)(soap,key1,key2, r);
}

typedef int (* klnag_OnUserForceSyncRequestFuncDef)( struct soap *soap, 
                        param__params info,
                        struct klnag_OnUserForceSyncRequestResponse& r);

int klnag_OnUserForceSyncRequest( struct soap *soap, 
                        param__params info,
                        struct klnag_OnUserForceSyncRequestResponse& r)
{
	void *funcPtr = KLSTRT::GetFunctionPtrByName(L"klnag_OnUserForceSyncRequest");
	if ( funcPtr==NULL ) return SOAP_NO_METHOD;
	else return ((klnag_OnUserForceSyncRequestFuncDef)funcPtr)(soap,info, r);
}

typedef int (* klftbridge_CreateReceiverFuncDef)( struct soap *soap,  xsd__boolean		useUpdaterFolder,
						struct klftbridge_CreateReceiverResponse
							&r );

int klftbridge_CreateReceiver( struct soap *soap,  xsd__boolean		useUpdaterFolder,
						struct klftbridge_CreateReceiverResponse
							&r )
{
	void *funcPtr = KLSTRT::GetFunctionPtrByName(L"klftbridge_CreateReceiver");
	if ( funcPtr==NULL ) return SOAP_NO_METHOD;
	else return ((klftbridge_CreateReceiverFuncDef)funcPtr)(soap,useUpdaterFolder,r);
}

typedef int (* klftbridge_ConnectFuncDef)( struct soap *soap,  xsd__wstring			receiverId,
					    xsd__boolean			toMasterServer,
						struct klftbridge_ConnectResponse
							&r );

int klftbridge_Connect( struct soap *soap,  xsd__wstring			receiverId,
					    xsd__boolean			toMasterServer,
						struct klftbridge_ConnectResponse
							&r )
{
	void *funcPtr = KLSTRT::GetFunctionPtrByName(L"klftbridge_Connect");
	if ( funcPtr==NULL ) return SOAP_NO_METHOD;
	else return ((klftbridge_ConnectFuncDef)funcPtr)(soap,receiverId,toMasterServer,r);
}

typedef int (* klftbridge_GetFileInfoFuncDef)( struct soap *soap, 
						xsd__wstring	receiverId,
						xsd__wstring	fileName,
						struct klftbridge_GetFileInfoResponse
							&r );

int klftbridge_GetFileInfo( struct soap *soap, 
						xsd__wstring	receiverId,
						xsd__wstring	fileName,
						struct klftbridge_GetFileInfoResponse
							&r )
{
	void *funcPtr = KLSTRT::GetFunctionPtrByName(L"klftbridge_GetFileInfo");
	if ( funcPtr==NULL ) return SOAP_NO_METHOD;
	else return ((klftbridge_GetFileInfoFuncDef)funcPtr)(soap,receiverId,fileName,r);
}

typedef int (* klftbridge_GetNextFileChunkFuncDef)( struct soap *soap, 
						xsd__wstring	receiverId,
						xsd__wstring	fileName,						
						xsd__unsignedLong	startFilePos,
						xsd__unsignedLong	neededSize,						
						struct klftbridge_GetNextFileChunkResponse
							&r );

int klftbridge_GetNextFileChunk( struct soap *soap, 
						xsd__wstring	receiverId,
						xsd__wstring	fileName,						
						xsd__unsignedLong	startFilePos,
						xsd__unsignedLong	neededSize,						
						struct klftbridge_GetNextFileChunkResponse
							&r )
{
	void *funcPtr = KLSTRT::GetFunctionPtrByName(L"klftbridge_GetNextFileChunk");
	if ( funcPtr==NULL ) return SOAP_NO_METHOD;
	else return ((klftbridge_GetNextFileChunkFuncDef)funcPtr)(soap,receiverId,fileName,startFilePos,neededSize,r);
}

typedef int (* klftbridge_ReleaseReceiverFuncDef)( struct soap *soap,  xsd__wstring			receiverId,
						struct klftbridge_ReleaseReceiverResponse
							&r );

int klftbridge_ReleaseReceiver( struct soap *soap,  xsd__wstring			receiverId,
						struct klftbridge_ReleaseReceiverResponse
							&r )
{
	void *funcPtr = KLSTRT::GetFunctionPtrByName(L"klftbridge_ReleaseReceiver");
	if ( funcPtr==NULL ) return SOAP_NO_METHOD;
	else return ((klftbridge_ReleaseReceiverFuncDef)funcPtr)(soap,receiverId,r);
}

typedef int (* klft_InitiateFileUploadFuncDef)( struct soap *soap, 
						xsd__wstring	fileName,
						xsd__wstring	fileId,
						xsd__wstring	description,
						xsd__unsignedLong	dirFlag,
						xsd__unsignedLong	fullFileSize,						
						xsd__wstring	serverComponent,
						xsd__wstring	remoteClientName,
						xsd__unsignedLong	uploadDelay,
						xsd__unsignedLong	nextChunkDelay,
						xsd__int			fileType,
						xsd__unsignedLong	forUpdateAgentFlag,
						struct SOAPUpdateAgentInfosList *updatesAgents,
						struct klft_InitiateFileUploadResponse
							&r );

int klft_InitiateFileUpload( struct soap *soap, 
						xsd__wstring	fileName,
						xsd__wstring	fileId,
						xsd__wstring	description,
						xsd__unsignedLong	dirFlag,
						xsd__unsignedLong	fullFileSize,						
						xsd__wstring	serverComponent,
						xsd__wstring	remoteClientName,
						xsd__unsignedLong	uploadDelay,
						xsd__unsignedLong	nextChunkDelay,
						xsd__int			fileType,
						xsd__unsignedLong	forUpdateAgentFlag,
						struct SOAPUpdateAgentInfosList *updatesAgents,
						struct klft_InitiateFileUploadResponse
							&r )
{
	void *funcPtr = KLSTRT::GetFunctionPtrByName(L"klft_InitiateFileUpload");
	if ( funcPtr==NULL ) return SOAP_NO_METHOD;
	else return ((klft_InitiateFileUploadFuncDef)funcPtr)(soap,fileName,fileId,description,dirFlag,fullFileSize,serverComponent,remoteClientName,uploadDelay,nextChunkDelay,fileType,forUpdateAgentFlag,updatesAgents,r);
}

typedef int (* klft_RegisterUpdateAgentFuncDef)( struct soap *soap, 
						xsd__wstring	strAddress,
						xsd__wstring	strNoSSLAddress,
						xsd__wstring	strMulticastIp,
						param__params	pParOptions,
						struct klft_RegisterUpdateAgentResponse
							&r );

int klft_RegisterUpdateAgent( struct soap *soap, 
						xsd__wstring	strAddress,
						xsd__wstring	strNoSSLAddress,
						xsd__wstring	strMulticastIp,
						param__params	pParOptions,
						struct klft_RegisterUpdateAgentResponse
							&r )
{
	void *funcPtr = KLSTRT::GetFunctionPtrByName(L"klft_RegisterUpdateAgent");
	if ( funcPtr==NULL ) return SOAP_NO_METHOD;
	else return ((klft_RegisterUpdateAgentFuncDef)funcPtr)(soap,strAddress,strNoSSLAddress,strMulticastIp,pParOptions,r);
}

typedef int (* klft_InitiateServerFileUploadFuncDef)( struct soap *soap, 						
						xsd__wstring	fileId,
						xsd__unsignedLong	dirFlag,
						xsd__unsignedLong	lifeTime,
						xsd__unsignedLong	fullFileSize,
						struct klft_InitiateServerFileUploadResponse
							&r );

int klft_InitiateServerFileUpload( struct soap *soap, 						
						xsd__wstring	fileId,
						xsd__unsignedLong	dirFlag,
						xsd__unsignedLong	lifeTime,
						xsd__unsignedLong	fullFileSize,
						struct klft_InitiateServerFileUploadResponse
							&r )
{
	void *funcPtr = KLSTRT::GetFunctionPtrByName(L"klft_InitiateServerFileUpload");
	if ( funcPtr==NULL ) return SOAP_NO_METHOD;
	else return ((klft_InitiateServerFileUploadFuncDef)funcPtr)(soap,fileId,dirFlag,lifeTime,fullFileSize,r);
}

typedef int (* klft_CancelServerFileUploadFuncDef)( struct soap *soap, 						
						xsd__wstring	fileId,
						struct klft_CancelServerFileUploadResponse
							&r );

int klft_CancelServerFileUpload( struct soap *soap, 						
						xsd__wstring	fileId,
						struct klft_CancelServerFileUploadResponse
							&r )
{
	void *funcPtr = KLSTRT::GetFunctionPtrByName(L"klft_CancelServerFileUpload");
	if ( funcPtr==NULL ) return SOAP_NO_METHOD;
	else return ((klft_CancelServerFileUploadFuncDef)funcPtr)(soap,fileId,r);
}

typedef int (* klft_PutNextFileChunkFuncDef)( struct soap *soap, 						
						xsd__wstring	fileId,						
						struct klft_file_chunk_t	chunk,
						struct klft_PutNextFileChunkResponse
							&r );

int klft_PutNextFileChunk( struct soap *soap, 						
						xsd__wstring	fileId,						
						struct klft_file_chunk_t	chunk,
						struct klft_PutNextFileChunkResponse
							&r )
{
	void *funcPtr = KLSTRT::GetFunctionPtrByName(L"klft_PutNextFileChunk");
	if ( funcPtr==NULL ) return SOAP_NO_METHOD;
	else return ((klft_PutNextFileChunkFuncDef)funcPtr)(soap,fileId,chunk,r);
}

typedef int (* klft_GetSyncFolderDiffFuncDef)( struct soap *soap, 						
						xsd__wstring	fileDescription,
						struct SOAPFilesInfoList *clientFilesList,
						struct SOAPSyncFolderOptions *subfoldersOptions,
						struct klft_GetSyncFolderDiffResponse
							&r );

int klft_GetSyncFolderDiff( struct soap *soap, 						
						xsd__wstring	fileDescription,
						struct SOAPFilesInfoList *clientFilesList,
						struct SOAPSyncFolderOptions *subfoldersOptions,
						struct klft_GetSyncFolderDiffResponse
							&r )
{
	void *funcPtr = KLSTRT::GetFunctionPtrByName(L"klft_GetSyncFolderDiff");
	if ( funcPtr==NULL ) return SOAP_NO_METHOD;
	else return ((klft_GetSyncFolderDiffFuncDef)funcPtr)(soap,fileDescription,clientFilesList,subfoldersOptions,r);
}

typedef int (* klft_GetSyncFolderFileInfoFuncDef)( struct soap *soap, 
						xsd__wstring	syncFolderFileId,
						xsd__wstring	folderFileName,						
						struct klft_GetSyncFolderFileInfoResponse
							&r );

int klft_GetSyncFolderFileInfo( struct soap *soap, 
						xsd__wstring	syncFolderFileId,
						xsd__wstring	folderFileName,						
						struct klft_GetSyncFolderFileInfoResponse
							&r )
{
	void *funcPtr = KLSTRT::GetFunctionPtrByName(L"klft_GetSyncFolderFileInfo");
	if ( funcPtr==NULL ) return SOAP_NO_METHOD;
	else return ((klft_GetSyncFolderFileInfoFuncDef)funcPtr)(soap,syncFolderFileId,folderFileName,r);
}

typedef int (* klft_GetSyncFolderFileChunkFuncDef)( struct soap *soap, 
						xsd__wstring	syncFolderFileId,
						xsd__wstring	folderFileName,						
						xsd__unsignedLong	startFilePos,
						xsd__unsignedLong	neededSize,
						struct klft_GetSyncFolderFileChunkResponse
							&r );

int klft_GetSyncFolderFileChunk( struct soap *soap, 
						xsd__wstring	syncFolderFileId,
						xsd__wstring	folderFileName,						
						xsd__unsignedLong	startFilePos,
						xsd__unsignedLong	neededSize,
						struct klft_GetSyncFolderFileChunkResponse
							&r )
{
	void *funcPtr = KLSTRT::GetFunctionPtrByName(L"klft_GetSyncFolderFileChunk");
	if ( funcPtr==NULL ) return SOAP_NO_METHOD;
	else return ((klft_GetSyncFolderFileChunkFuncDef)funcPtr)(soap,syncFolderFileId,folderFileName,startFilePos,neededSize,r);
}

typedef int (* sync_putDataFuncDef)( struct soap *soap, 
				xsd__wstring wstrID,
				param__params data,
				struct sync_putDataResponse &r);

int sync_putData( struct soap *soap, 
				xsd__wstring wstrID,
				param__params data,
				struct sync_putDataResponse &r)
{
	void *funcPtr = KLSTRT::GetFunctionPtrByName(L"sync_putData");
	if ( funcPtr==NULL ) return SOAP_NO_METHOD;
	else return ((sync_putDataFuncDef)funcPtr)(soap,wstrID,data,r);
}

typedef int (* sync_CallFuncDef)( struct soap *soap, 
				xsd__wstring wstrIDTo,
				xsd__wstring wstrIDFrom,
				param__params parInputData,
				struct sync_CallResponse &r);

int sync_Call( struct soap *soap, 
				xsd__wstring wstrIDTo,
				xsd__wstring wstrIDFrom,
				param__params parInputData,
				struct sync_CallResponse &r)
{
	void *funcPtr = KLSTRT::GetFunctionPtrByName(L"sync_Call");
	if ( funcPtr==NULL ) return SOAP_NO_METHOD;
	else return ((sync_CallFuncDef)funcPtr)(soap,wstrIDTo,wstrIDFrom,parInputData,r);
}

typedef int (* sync_startFuncDef)( struct soap *soap, 
				xsd__wstring wstrType,
				xsd__wstring wstrIDFrom,
				param__params parOptions,
				struct sync_startResponse &r);

int sync_start( struct soap *soap, 
				xsd__wstring wstrType,
				xsd__wstring wstrIDFrom,
				param__params parOptions,
				struct sync_startResponse &r)
{
	void *funcPtr = KLSTRT::GetFunctionPtrByName(L"sync_start");
	if ( funcPtr==NULL ) return SOAP_NO_METHOD;
	else return ((sync_startFuncDef)funcPtr)(soap,wstrType,wstrIDFrom,parOptions,r);
}

typedef int (* klhst_UseKeepConnectionFuncDef)( struct soap *soap, 
					xsd__wstring		host,
					struct klhst_UseKeepConnectionResponse&r);

int klhst_UseKeepConnection( struct soap *soap, 
					xsd__wstring		host,
					struct klhst_UseKeepConnectionResponse&r)
{
	void *funcPtr = KLSTRT::GetFunctionPtrByName(L"klhst_UseKeepConnection");
	if ( funcPtr==NULL ) return SOAP_NO_METHOD;
	else return ((klhst_UseKeepConnectionFuncDef)funcPtr)(soap,host,r);
}

typedef int (* klhst_AddHostsFuncDef)( struct soap *soap, 
					param__params	info,
					struct klhst_AddHostsResponse&r);

int klhst_AddHosts( struct soap *soap, 
					param__params	info,
					struct klhst_AddHostsResponse&r)
{
	void *funcPtr = KLSTRT::GetFunctionPtrByName(L"klhst_AddHosts");
	if ( funcPtr==NULL ) return SOAP_NO_METHOD;
	else return ((klhst_AddHostsFuncDef)funcPtr)(soap,info,r);
}

typedef int (* klhst_GetHostTasksFuncDef)( struct soap *soap, 
					xsd__wstring		host,
					xsd__wstring		product,
					xsd__wstring		version,
					xsd__int			lifetime,
					struct klhst_GetHostTasksResponse&r);

int klhst_GetHostTasks( struct soap *soap, 
					xsd__wstring		host,
					xsd__wstring		product,
					xsd__wstring		version,
					xsd__int			lifetime,
					struct klhst_GetHostTasksResponse&r)
{
	void *funcPtr = KLSTRT::GetFunctionPtrByName(L"klhst_GetHostTasks");
	if ( funcPtr==NULL ) return SOAP_NO_METHOD;
	else return ((klhst_GetHostTasksFuncDef)funcPtr)(soap,host,product,version,lifetime,r);
}

typedef int (* klhst_GetDomainsFuncDef)( struct soap *soap, 
					void* _,
					struct klhst_GetDomainsResponse&r);

int klhst_GetDomains( struct soap *soap, 
					void* _,
					struct klhst_GetDomainsResponse&r)
{
	void *funcPtr = KLSTRT::GetFunctionPtrByName(L"klhst_GetDomains");
	if ( funcPtr==NULL ) return SOAP_NO_METHOD;
	else return ((klhst_GetDomainsFuncDef)funcPtr)(soap, _,r);
}

typedef int (* klhst_GetDomainHostsFuncDef)( struct soap *soap, 
					xsd__wstring domain,
					struct klhst_GetDomainHostsResponse&r);

int klhst_GetDomainHosts( struct soap *soap, 
					xsd__wstring domain,
					struct klhst_GetDomainHostsResponse&r)
{
	void *funcPtr = KLSTRT::GetFunctionPtrByName(L"klhst_GetDomainHosts");
	if ( funcPtr==NULL ) return SOAP_NO_METHOD;
	else return ((klhst_GetDomainHostsFuncDef)funcPtr)(soap,domain,r);
}

typedef int (* klhst_GetHostInfoFuncDef)( struct soap *soap, 
					  xsd__wstring		name,
					  klhst_wstrings	fields,
					  struct klhst_GetHostInfoResponse&r);

int klhst_GetHostInfo( struct soap *soap, 
					  xsd__wstring		name,
					  klhst_wstrings	fields,
					  struct klhst_GetHostInfoResponse&r)
{
	void *funcPtr = KLSTRT::GetFunctionPtrByName(L"klhst_GetHostInfo");
	if ( funcPtr==NULL ) return SOAP_NO_METHOD;
	else return ((klhst_GetHostInfoFuncDef)funcPtr)(soap,name,fields,r);
}

typedef int (* klhst_AddDomainFuncDef)( struct soap *soap, 
					  xsd__wstring		domain,
					  xsd__int			type,
					  struct klhst_AddDomainResponse&r);

int klhst_AddDomain( struct soap *soap, 
					  xsd__wstring		domain,
					  xsd__int			type,
					  struct klhst_AddDomainResponse&r)
{
	void *funcPtr = KLSTRT::GetFunctionPtrByName(L"klhst_AddDomain");
	if ( funcPtr==NULL ) return SOAP_NO_METHOD;
	else return ((klhst_AddDomainFuncDef)funcPtr)(soap,domain,type,r);
}

typedef int (* klhst_DelDomainFuncDef)( struct soap *soap, 
					  xsd__wstring		domain,
					  struct klhst_DelDomainResponse&r);

int klhst_DelDomain( struct soap *soap, 
					  xsd__wstring		domain,
					  struct klhst_DelDomainResponse&r)
{
	void *funcPtr = KLSTRT::GetFunctionPtrByName(L"klhst_DelDomain");
	if ( funcPtr==NULL ) return SOAP_NO_METHOD;
	else return ((klhst_DelDomainFuncDef)funcPtr)(soap,domain,r);
}

typedef int (* klhst_AddHostFuncDef)( struct soap *soap, 
					  param__params		info,
					  struct klhst_AddHostResponse&r);

int klhst_AddHost( struct soap *soap, 
					  param__params		info,
					  struct klhst_AddHostResponse&r)
{
	void *funcPtr = KLSTRT::GetFunctionPtrByName(L"klhst_AddHost");
	if ( funcPtr==NULL ) return SOAP_NO_METHOD;
	else return ((klhst_AddHostFuncDef)funcPtr)(soap,info,r);
}

typedef int (* klhst_DelHostFuncDef)( struct soap *soap, 
					  xsd__wstring		name,
					  struct klhst_DelHostResponse&r);

int klhst_DelHost( struct soap *soap, 
					  xsd__wstring		name,
					  struct klhst_DelHostResponse&r)
{
	void *funcPtr = KLSTRT::GetFunctionPtrByName(L"klhst_DelHost");
	if ( funcPtr==NULL ) return SOAP_NO_METHOD;
	else return ((klhst_DelHostFuncDef)funcPtr)(soap,name,r);
}

typedef int (* klhst_UpdateHostFuncDef)( struct soap *soap, 
					  xsd__wstring		name,
					  param__params		info,
					  struct klhst_UpdateHostResponse&r);

int klhst_UpdateHost( struct soap *soap, 
					  xsd__wstring		name,
					  param__params		info,
					  struct klhst_UpdateHostResponse&r)
{
	void *funcPtr = KLSTRT::GetFunctionPtrByName(L"klhst_UpdateHost");
	if ( funcPtr==NULL ) return SOAP_NO_METHOD;
	else return ((klhst_UpdateHostFuncDef)funcPtr)(soap,name,info,r);
}

typedef int (* klhst_GetHostProductsFuncDef)( struct soap *soap, 
					  xsd__wstring		name,
					  struct klhst_GetHostProductsResponse&r);

int klhst_GetHostProducts( struct soap *soap, 
					  xsd__wstring		name,
					  struct klhst_GetHostProductsResponse&r)
{
	void *funcPtr = KLSTRT::GetFunctionPtrByName(L"klhst_GetHostProducts");
	if ( funcPtr==NULL ) return SOAP_NO_METHOD;
	else return ((klhst_GetHostProductsFuncDef)funcPtr)(soap,name,r);
}

typedef int (* klhst_SS_ReadFuncDef)( struct soap *soap, 
				  xsd__wstring	name,
				  xsd__wstring	type,
				  xsd__wstring	product,
				  xsd__wstring	version,
				  xsd__wstring	section,
				  xsd__int		timeout,
				  struct klhst_SS_ReadResponse&r);

int klhst_SS_Read( struct soap *soap, 
				  xsd__wstring	name,
				  xsd__wstring	type,
				  xsd__wstring	product,
				  xsd__wstring	version,
				  xsd__wstring	section,
				  xsd__int		timeout,
				  struct klhst_SS_ReadResponse&r)
{
	void *funcPtr = KLSTRT::GetFunctionPtrByName(L"klhst_SS_Read");
	if ( funcPtr==NULL ) return SOAP_NO_METHOD;
	else return ((klhst_SS_ReadFuncDef)funcPtr)(soap,name,type,product,version,section,timeout,r);
}

typedef int (* klhst_SS_WriteFuncDef)( struct soap *soap, 
					xsd__wstring	name,
					xsd__wstring	type,
					xsd__wstring	product,
					xsd__wstring	version,
					xsd__wstring	section,
					xsd__int		flags,
					param__params	data,
					xsd__int		timeout,
					struct klhst_SS_WriteResponse&r);

int klhst_SS_Write( struct soap *soap, 
					xsd__wstring	name,
					xsd__wstring	type,
					xsd__wstring	product,
					xsd__wstring	version,
					xsd__wstring	section,
					xsd__int		flags,
					param__params	data,
					xsd__int		timeout,
					struct klhst_SS_WriteResponse&r)
{
	void *funcPtr = KLSTRT::GetFunctionPtrByName(L"klhst_SS_Write");
	if ( funcPtr==NULL ) return SOAP_NO_METHOD;
	else return ((klhst_SS_WriteFuncDef)funcPtr)(soap,name,type,product,version,section,flags,data,timeout,r);
}

typedef int (* klhst_SS_CreateSectionFuncDef)( struct soap *soap, 
					xsd__wstring	name,
					xsd__wstring	type,
					xsd__wstring	product,
					xsd__wstring	version,
					xsd__wstring	section,
					xsd__int		timeout,
					struct klhst_SS_CreateSectionResponse&r);

int klhst_SS_CreateSection( struct soap *soap, 
					xsd__wstring	name,
					xsd__wstring	type,
					xsd__wstring	product,
					xsd__wstring	version,
					xsd__wstring	section,
					xsd__int		timeout,
					struct klhst_SS_CreateSectionResponse&r)
{
	void *funcPtr = KLSTRT::GetFunctionPtrByName(L"klhst_SS_CreateSection");
	if ( funcPtr==NULL ) return SOAP_NO_METHOD;
	else return ((klhst_SS_CreateSectionFuncDef)funcPtr)(soap,name,type,product,version,section,timeout,r);
}

typedef int (* klhst_SS_DeleteSectionFuncDef)( struct soap *soap, 
					xsd__wstring	name,
					xsd__wstring	type,
					xsd__wstring	product,
					xsd__wstring	version,
					xsd__wstring	section,
					xsd__int		timeout,
					struct klhst_SS_DeleteSectionResponse&r);

int klhst_SS_DeleteSection( struct soap *soap, 
					xsd__wstring	name,
					xsd__wstring	type,
					xsd__wstring	product,
					xsd__wstring	version,
					xsd__wstring	section,
					xsd__int		timeout,
					struct klhst_SS_DeleteSectionResponse&r)
{
	void *funcPtr = KLSTRT::GetFunctionPtrByName(L"klhst_SS_DeleteSection");
	if ( funcPtr==NULL ) return SOAP_NO_METHOD;
	else return ((klhst_SS_DeleteSectionFuncDef)funcPtr)(soap,name,type,product,version,section,timeout,r);
}

typedef int (* klhst_SS_GetNamesFuncDef)( struct soap *soap, 
					xsd__wstring	name,
					xsd__wstring	type,
					xsd__wstring	product,
					xsd__wstring	version,
					xsd__int		timeout,
					struct klhst_SS_GetNamesResponse&r);

int klhst_SS_GetNames( struct soap *soap, 
					xsd__wstring	name,
					xsd__wstring	type,
					xsd__wstring	product,
					xsd__wstring	version,
					xsd__int		timeout,
					struct klhst_SS_GetNamesResponse&r)
{
	void *funcPtr = KLSTRT::GetFunctionPtrByName(L"klhst_SS_GetNames");
	if ( funcPtr==NULL ) return SOAP_NO_METHOD;
	else return ((klhst_SS_GetNamesFuncDef)funcPtr)(soap,name,type,product,version,timeout,r);
}

typedef int (* klhst_CallGetRunTimeInfoFuncDef)( struct soap *soap, 
					xsd__wstring	name,
					param__params filter,
					struct klhst_CallGetRunTimeInfoResponse&r);

int klhst_CallGetRunTimeInfo( struct soap *soap, 
					xsd__wstring	name,
					param__params filter,
					struct klhst_CallGetRunTimeInfoResponse&r)
{
	void *funcPtr = KLSTRT::GetFunctionPtrByName(L"klhst_CallGetRunTimeInfo");
	if ( funcPtr==NULL ) return SOAP_NO_METHOD;
	else return ((klhst_CallGetRunTimeInfoFuncDef)funcPtr)(soap,name,filter,r);
}

typedef int (* klhst_CallGetStaticInfoFuncDef)( struct soap *soap, 
					xsd__wstring	name,
					param__params filter,
					struct klhst_CallGetStaticInfoResponse&r);

int klhst_CallGetStaticInfo( struct soap *soap, 
					xsd__wstring	name,
					param__params filter,
					struct klhst_CallGetStaticInfoResponse&r)
{
	void *funcPtr = KLSTRT::GetFunctionPtrByName(L"klhst_CallGetStaticInfo");
	if ( funcPtr==NULL ) return SOAP_NO_METHOD;
	else return ((klhst_CallGetStaticInfoFuncDef)funcPtr)(soap,name,filter,r);
}

typedef int (* klhst_CallGetStatisticsFuncDef)( struct soap *soap, 
					xsd__wstring	name,
					param__params filter,
					struct klhst_CallGetStatisticsResponse&r);

int klhst_CallGetStatistics( struct soap *soap, 
					xsd__wstring	name,
					param__params filter,
					struct klhst_CallGetStatisticsResponse&r)
{
	void *funcPtr = KLSTRT::GetFunctionPtrByName(L"klhst_CallGetStatistics");
	if ( funcPtr==NULL ) return SOAP_NO_METHOD;
	else return ((klhst_CallGetStatisticsFuncDef)funcPtr)(soap,name,filter,r);
}

typedef int (* klhst_CallGetInstancePortFuncDef)( struct soap *soap, 
					xsd__wstring	name,
					xsd__wstring	product,
					xsd__wstring	version,
					xsd__wstring	component,
					xsd__wstring	instance,
					struct klhst_CallGetInstancePortResponse&r);

int klhst_CallGetInstancePort( struct soap *soap, 
					xsd__wstring	name,
					xsd__wstring	product,
					xsd__wstring	version,
					xsd__wstring	component,
					xsd__wstring	instance,
					struct klhst_CallGetInstancePortResponse&r)
{
	void *funcPtr = KLSTRT::GetFunctionPtrByName(L"klhst_CallGetInstancePort");
	if ( funcPtr==NULL ) return SOAP_NO_METHOD;
	else return ((klhst_CallGetInstancePortFuncDef)funcPtr)(soap,name,product,version,component,instance,r);
}

typedef int (* klhst_NotifyTaskFuncDef)( struct soap *soap, 
                        xsd__wstring	name,
                        struct klhst_NotifyTaskResponse& r);

int klhst_NotifyTask( struct soap *soap, 
                        xsd__wstring	name,
                        struct klhst_NotifyTaskResponse& r)
{
	void *funcPtr = KLSTRT::GetFunctionPtrByName(L"klhst_NotifyTask");
	if ( funcPtr==NULL ) return SOAP_NO_METHOD;
	else return ((klhst_NotifyTaskFuncDef)funcPtr)(soap,name, r);
}

typedef int (* klupdt_GetUpdatesInfoFuncDef)( struct soap *soap, 
                    param__params filter,
					struct klupdt_GetUpdatesInfoResponse&r);

int klupdt_GetUpdatesInfo( struct soap *soap, 
                    param__params filter,
					struct klupdt_GetUpdatesInfoResponse&r)
{
	void *funcPtr = KLSTRT::GetFunctionPtrByName(L"klupdt_GetUpdatesInfo");
	if ( funcPtr==NULL ) return SOAP_NO_METHOD;
	else return ((klupdt_GetUpdatesInfoFuncDef)funcPtr)(soap,filter,r);
}

typedef int (* klupdt_SetBundleOptionsFuncDef)( struct soap *soap, 
                    param__params paramOptions,
					struct klupdt_SetBundleOptionsResponse&r);

int klupdt_SetBundleOptions( struct soap *soap, 
                    param__params paramOptions,
					struct klupdt_SetBundleOptionsResponse&r)
{
	void *funcPtr = KLSTRT::GetFunctionPtrByName(L"klupdt_SetBundleOptions");
	if ( funcPtr==NULL ) return SOAP_NO_METHOD;
	else return ((klupdt_SetBundleOptionsFuncDef)funcPtr)(soap,paramOptions,r);
}

typedef int (* klupdt_SetGeneralOptionsFuncDef)( struct soap *soap, 
                    param__params paramOptions,
					struct klupdt_SetGeneralOptionsResponse&r);

int klupdt_SetGeneralOptions( struct soap *soap, 
                    param__params paramOptions,
					struct klupdt_SetGeneralOptionsResponse&r)
{
	void *funcPtr = KLSTRT::GetFunctionPtrByName(L"klupdt_SetGeneralOptions");
	if ( funcPtr==NULL ) return SOAP_NO_METHOD;
	else return ((klupdt_SetGeneralOptionsFuncDef)funcPtr)(soap,paramOptions,r);
}

typedef int (* klupdt_GetGeneralOptionsFuncDef)( struct soap *soap, 
                    param__params data,
					struct klupdt_GetGeneralOptionsResponse&r);

int klupdt_GetGeneralOptions( struct soap *soap, 
                    param__params data,
					struct klupdt_GetGeneralOptionsResponse&r)
{
	void *funcPtr = KLSTRT::GetFunctionPtrByName(L"klupdt_GetGeneralOptions");
	if ( funcPtr==NULL ) return SOAP_NO_METHOD;
	else return ((klupdt_GetGeneralOptionsFuncDef)funcPtr)(soap,data,r);
}

typedef int (* klupdt_GetAvailableUpdatesInfoFuncDef)( struct soap *soap, 
					xsd__wstring wstrLocalization,
					struct klupdt_GetAvailableUpdatesInfoResponse&r);

int klupdt_GetAvailableUpdatesInfo( struct soap *soap, 
					xsd__wstring wstrLocalization,
					struct klupdt_GetAvailableUpdatesInfoResponse&r)
{
	void *funcPtr = KLSTRT::GetFunctionPtrByName(L"klupdt_GetAvailableUpdatesInfo");
	if ( funcPtr==NULL ) return SOAP_NO_METHOD;
	else return ((klupdt_GetAvailableUpdatesInfoFuncDef)funcPtr)(soap,wstrLocalization,r);
}

typedef int (* klupdt_GetRequiedUpdatesInfoFuncDef)( struct soap *soap, 
					int nDummy,
					struct klupdt_GetRequiedUpdatesInfoResponse&r);

int klupdt_GetRequiedUpdatesInfo( struct soap *soap, 
					int nDummy,
					struct klupdt_GetRequiedUpdatesInfoResponse&r)
{
	void *funcPtr = KLSTRT::GetFunctionPtrByName(L"klupdt_GetRequiedUpdatesInfo");
	if ( funcPtr==NULL ) return SOAP_NO_METHOD;
	else return ((klupdt_GetRequiedUpdatesInfoFuncDef)funcPtr)(soap,nDummy,r);
}

typedef int (* kllicsrv_GetKeysInfoFuncDef)( struct soap *soap, 
                    klhst_wstrings              fields,
                    xsd__wstring	            filter,
                    xsd__int                    lTimeout,
                    param__params	            options,
                    struct kllicsrv_GetKeysInfoResponse&r);

int kllicsrv_GetKeysInfo( struct soap *soap, 
                    klhst_wstrings              fields,
                    xsd__wstring	            filter,
                    xsd__int                    lTimeout,
                    param__params	            options,
                    struct kllicsrv_GetKeysInfoResponse&r)
{
	void *funcPtr = KLSTRT::GetFunctionPtrByName(L"kllicsrv_GetKeysInfo");
	if ( funcPtr==NULL ) return SOAP_NO_METHOD;
	else return ((kllicsrv_GetKeysInfoFuncDef)funcPtr)(soap,fields,filter,lTimeout,options,r);
}

typedef int (* kllicsrv_GetKeyInfoFuncDef)( struct soap *soap, 
                    klhst_wstrings          fields,
					klhst_field_order_array	fieldsToOrder,
                    xsd__wstring	        serial,
                    xsd__int                lTimeout,
                    struct kllicsrv_GetKeyInfoResponse&r);

int kllicsrv_GetKeyInfo( struct soap *soap, 
                    klhst_wstrings          fields,
					klhst_field_order_array	fieldsToOrder,
                    xsd__wstring	        serial,
                    xsd__int                lTimeout,
                    struct kllicsrv_GetKeyInfoResponse&r)
{
	void *funcPtr = KLSTRT::GetFunctionPtrByName(L"kllicsrv_GetKeyInfo");
	if ( funcPtr==NULL ) return SOAP_NO_METHOD;
	else return ((kllicsrv_GetKeyInfoFuncDef)funcPtr)(soap,fields,fieldsToOrder,serial,lTimeout,r);
}

typedef int (* kllicsrv_DeleteKeyInfoFuncDef)( struct soap *soap, 
                    xsd__wstring	        serial,
                    struct kllicsrv_DeleteKeyInfoResponse&r);

int kllicsrv_DeleteKeyInfo( struct soap *soap, 
                    xsd__wstring	        serial,
                    struct kllicsrv_DeleteKeyInfoResponse&r)
{
	void *funcPtr = KLSTRT::GetFunctionPtrByName(L"kllicsrv_DeleteKeyInfo");
	if ( funcPtr==NULL ) return SOAP_NO_METHOD;
	else return ((kllicsrv_DeleteKeyInfoFuncDef)funcPtr)(soap,serial,r);
}

typedef int (* kllicsrv_InstallKeyFuncDef)( struct soap *soap, 
                    param__params	        keyinfo,
                    struct kllicsrv_InstallKeyResponse&r);

int kllicsrv_InstallKey( struct soap *soap, 
                    param__params	        keyinfo,
                    struct kllicsrv_InstallKeyResponse&r)
{
	void *funcPtr = KLSTRT::GetFunctionPtrByName(L"kllicsrv_InstallKey");
	if ( funcPtr==NULL ) return SOAP_NO_METHOD;
	else return ((kllicsrv_InstallKeyFuncDef)funcPtr)(soap,keyinfo,r);
}

typedef int (* kllicsrv_UninstallKeyFuncDef)( struct soap *soap, 
                    param__params	        keyinfo,
                    struct kllicsrv_UninstallKeyResponse&r);

int kllicsrv_UninstallKey( struct soap *soap, 
                    param__params	        keyinfo,
                    struct kllicsrv_UninstallKeyResponse&r)
{
	void *funcPtr = KLSTRT::GetFunctionPtrByName(L"kllicsrv_UninstallKey");
	if ( funcPtr==NULL ) return SOAP_NO_METHOD;
	else return ((kllicsrv_UninstallKeyFuncDef)funcPtr)(soap,keyinfo,r);
}

typedef int (* kllicsrv_GetKeyDataFuncDef)( struct soap *soap, 
                    param__params	        indata,
                    struct kllicsrv_GetKeyDataResponse&r);

int kllicsrv_GetKeyData( struct soap *soap, 
                    param__params	        indata,
                    struct kllicsrv_GetKeyDataResponse&r)
{
	void *funcPtr = KLSTRT::GetFunctionPtrByName(L"kllicsrv_GetKeyData");
	if ( funcPtr==NULL ) return SOAP_NO_METHOD;
	else return ((kllicsrv_GetKeyDataFuncDef)funcPtr)(soap,indata,r);
}

typedef int (* kllicsrv_AdjustFlexibleKeyFuncDef)( struct soap *soap, 
                    param__params	        keyinfo,
                    struct kllicsrv_AdjustFlexibleKeyResponse&r);

int kllicsrv_AdjustFlexibleKey( struct soap *soap, 
                    param__params	        keyinfo,
                    struct kllicsrv_AdjustFlexibleKeyResponse&r)
{
	void *funcPtr = KLSTRT::GetFunctionPtrByName(L"kllicsrv_AdjustFlexibleKey");
	if ( funcPtr==NULL ) return SOAP_NO_METHOD;
	else return ((kllicsrv_AdjustFlexibleKeyFuncDef)funcPtr)(soap,keyinfo,r);
}

typedef int (* kllicsrv_EnumKeysFuncDef)( struct soap *soap, 
                    klhst_wstrings          fields,
					klhst_field_order_array	fieldsToOrder,
                    param__params	        options,
                    xsd__int                lTimeout,
                    struct kllicsrv_EnumKeysResponse&r);

int kllicsrv_EnumKeys( struct soap *soap, 
                    klhst_wstrings          fields,
					klhst_field_order_array	fieldsToOrder,
                    param__params	        options,
                    xsd__int                lTimeout,
                    struct kllicsrv_EnumKeysResponse&r)
{
	void *funcPtr = KLSTRT::GetFunctionPtrByName(L"kllicsrv_EnumKeys");
	if ( funcPtr==NULL ) return SOAP_NO_METHOD;
	else return ((kllicsrv_EnumKeysFuncDef)funcPtr)(soap,fields,fieldsToOrder,options,lTimeout,r);
}

typedef int (* klhst_MoveRulesAddRuleFuncDef)( struct soap *soap, 
                    param__params ruleinfo,
                    struct klhst_MoveRulesAddRuleResponse&r);

int klhst_MoveRulesAddRule( struct soap *soap, 
                    param__params ruleinfo,
                    struct klhst_MoveRulesAddRuleResponse&r)
{
	void *funcPtr = KLSTRT::GetFunctionPtrByName(L"klhst_MoveRulesAddRule");
	if ( funcPtr==NULL ) return SOAP_NO_METHOD;
	else return ((klhst_MoveRulesAddRuleFuncDef)funcPtr)(soap,ruleinfo,r);
}

typedef int (* klhst_MoveRulesUpdateRuleFuncDef)( struct soap *soap, 
                    xsd__int            nRule,
                    param__params       ruleinfo,
                    struct klhst_MoveRulesUpdateRuleResponse&r);

int klhst_MoveRulesUpdateRule( struct soap *soap, 
                    xsd__int            nRule,
                    param__params       ruleinfo,
                    struct klhst_MoveRulesUpdateRuleResponse&r)
{
	void *funcPtr = KLSTRT::GetFunctionPtrByName(L"klhst_MoveRulesUpdateRule");
	if ( funcPtr==NULL ) return SOAP_NO_METHOD;
	else return ((klhst_MoveRulesUpdateRuleFuncDef)funcPtr)(soap,nRule,ruleinfo,r);
}

typedef int (* klhst_MoveRulesDeleteRuleFuncDef)( struct soap *soap, 
                    xsd__int    nRule,
                    struct klhst_MoveRulesDeleteRuleResponse&r);

int klhst_MoveRulesDeleteRule( struct soap *soap, 
                    xsd__int    nRule,
                    struct klhst_MoveRulesDeleteRuleResponse&r)
{
	void *funcPtr = KLSTRT::GetFunctionPtrByName(L"klhst_MoveRulesDeleteRule");
	if ( funcPtr==NULL ) return SOAP_NO_METHOD;
	else return ((klhst_MoveRulesDeleteRuleFuncDef)funcPtr)(soap,nRule,r);
}

typedef int (* klhst_MoveRulesSetRulesOrderFuncDef)( struct soap *soap, 
                    klhst_rule_order_array  arr,
                    struct klhst_MoveRulesSetRulesOrderResponse&r);

int klhst_MoveRulesSetRulesOrder( struct soap *soap, 
                    klhst_rule_order_array  arr,
                    struct klhst_MoveRulesSetRulesOrderResponse&r)
{
	void *funcPtr = KLSTRT::GetFunctionPtrByName(L"klhst_MoveRulesSetRulesOrder");
	if ( funcPtr==NULL ) return SOAP_NO_METHOD;
	else return ((klhst_MoveRulesSetRulesOrderFuncDef)funcPtr)(soap,arr,r);
}

typedef int (* klhst_MoveRulesGetRuleFuncDef)( struct soap *soap, 
                    xsd__int    nRule,
                    struct klhst_MoveRulesGetRuleResponse&r);

int klhst_MoveRulesGetRule( struct soap *soap, 
                    xsd__int    nRule,
                    struct klhst_MoveRulesGetRuleResponse&r)
{
	void *funcPtr = KLSTRT::GetFunctionPtrByName(L"klhst_MoveRulesGetRule");
	if ( funcPtr==NULL ) return SOAP_NO_METHOD;
	else return ((klhst_MoveRulesGetRuleFuncDef)funcPtr)(soap,nRule,r);
}

typedef int (* klhst_MoveRulesGetRulesFuncDef)( struct soap *soap, 
                    klhst_wstrings  fields,
                    struct klhst_MoveRulesGetRulesResponse&r);

int klhst_MoveRulesGetRules( struct soap *soap, 
                    klhst_wstrings  fields,
                    struct klhst_MoveRulesGetRulesResponse&r)
{
	void *funcPtr = KLSTRT::GetFunctionPtrByName(L"klhst_MoveRulesGetRules");
	if ( funcPtr==NULL ) return SOAP_NO_METHOD;
	else return ((klhst_MoveRulesGetRulesFuncDef)funcPtr)(soap,fields,r);
}

typedef int (* kldpns_AddDiapasonFuncDef)( struct soap *soap, 
                    param__params data,
                    struct kldpns_AddDiapasonResponse&r);

int kldpns_AddDiapason( struct soap *soap, 
                    param__params data,
                    struct kldpns_AddDiapasonResponse&r)
{
	void *funcPtr = KLSTRT::GetFunctionPtrByName(L"kldpns_AddDiapason");
	if ( funcPtr==NULL ) return SOAP_NO_METHOD;
	else return ((kldpns_AddDiapasonFuncDef)funcPtr)(soap,data,r);
}

typedef int (* kldpns_UpdateDiapasonFuncDef)( struct soap *soap, 
                    xsd__int        id,
                    param__params data,
                    struct kldpns_UpdateDiapasonResponse&r);

int kldpns_UpdateDiapason( struct soap *soap, 
                    xsd__int        id,
                    param__params data,
                    struct kldpns_UpdateDiapasonResponse&r)
{
	void *funcPtr = KLSTRT::GetFunctionPtrByName(L"kldpns_UpdateDiapason");
	if ( funcPtr==NULL ) return SOAP_NO_METHOD;
	else return ((kldpns_UpdateDiapasonFuncDef)funcPtr)(soap,id,data,r);
}

typedef int (* kldpns_RemoveDiapasonFuncDef)( struct soap *soap, 
                    xsd__int        id,
                    struct kldpns_RemoveDiapasonResponse&r);

int kldpns_RemoveDiapason( struct soap *soap, 
                    xsd__int        id,
                    struct kldpns_RemoveDiapasonResponse&r)
{
	void *funcPtr = KLSTRT::GetFunctionPtrByName(L"kldpns_RemoveDiapason");
	if ( funcPtr==NULL ) return SOAP_NO_METHOD;
	else return ((kldpns_RemoveDiapasonFuncDef)funcPtr)(soap,id,r);
}

typedef int (* kldpns_GetDiapasonsFuncDef)( struct soap *soap, 
                    klhst_wstrings	fields,
                    xsd__int        lTimeout,
					struct kldpns_GetDiapasonsResponse&r);

int kldpns_GetDiapasons( struct soap *soap, 
                    klhst_wstrings	fields,
                    xsd__int        lTimeout,
					struct kldpns_GetDiapasonsResponse&r)
{
	void *funcPtr = KLSTRT::GetFunctionPtrByName(L"kldpns_GetDiapasons");
	if ( funcPtr==NULL ) return SOAP_NO_METHOD;
	else return ((kldpns_GetDiapasonsFuncDef)funcPtr)(soap,fields,lTimeout,r);
}

typedef int (* kldpns_GetDiapasonFuncDef)( struct soap *soap, 
                    xsd__int        id,
                    klhst_wstrings	fields,
					struct kldpns_GetDiapasonResponse&r);

int kldpns_GetDiapason( struct soap *soap, 
                    xsd__int        id,
                    klhst_wstrings	fields,
					struct kldpns_GetDiapasonResponse&r)
{
	void *funcPtr = KLSTRT::GetFunctionPtrByName(L"kldpns_GetDiapason");
	if ( funcPtr==NULL ) return SOAP_NO_METHOD;
	else return ((kldpns_GetDiapasonFuncDef)funcPtr)(soap,id,fields,r);
}

typedef int (* kldpns_NotifyDpnsTaskFuncDef)( struct soap *soap, 
					struct kldpns_NotifyDpnsTaskResponse&r);

int kldpns_NotifyDpnsTask( struct soap *soap, 
					struct kldpns_NotifyDpnsTaskResponse&r)
{
	void *funcPtr = KLSTRT::GetFunctionPtrByName(L"kldpns_NotifyDpnsTask");
	if ( funcPtr==NULL ) return SOAP_NO_METHOD;
	else return ((kldpns_NotifyDpnsTaskFuncDef)funcPtr)(soap,r);
}

typedef int (* klgrp_GetGroupsFuncDef)( struct soap *soap, 
					xsd__int	parent,
					xsd__int	depth, 
					struct klgrp_GetGroupsResponse&r);

int klgrp_GetGroups( struct soap *soap, 
					xsd__int	parent,
					xsd__int	depth, 
					struct klgrp_GetGroupsResponse&r)
{
	void *funcPtr = KLSTRT::GetFunctionPtrByName(L"klgrp_GetGroups");
	if ( funcPtr==NULL ) return SOAP_NO_METHOD;
	else return ((klgrp_GetGroupsFuncDef)funcPtr)(soap,parent,depth,r);
}

typedef int (* klgrp_GetUnassignedGroupIdFuncDef)( struct soap *soap, 
					void* _,
					struct klgrp_GetUnassignedGroupIdResponse&r);

int klgrp_GetUnassignedGroupId( struct soap *soap, 
					void* _,
					struct klgrp_GetUnassignedGroupIdResponse&r)
{
	void *funcPtr = KLSTRT::GetFunctionPtrByName(L"klgrp_GetUnassignedGroupId");
	if ( funcPtr==NULL ) return SOAP_NO_METHOD;
	else return ((klgrp_GetUnassignedGroupIdFuncDef)funcPtr)(soap, _,r);
}

typedef int (* klgrp_GetGroupInfoFuncDef)( struct soap *soap, 
					xsd__int			id,
                    param__params		info,
					struct klgrp_GetGroupInfoResponse&r);

int klgrp_GetGroupInfo( struct soap *soap, 
					xsd__int			id,
                    param__params		info,
					struct klgrp_GetGroupInfoResponse&r)
{
	void *funcPtr = KLSTRT::GetFunctionPtrByName(L"klgrp_GetGroupInfo");
	if ( funcPtr==NULL ) return SOAP_NO_METHOD;
	else return ((klgrp_GetGroupInfoFuncDef)funcPtr)(soap,id,info,r);
}

typedef int (* klgrp_AddGroupFuncDef)( struct soap *soap, 
					param__params		info,
					struct klgrp_AddGroupResponse&r);

int klgrp_AddGroup( struct soap *soap, 
					param__params		info,
					struct klgrp_AddGroupResponse&r)
{
	void *funcPtr = KLSTRT::GetFunctionPtrByName(L"klgrp_AddGroup");
	if ( funcPtr==NULL ) return SOAP_NO_METHOD;
	else return ((klgrp_AddGroupFuncDef)funcPtr)(soap,info,r);
}

typedef int (* klgrp_DelGroupFuncDef)( struct soap *soap, 
					xsd__int id,
					struct klgrp_DelGroupResponse&r);

int klgrp_DelGroup( struct soap *soap, 
					xsd__int id,
					struct klgrp_DelGroupResponse&r)
{
	void *funcPtr = KLSTRT::GetFunctionPtrByName(L"klgrp_DelGroup");
	if ( funcPtr==NULL ) return SOAP_NO_METHOD;
	else return ((klgrp_DelGroupFuncDef)funcPtr)(soap,id,r);
}

typedef int (* klgrp_UpdateGroupFuncDef)( struct soap *soap, 
					xsd__int			id,
					param__params		info,
					struct klgrp_UpdateGroupResponse&r);

int klgrp_UpdateGroup( struct soap *soap, 
					xsd__int			id,
					param__params		info,
					struct klgrp_UpdateGroupResponse&r)
{
	void *funcPtr = KLSTRT::GetFunctionPtrByName(L"klgrp_UpdateGroup");
	if ( funcPtr==NULL ) return SOAP_NO_METHOD;
	else return ((klgrp_UpdateGroupFuncDef)funcPtr)(soap,id,info,r);
}

typedef int (* klgrp_SetGroupHostsFuncDef)( struct soap *soap, 
					xsd__int			id,
					param__params		hosts,
					struct klgrp_SetGroupHostsResponse&r);

int klgrp_SetGroupHosts( struct soap *soap, 
					xsd__int			id,
					param__params		hosts,
					struct klgrp_SetGroupHostsResponse&r)
{
	void *funcPtr = KLSTRT::GetFunctionPtrByName(L"klgrp_SetGroupHosts");
	if ( funcPtr==NULL ) return SOAP_NO_METHOD;
	else return ((klgrp_SetGroupHostsFuncDef)funcPtr)(soap,id,hosts,r);
}

typedef int (* klgrp_RemoveHostsFuncDef)( struct soap *soap, 
    				klgrp_wstrings	hosts,
					struct klgrp_RemoveHostsResponse&r);

int klgrp_RemoveHosts( struct soap *soap, 
    				klgrp_wstrings	hosts,
					struct klgrp_RemoveHostsResponse&r)
{
	void *funcPtr = KLSTRT::GetFunctionPtrByName(L"klgrp_RemoveHosts");
	if ( funcPtr==NULL ) return SOAP_NO_METHOD;
	else return ((klgrp_RemoveHostsFuncDef)funcPtr)(soap,hosts,r);
}

typedef int (* klgrp_ResetGroupHostsIteratorFuncDef)( struct soap *soap, 
					xsd__int			id,
					klgrp_wstrings		fields,
					xsd__int			lifetime,
					struct klgrp_ResetGroupHostsIteratorResponse&r);

int klgrp_ResetGroupHostsIterator( struct soap *soap, 
					xsd__int			id,
					klgrp_wstrings		fields,
					xsd__int			lifetime,
					struct klgrp_ResetGroupHostsIteratorResponse&r)
{
	void *funcPtr = KLSTRT::GetFunctionPtrByName(L"klgrp_ResetGroupHostsIterator");
	if ( funcPtr==NULL ) return SOAP_NO_METHOD;
	else return ((klgrp_ResetGroupHostsIteratorFuncDef)funcPtr)(soap,id,fields,lifetime,r);
}

typedef int (* klgrp_ReleaseGroupHostsIteratorFuncDef)( struct soap *soap, 
					xsd__wstring		it,
					struct klgrp_ReleaseGroupHostsIteratorResponse&r);

int klgrp_ReleaseGroupHostsIterator( struct soap *soap, 
					xsd__wstring		it,
					struct klgrp_ReleaseGroupHostsIteratorResponse&r)
{
	void *funcPtr = KLSTRT::GetFunctionPtrByName(L"klgrp_ReleaseGroupHostsIterator");
	if ( funcPtr==NULL ) return SOAP_NO_METHOD;
	else return ((klgrp_ReleaseGroupHostsIteratorFuncDef)funcPtr)(soap,it,r);
}

typedef int (* klgrp_GetNextGroupHostFuncDef)( struct soap *soap, 
					xsd__wstring	it,
					xsd__int		nCount,
					struct klgrp_GetNextGroupHostResponse&r);

int klgrp_GetNextGroupHost( struct soap *soap, 
					xsd__wstring	it,
					xsd__int		nCount,
					struct klgrp_GetNextGroupHostResponse&r)
{
	void *funcPtr = KLSTRT::GetFunctionPtrByName(L"klgrp_GetNextGroupHost");
	if ( funcPtr==NULL ) return SOAP_NO_METHOD;
	else return ((klgrp_GetNextGroupHostFuncDef)funcPtr)(soap,it,nCount,r);
}

typedef int (* klgrp_FindHostsFuncDef)( struct soap *soap, 
                    xsd__wstring	            wstrFilter,
					klgrp_wstrings	            arrFields,
					klgrp_field_order_array     arrFieldsToOrder,
					param__params				params,
					xsd__int		            lTimeout,
                    xsd__wstring	            wstrRequestId,
					struct klgrp_FindHostsResponse& r);

int klgrp_FindHosts( struct soap *soap, 
                    xsd__wstring	            wstrFilter,
					klgrp_wstrings	            arrFields,
					klgrp_field_order_array     arrFieldsToOrder,
					param__params				params,
					xsd__int		            lTimeout,
                    xsd__wstring	            wstrRequestId,
					struct klgrp_FindHostsResponse& r)
{
	void *funcPtr = KLSTRT::GetFunctionPtrByName(L"klgrp_FindHosts");
	if ( funcPtr==NULL ) return SOAP_NO_METHOD;
	else return ((klgrp_FindHostsFuncDef)funcPtr)(soap,wstrFilter,arrFields,arrFieldsToOrder,params,lTimeout,wstrRequestId, r);
}

typedef int (* klgrp_FindHostsCancelFuncDef)( struct soap *soap, 
					xsd__wstring	wstrRequestId,
					struct klgrp_FindHostsCancelResponse&r );

int klgrp_FindHostsCancel( struct soap *soap, 
					xsd__wstring	wstrRequestId,
					struct klgrp_FindHostsCancelResponse&r )
{
	void *funcPtr = KLSTRT::GetFunctionPtrByName(L"klgrp_FindHostsCancel");
	if ( funcPtr==NULL ) return SOAP_NO_METHOD;
	else return ((klgrp_FindHostsCancelFuncDef)funcPtr)(soap,wstrRequestId,r);
}

typedef int (* klgrp_FindHostsGetAccessorFuncDef)( struct soap *soap, 
					xsd__wstring	wstrRequestId,
					struct klgrp_FindHostsGetAccessorResponse&r );

int klgrp_FindHostsGetAccessor( struct soap *soap, 
					xsd__wstring	wstrRequestId,
					struct klgrp_FindHostsGetAccessorResponse&r )
{
	void *funcPtr = KLSTRT::GetFunctionPtrByName(L"klgrp_FindHostsGetAccessor");
	if ( funcPtr==NULL ) return SOAP_NO_METHOD;
	else return ((klgrp_FindHostsGetAccessorFuncDef)funcPtr)(soap,wstrRequestId,r);
}

typedef int (* klgrp_GetSuperGroupIdFuncDef)( struct soap *soap, 
					void* _,
					struct klgrp_GetSuperGroupIdResponse&r);

int klgrp_GetSuperGroupId( struct soap *soap, 
					void* _,
					struct klgrp_GetSuperGroupIdResponse&r)
{
	void *funcPtr = KLSTRT::GetFunctionPtrByName(L"klgrp_GetSuperGroupId");
	if ( funcPtr==NULL ) return SOAP_NO_METHOD;
	else return ((klgrp_GetSuperGroupIdFuncDef)funcPtr)(soap, _,r);
}

typedef int (* klgrp_FindGroupsFuncDef)( struct soap *soap, 
                    xsd__wstring	            wstrFilter,
					klgrp_wstrings	            arrFields,
					klgrp_field_order_array     arrFieldsToOrder,
					param__params				params,
					xsd__int		            lTimeout,
                    xsd__wstring	            wstrRequestId,
					struct klgrp_FindGroupsResponse& r);

int klgrp_FindGroups( struct soap *soap, 
                    xsd__wstring	            wstrFilter,
					klgrp_wstrings	            arrFields,
					klgrp_field_order_array     arrFieldsToOrder,
					param__params				params,
					xsd__int		            lTimeout,
                    xsd__wstring	            wstrRequestId,
					struct klgrp_FindGroupsResponse& r)
{
	void *funcPtr = KLSTRT::GetFunctionPtrByName(L"klgrp_FindGroups");
	if ( funcPtr==NULL ) return SOAP_NO_METHOD;
	else return ((klgrp_FindGroupsFuncDef)funcPtr)(soap,wstrFilter,arrFields,arrFieldsToOrder,params,lTimeout,wstrRequestId, r);
}

typedef int (* klpol_GetPolicyCommonDataFuncDef)( struct soap *soap, 
    xsd__int nGroupId,
    xsd__int nExpectedServerVersion,
	struct klpol_GetPolicyCommonDataResponse&r );

int klpol_GetPolicyCommonData( struct soap *soap, 
    xsd__int nGroupId,
    xsd__int nExpectedServerVersion,
	struct klpol_GetPolicyCommonDataResponse&r )
{
	void *funcPtr = KLSTRT::GetFunctionPtrByName(L"klpol_GetPolicyCommonData");
	if ( funcPtr==NULL ) return SOAP_NO_METHOD;
	else return ((klpol_GetPolicyCommonDataFuncDef)funcPtr)(soap,nGroupId,nExpectedServerVersion,r);
}

typedef int (* klpol_GetAllAcivePoliciesForGroupFuncDef)( struct soap *soap, 
    xsd__int nGroupId,
	struct klpol_GetAllAcivePoliciesForGroupResponse&r );

int klpol_GetAllAcivePoliciesForGroup( struct soap *soap, 
    xsd__int nGroupId,
	struct klpol_GetAllAcivePoliciesForGroupResponse&r )
{
	void *funcPtr = KLSTRT::GetFunctionPtrByName(L"klpol_GetAllAcivePoliciesForGroup");
	if ( funcPtr==NULL ) return SOAP_NO_METHOD;
	else return ((klpol_GetAllAcivePoliciesForGroupFuncDef)funcPtr)(soap,nGroupId,r);
}

typedef int (* klpol_GetSinglePolicyCommonDataFuncDef)( struct soap *soap, 
    xsd__int policyId,
	struct klpol_GetSinglePolicyCommonDataResponse&r );

int klpol_GetSinglePolicyCommonData( struct soap *soap, 
    xsd__int policyId,
	struct klpol_GetSinglePolicyCommonDataResponse&r )
{
	void *funcPtr = KLSTRT::GetFunctionPtrByName(L"klpol_GetSinglePolicyCommonData");
	if ( funcPtr==NULL ) return SOAP_NO_METHOD;
	else return ((klpol_GetSinglePolicyCommonDataFuncDef)funcPtr)(soap,policyId,r);
}

typedef int (* klpol_AddPolicyFuncDef)( struct soap *soap, 
    xsd__int nGroupId,
    struct  klpol_policy_common_data    policy,
	struct klpol_AddPolicyResponse&r );

int klpol_AddPolicy( struct soap *soap, 
    xsd__int nGroupId,
    struct  klpol_policy_common_data    policy,
	struct klpol_AddPolicyResponse&r )
{
	void *funcPtr = KLSTRT::GetFunctionPtrByName(L"klpol_AddPolicy");
	if ( funcPtr==NULL ) return SOAP_NO_METHOD;
	else return ((klpol_AddPolicyFuncDef)funcPtr)(soap,nGroupId,policy,r);
}

typedef int (* klpol_UpdatePolicyCommonDataFuncDef)( struct soap *soap, 
    struct  klpol_policy_common_data    policy,
	struct klpol_UpdatePolicyCommonDataResponse&r );

int klpol_UpdatePolicyCommonData( struct soap *soap, 
    struct  klpol_policy_common_data    policy,
	struct klpol_UpdatePolicyCommonDataResponse&r )
{
	void *funcPtr = KLSTRT::GetFunctionPtrByName(L"klpol_UpdatePolicyCommonData");
	if ( funcPtr==NULL ) return SOAP_NO_METHOD;
	else return ((klpol_UpdatePolicyCommonDataFuncDef)funcPtr)(soap,policy,r);
}

typedef int (* klpol_DeletePolicyFuncDef)( struct soap *soap, 
    xsd__int policyId,
	struct klpol_DeletePolicyResponse&r );

int klpol_DeletePolicy( struct soap *soap, 
    xsd__int policyId,
	struct klpol_DeletePolicyResponse&r )
{
	void *funcPtr = KLSTRT::GetFunctionPtrByName(L"klpol_DeletePolicy");
	if ( funcPtr==NULL ) return SOAP_NO_METHOD;
	else return ((klpol_DeletePolicyFuncDef)funcPtr)(soap,policyId,r);
}

typedef int (* klpol_CopyPolicyExFuncDef)( struct soap *soap, 
    xsd__int        policyId,
    xsd__int        nNewGroupId,
    xsd__boolean    bDeleteOrigin,
	struct klpol_CopyPolicyExResponse&r );

int klpol_CopyPolicyEx( struct soap *soap, 
    xsd__int        policyId,
    xsd__int        nNewGroupId,
    xsd__boolean    bDeleteOrigin,
	struct klpol_CopyPolicyExResponse&r )
{
	void *funcPtr = KLSTRT::GetFunctionPtrByName(L"klpol_CopyPolicyEx");
	if ( funcPtr==NULL ) return SOAP_NO_METHOD;
	else return ((klpol_CopyPolicyExFuncDef)funcPtr)(soap,policyId,nNewGroupId,bDeleteOrigin,r);
}

typedef int (* klpol_GetSSProxyIDFuncDef)( struct soap *soap, 
    xsd__int policyId,
    xsd__int nTimeout,
	struct klpol_GetSSProxyIDResponse&r );

int klpol_GetSSProxyID( struct soap *soap, 
    xsd__int policyId,
    xsd__int nTimeout,
	struct klpol_GetSSProxyIDResponse&r )
{
	void *funcPtr = KLSTRT::GetFunctionPtrByName(L"klpol_GetSSProxyID");
	if ( funcPtr==NULL ) return SOAP_NO_METHOD;
	else return ((klpol_GetSSProxyIDFuncDef)funcPtr)(soap,policyId,nTimeout,r);
}

typedef int (* klpol_ModifySettingsFuncDef)( struct soap *soap, 
        xsd__int policyId,
        struct klpol_ModifySettingsResponse&r );

int klpol_ModifySettings( struct soap *soap, 
        xsd__int policyId,
        struct klpol_ModifySettingsResponse&r )
{
	void *funcPtr = KLSTRT::GetFunctionPtrByName(L"klpol_ModifySettings");
	if ( funcPtr==NULL ) return SOAP_NO_METHOD;
	else return ((klpol_ModifySettingsFuncDef)funcPtr)(soap,policyId,r);
}

typedef int (* klpol_MakePolicyActiveFuncDef)( struct soap *soap, 
        xsd__int policyId,
        xsd__boolean bActive,
        struct klpol_MakePolicyActiveResponse&r );

int klpol_MakePolicyActive( struct soap *soap, 
        xsd__int policyId,
        xsd__boolean bActive,
        struct klpol_MakePolicyActiveResponse&r )
{
	void *funcPtr = KLSTRT::GetFunctionPtrByName(L"klpol_MakePolicyActive");
	if ( funcPtr==NULL ) return SOAP_NO_METHOD;
	else return ((klpol_MakePolicyActiveFuncDef)funcPtr)(soap,policyId,bActive,r);
}

typedef int (* klpol_MakePolicyRoamingFuncDef)( struct soap *soap, 
        xsd__int policyId,
        struct klpol_MakePolicyRoamingResponse&r );

int klpol_MakePolicyRoaming( struct soap *soap, 
        xsd__int policyId,
        struct klpol_MakePolicyRoamingResponse&r )
{
	void *funcPtr = KLSTRT::GetFunctionPtrByName(L"klpol_MakePolicyRoaming");
	if ( funcPtr==NULL ) return SOAP_NO_METHOD;
	else return ((klpol_MakePolicyRoamingFuncDef)funcPtr)(soap,policyId,r);
}

typedef int (* klpol_GetPoliciesForGroupFuncDef)( struct soap *soap,  
    xsd__int nGroupId,
    xsd__int nExpectedServerVersion,
	struct klpol_GetPoliciesForGroupResponse&r );

int klpol_GetPoliciesForGroup( struct soap *soap,  
    xsd__int nGroupId,
    xsd__int nExpectedServerVersion,
	struct klpol_GetPoliciesForGroupResponse&r )
{
	void *funcPtr = KLSTRT::GetFunctionPtrByName(L"klpol_GetPoliciesForGroup");
	if ( funcPtr==NULL ) return SOAP_NO_METHOD;
	else return ((klpol_GetPoliciesForGroupFuncDef)funcPtr)(soap,nGroupId,nExpectedServerVersion,r);
}

typedef int (* klpol_CopyOrMovePolicyFuncDef)( struct soap *soap, 
    xsd__int                            policyId,
    xsd__int                            nNewGroupId,
    xsd__boolean                        bDeleteOrigin,
    struct  klpol_policy_common_data    data,
	struct klpol_CopyOrMovePolicyResponse&r );

int klpol_CopyOrMovePolicy( struct soap *soap, 
    xsd__int                            policyId,
    xsd__int                            nNewGroupId,
    xsd__boolean                        bDeleteOrigin,
    struct  klpol_policy_common_data    data,
	struct klpol_CopyOrMovePolicyResponse&r )
{
	void *funcPtr = KLSTRT::GetFunctionPtrByName(L"klpol_CopyOrMovePolicy");
	if ( funcPtr==NULL ) return SOAP_NO_METHOD;
	else return ((klpol_CopyOrMovePolicyFuncDef)funcPtr)(soap,policyId,nNewGroupId,bDeleteOrigin,data,r);
}

typedef int (* klpol_SetOutbreakPolicyFuncDef)( struct soap *soap, 
    klpol_polici_ids    vec_policies,
	struct klpol_SetOutbreakPolicyResponse&r );

int klpol_SetOutbreakPolicy( struct soap *soap, 
    klpol_polici_ids    vec_policies,
	struct klpol_SetOutbreakPolicyResponse&r )
{
	void *funcPtr = KLSTRT::GetFunctionPtrByName(L"klpol_SetOutbreakPolicy");
	if ( funcPtr==NULL ) return SOAP_NO_METHOD;
	else return ((klpol_SetOutbreakPolicyFuncDef)funcPtr)(soap,vec_policies,r);
}

typedef int (* klpol_GetOutbreakPolicyFuncDef)( struct soap *soap, 
	struct klpol_GetOutbreakPolicyResponse&r );

int klpol_GetOutbreakPolicy( struct soap *soap, 
	struct klpol_GetOutbreakPolicyResponse&r )
{
	void *funcPtr = KLSTRT::GetFunctionPtrByName(L"klpol_GetOutbreakPolicy");
	if ( funcPtr==NULL ) return SOAP_NO_METHOD;
	else return ((klpol_GetOutbreakPolicyFuncDef)funcPtr)(soap,r);
}

typedef int (* klpol_SetOutbreakPolicy2FuncDef)( struct soap *soap, 
    param__params           data,
	struct klpol_SetOutbreakPolicy2Response&r );

int klpol_SetOutbreakPolicy2( struct soap *soap, 
    param__params           data,
	struct klpol_SetOutbreakPolicy2Response&r )
{
	void *funcPtr = KLSTRT::GetFunctionPtrByName(L"klpol_SetOutbreakPolicy2");
	if ( funcPtr==NULL ) return SOAP_NO_METHOD;
	else return ((klpol_SetOutbreakPolicy2FuncDef)funcPtr)(soap,data,r);
}

typedef int (* klpol_GetOutbreakPolicy2FuncDef)( struct soap *soap, 
	struct klpol_GetOutbreakPolicy2Response&r );

int klpol_GetOutbreakPolicy2( struct soap *soap, 
	struct klpol_GetOutbreakPolicy2Response&r )
{
	void *funcPtr = KLSTRT::GetFunctionPtrByName(L"klpol_GetOutbreakPolicy2");
	if ( funcPtr==NULL ) return SOAP_NO_METHOD;
	else return ((klpol_GetOutbreakPolicy2FuncDef)funcPtr)(soap,r);
}

typedef int (* klprssp_SS_ReadFuncDef)( struct soap *soap, 
    xsd__wstring	storage_descr,
    xsd__wstring	name,
    xsd__wstring	version,
    xsd__wstring	section,
    struct klprssp_SS_ReadResponse&r );

int klprssp_SS_Read( struct soap *soap, 
    xsd__wstring	storage_descr,
    xsd__wstring	name,
    xsd__wstring	version,
    xsd__wstring	section,
    struct klprssp_SS_ReadResponse&r )
{
	void *funcPtr = KLSTRT::GetFunctionPtrByName(L"klprssp_SS_Read");
	if ( funcPtr==NULL ) return SOAP_NO_METHOD;
	else return ((klprssp_SS_ReadFuncDef)funcPtr)(soap,storage_descr,name,version,section,r);
}

typedef int (* klprssp_SS_WriteFuncDef)( struct soap *soap, 
					xsd__wstring	storage_descr,
					xsd__wstring	name,
					xsd__wstring	version,
					xsd__wstring	section,
					param__params	data,
					xsd__int		operation_type,  
					struct klprssp_SS_WriteResponse&r);

int klprssp_SS_Write( struct soap *soap, 
					xsd__wstring	storage_descr,
					xsd__wstring	name,
					xsd__wstring	version,
					xsd__wstring	section,
					param__params	data,
					xsd__int		operation_type,  
					struct klprssp_SS_WriteResponse&r)
{
	void *funcPtr = KLSTRT::GetFunctionPtrByName(L"klprssp_SS_Write");
	if ( funcPtr==NULL ) return SOAP_NO_METHOD;
	else return ((klprssp_SS_WriteFuncDef)funcPtr)(soap,storage_descr,name,version,section,data,operation_type,r);
}

typedef int (* klprssp_SS_SectionOperationFuncDef)( struct soap *soap, 
					xsd__wstring	storage_descr,
					xsd__wstring	name,
					xsd__wstring	version,
					xsd__wstring	section,
					xsd__int		operation_type,
					struct klprssp_SS_SectionOperationResponse&r);

int klprssp_SS_SectionOperation( struct soap *soap, 
					xsd__wstring	storage_descr,
					xsd__wstring	name,
					xsd__wstring	version,
					xsd__wstring	section,
					xsd__int		operation_type,
					struct klprssp_SS_SectionOperationResponse&r)
{
	void *funcPtr = KLSTRT::GetFunctionPtrByName(L"klprssp_SS_SectionOperation");
	if ( funcPtr==NULL ) return SOAP_NO_METHOD;
	else return ((klprssp_SS_SectionOperationFuncDef)funcPtr)(soap,storage_descr,name,version,section,operation_type,r);
}

typedef int (* klprssp_SS_GetNamesFuncDef)( struct soap *soap, 
					xsd__wstring	storage_descr,
					xsd__wstring	name,
					xsd__wstring	version,
					struct klprssp_SS_GetNamesResponse&r);

int klprssp_SS_GetNames( struct soap *soap, 
					xsd__wstring	storage_descr,
					xsd__wstring	name,
					xsd__wstring	version,
					struct klprssp_SS_GetNamesResponse&r)
{
	void *funcPtr = KLSTRT::GetFunctionPtrByName(L"klprssp_SS_GetNames");
	if ( funcPtr==NULL ) return SOAP_NO_METHOD;
	else return ((klprssp_SS_GetNamesFuncDef)funcPtr)(soap,storage_descr,name,version,r);
}

typedef int (* klprssp_SS_ApplyChangesFuncDef)( struct soap *soap, 
					xsd__wstring	storage_descr,
					struct klprssp_SS_ApplyChangesResponse&r);

int klprssp_SS_ApplyChanges( struct soap *soap, 
					xsd__wstring	storage_descr,
					struct klprssp_SS_ApplyChangesResponse&r)
{
	void *funcPtr = KLSTRT::GetFunctionPtrByName(L"klprssp_SS_ApplyChanges");
	if ( funcPtr==NULL ) return SOAP_NO_METHOD;
	else return ((klprssp_SS_ApplyChangesFuncDef)funcPtr)(soap,storage_descr,r);
}

typedef int (* klprssp_ReleaseSSFuncDef)( struct soap *soap, 
                    xsd__wstring    storage_descr,
                    struct klprssp_ReleaseSSResponse&r );

int klprssp_ReleaseSS( struct soap *soap, 
                    xsd__wstring    storage_descr,
                    struct klprssp_ReleaseSSResponse&r )
{
	void *funcPtr = KLSTRT::GetFunctionPtrByName(L"klprssp_ReleaseSS");
	if ( funcPtr==NULL ) return SOAP_NO_METHOD;
	else return ((klprssp_ReleaseSSFuncDef)funcPtr)(soap,storage_descr,r);
}

typedef int (* adhst_GetChildComputersFuncDef)( struct soap *soap, 
                    xsd__int                    idOU, 
                    klhst_wstrings              fields,
                    xsd__int                    lTimeout,
                    struct adhst_GetChildComputersResponse&r);

int adhst_GetChildComputers( struct soap *soap, 
                    xsd__int                    idOU, 
                    klhst_wstrings              fields,
                    xsd__int                    lTimeout,
                    struct adhst_GetChildComputersResponse&r)
{
	void *funcPtr = KLSTRT::GetFunctionPtrByName(L"adhst_GetChildComputers");
	if ( funcPtr==NULL ) return SOAP_NO_METHOD;
	else return ((adhst_GetChildComputersFuncDef)funcPtr)(soap,idOU,fields,lTimeout,r);
}

typedef int (* adhst_GetChildOUsFuncDef)( struct soap *soap, 
                    xsd__int                    idOU, 
                    klhst_wstrings              fields,
                    xsd__int                    lTimeout,
                    struct adhst_GetChildOUsResponse&r);

int adhst_GetChildOUs( struct soap *soap, 
                    xsd__int                    idOU, 
                    klhst_wstrings              fields,
                    xsd__int                    lTimeout,
                    struct adhst_GetChildOUsResponse&r)
{
	void *funcPtr = KLSTRT::GetFunctionPtrByName(L"adhst_GetChildOUs");
	if ( funcPtr==NULL ) return SOAP_NO_METHOD;
	else return ((adhst_GetChildOUsFuncDef)funcPtr)(soap,idOU,fields,lTimeout,r);
}

typedef int (* adhst_GetOUFuncDef)( struct soap *soap, 
                    xsd__int                    idOU, 
                    klhst_wstrings              fields,
                    struct adhst_GetOUResponse&r);

int adhst_GetOU( struct soap *soap, 
                    xsd__int                    idOU, 
                    klhst_wstrings              fields,
                    struct adhst_GetOUResponse&r)
{
	void *funcPtr = KLSTRT::GetFunctionPtrByName(L"adhst_GetOU");
	if ( funcPtr==NULL ) return SOAP_NO_METHOD;
	else return ((adhst_GetOUFuncDef)funcPtr)(soap,idOU,fields,r);
}

typedef int (* adhst_UpdateOUFuncDef)( struct soap *soap, 
                    xsd__int                    idOU, 
                    param__params		        parData,
                    struct adhst_UpdateOUResponse&r);

int adhst_UpdateOU( struct soap *soap, 
                    xsd__int                    idOU, 
                    param__params		        parData,
                    struct adhst_UpdateOUResponse&r)
{
	void *funcPtr = KLSTRT::GetFunctionPtrByName(L"adhst_UpdateOU");
	if ( funcPtr==NULL ) return SOAP_NO_METHOD;
	else return ((adhst_UpdateOUFuncDef)funcPtr)(soap,idOU,parData,r);
}

typedef int (* klgsyn_GetNextItemsFuncDef)( struct soap *soap, 
						xsd__wstring wstrIterator,
						xsd__int	nCount,
						struct klgsyn_GetNextItemsResponse& r);

int klgsyn_GetNextItems( struct soap *soap, 
						xsd__wstring wstrIterator,
						xsd__int	nCount,
						struct klgsyn_GetNextItemsResponse& r)
{
	void *funcPtr = KLSTRT::GetFunctionPtrByName(L"klgsyn_GetNextItems");
	if ( funcPtr==NULL ) return SOAP_NO_METHOD;
	else return ((klgsyn_GetNextItemsFuncDef)funcPtr)(soap,wstrIterator,nCount, r);
}

typedef int (* klgsyn_ReleaseIteratorFuncDef)( struct soap *soap, 
						xsd__wstring wstrIterator,
						struct klgsyn_ReleaseIteratorResponse& r);

int klgsyn_ReleaseIterator( struct soap *soap, 
						xsd__wstring wstrIterator,
						struct klgsyn_ReleaseIteratorResponse& r)
{
	void *funcPtr = KLSTRT::GetFunctionPtrByName(L"klgsyn_ReleaseIterator");
	if ( funcPtr==NULL ) return SOAP_NO_METHOD;
	else return ((klgsyn_ReleaseIteratorFuncDef)funcPtr)(soap,wstrIterator, r);
}

typedef int (* klgsyn_AddSyncObjGFuncDef)( struct soap *soap, 
					xsd__wstring	szwName,
					xsd__wstring	wstrSyncObjPath,
					xsd__int		nDirection,
					xsd__int		lGroup,
					xsd__int		lElapse,
					xsd__boolean	bCutoffChildren,
					struct klgsyn_AddSyncObjGResponse& r);

int klgsyn_AddSyncObjG( struct soap *soap, 
					xsd__wstring	szwName,
					xsd__wstring	wstrSyncObjPath,
					xsd__int		nDirection,
					xsd__int		lGroup,
					xsd__int		lElapse,
					xsd__boolean	bCutoffChildren,
					struct klgsyn_AddSyncObjGResponse& r)
{
	void *funcPtr = KLSTRT::GetFunctionPtrByName(L"klgsyn_AddSyncObjG");
	if ( funcPtr==NULL ) return SOAP_NO_METHOD;
	else return ((klgsyn_AddSyncObjGFuncDef)funcPtr)(soap,szwName,wstrSyncObjPath,nDirection,lGroup,lElapse,bCutoffChildren, r);
}

typedef int (* klgsyn_AddSyncObjHFuncDef)( struct soap *soap, 
					xsd__wstring		szwName,
					xsd__wstring		wstrSyncObjPath,
					xsd__int			nDirection,
					klgsyn_hostids		arrHosts,
					xsd__int			lElapse,					
					struct klgsyn_AddSyncObjHResponse& r);

int klgsyn_AddSyncObjH( struct soap *soap, 
					xsd__wstring		szwName,
					xsd__wstring		wstrSyncObjPath,
					xsd__int			nDirection,
					klgsyn_hostids		arrHosts,
					xsd__int			lElapse,					
					struct klgsyn_AddSyncObjHResponse& r)
{
	void *funcPtr = KLSTRT::GetFunctionPtrByName(L"klgsyn_AddSyncObjH");
	if ( funcPtr==NULL ) return SOAP_NO_METHOD;
	else return ((klgsyn_AddSyncObjHFuncDef)funcPtr)(soap,szwName,wstrSyncObjPath,nDirection,arrHosts,lElapse, r);
}

typedef int (* klgsyn_GetSyncInfoFuncDef)( struct soap *soap, 
					long				lSync,
					klgsyn_wstrings		arrFields,
					struct klgsyn_GetSyncInfoResponse& r);

int klgsyn_GetSyncInfo( struct soap *soap, 
					long				lSync,
					klgsyn_wstrings		arrFields,
					struct klgsyn_GetSyncInfoResponse& r)
{
	void *funcPtr = KLSTRT::GetFunctionPtrByName(L"klgsyn_GetSyncInfo");
	if ( funcPtr==NULL ) return SOAP_NO_METHOD;
	else return ((klgsyn_GetSyncInfoFuncDef)funcPtr)(soap,lSync,arrFields, r);
}

typedef int (* klgsyn_RemoveSyncObjFuncDef)( struct soap *soap, 
					xsd__int	lSync,
					struct klgsyn_RemoveSyncObjResponse& r);

int klgsyn_RemoveSyncObj( struct soap *soap, 
					xsd__int	lSync,
					struct klgsyn_RemoveSyncObjResponse& r)
{
	void *funcPtr = KLSTRT::GetFunctionPtrByName(L"klgsyn_RemoveSyncObj");
	if ( funcPtr==NULL ) return SOAP_NO_METHOD;
	else return ((klgsyn_RemoveSyncObjFuncDef)funcPtr)(soap,lSync, r);
}

typedef int (* klgsyn_GetSyncHostsInfoFuncDef)( struct soap *soap, 
					xsd__int			lSync, 
					klgsyn_wstrings		arrFields,
					xsd__int			lTimeout,
					struct klgsyn_GetSyncHostsInfoResponse& r);

int klgsyn_GetSyncHostsInfo( struct soap *soap, 
					xsd__int			lSync, 
					klgsyn_wstrings		arrFields,
					xsd__int			lTimeout,
					struct klgsyn_GetSyncHostsInfoResponse& r)
{
	void *funcPtr = KLSTRT::GetFunctionPtrByName(L"klgsyn_GetSyncHostsInfo");
	if ( funcPtr==NULL ) return SOAP_NO_METHOD;
	else return ((klgsyn_GetSyncHostsInfoFuncDef)funcPtr)(soap,lSync,arrFields,lTimeout, r);
}

typedef int (* klgsyn_FindHostsFuncDef)( struct soap *soap, 
					xsd__int			lSync, 
					xsd__wstring		wstrFilter,
					klgsyn_wstrings		arrFields,
					xsd__int			lTimeout,
					struct klgsyn_FindHostsResponse& r);

int klgsyn_FindHosts( struct soap *soap, 
					xsd__int			lSync, 
					xsd__wstring		wstrFilter,
					klgsyn_wstrings		arrFields,
					xsd__int			lTimeout,
					struct klgsyn_FindHostsResponse& r)
{
	void *funcPtr = KLSTRT::GetFunctionPtrByName(L"klgsyn_FindHosts");
	if ( funcPtr==NULL ) return SOAP_NO_METHOD;
	else return ((klgsyn_FindHostsFuncDef)funcPtr)(soap,lSync,wstrFilter,arrFields,lTimeout, r);
}

typedef int (* klgsyn_GetSyncHostsInfo2FuncDef)( struct soap *soap, 
					xsd__int			lSync, 
					klgsyn_wstrings		arrFields,
					klgsyn_field_order_array arrFieldsToOrder,
					xsd__int			lTimeout,
					struct klgsyn_GetSyncHostsInfo2Response& r);

int klgsyn_GetSyncHostsInfo2( struct soap *soap, 
					xsd__int			lSync, 
					klgsyn_wstrings		arrFields,
					klgsyn_field_order_array arrFieldsToOrder,
					xsd__int			lTimeout,
					struct klgsyn_GetSyncHostsInfo2Response& r)
{
	void *funcPtr = KLSTRT::GetFunctionPtrByName(L"klgsyn_GetSyncHostsInfo2");
	if ( funcPtr==NULL ) return SOAP_NO_METHOD;
	else return ((klgsyn_GetSyncHostsInfo2FuncDef)funcPtr)(soap,lSync,arrFields,arrFieldsToOrder,lTimeout, r);
}

typedef int (* klgsyn_FindHosts2FuncDef)( struct soap *soap, 
					xsd__int			lSync, 
					xsd__wstring		wstrFilter,
					klgsyn_wstrings		arrFields,
					klgsyn_field_order_array arrFieldsToOrder,
					xsd__int			lTimeout,
					struct klgsyn_FindHosts2Response& r);

int klgsyn_FindHosts2( struct soap *soap, 
					xsd__int			lSync, 
					xsd__wstring		wstrFilter,
					klgsyn_wstrings		arrFields,
					klgsyn_field_order_array arrFieldsToOrder,
					xsd__int			lTimeout,
					struct klgsyn_FindHosts2Response& r)
{
	void *funcPtr = KLSTRT::GetFunctionPtrByName(L"klgsyn_FindHosts2");
	if ( funcPtr==NULL ) return SOAP_NO_METHOD;
	else return ((klgsyn_FindHosts2FuncDef)funcPtr)(soap,lSync,wstrFilter,arrFields,arrFieldsToOrder,lTimeout, r);
}

typedef int (* klgsyn_GetItemsCountFuncDef)( struct soap *soap, 
						xsd__wstring wstrAccessor,
						struct klgsyn_GetItemsCountResponse& r);

int klgsyn_GetItemsCount( struct soap *soap, 
						xsd__wstring wstrAccessor,
						struct klgsyn_GetItemsCountResponse& r)
{
	void *funcPtr = KLSTRT::GetFunctionPtrByName(L"klgsyn_GetItemsCount");
	if ( funcPtr==NULL ) return SOAP_NO_METHOD;
	else return ((klgsyn_GetItemsCountFuncDef)funcPtr)(soap,wstrAccessor, r);
}

typedef int (* klgsyn_GetItemsChunkFuncDef)( struct soap *soap, 
						xsd__wstring wstrAccessor,
						xsd__int	nStart,
						xsd__int	nCount,
						struct klgsyn_GetItemsChunkResponse& r);

int klgsyn_GetItemsChunk( struct soap *soap, 
						xsd__wstring wstrAccessor,
						xsd__int	nStart,
						xsd__int	nCount,
						struct klgsyn_GetItemsChunkResponse& r)
{
	void *funcPtr = KLSTRT::GetFunctionPtrByName(L"klgsyn_GetItemsChunk");
	if ( funcPtr==NULL ) return SOAP_NO_METHOD;
	else return ((klgsyn_GetItemsChunkFuncDef)funcPtr)(soap,wstrAccessor,nStart,nCount, r);
}

typedef int (* klgsyn_ReleaseChunkAccessorFuncDef)( struct soap *soap, 
						xsd__wstring wstrAccessor,
						struct klgsyn_ReleaseChunkAccessorResponse& r);

int klgsyn_ReleaseChunkAccessor( struct soap *soap, 
						xsd__wstring wstrAccessor,
						struct klgsyn_ReleaseChunkAccessorResponse& r)
{
	void *funcPtr = KLSTRT::GetFunctionPtrByName(L"klgsyn_ReleaseChunkAccessor");
	if ( funcPtr==NULL ) return SOAP_NO_METHOD;
	else return ((klgsyn_ReleaseChunkAccessorFuncDef)funcPtr)(soap,wstrAccessor, r);
}

typedef int (* kltsk_ForbidTaskForGroupFuncDef)( struct soap *soap, 
    xsd__int            nGroupId,
    xsd__int            nTaskId,
    struct kltsk_ForbidTaskForGroupResponse&r );

int kltsk_ForbidTaskForGroup( struct soap *soap, 
    xsd__int            nGroupId,
    xsd__int            nTaskId,
    struct kltsk_ForbidTaskForGroupResponse&r )
{
	void *funcPtr = KLSTRT::GetFunctionPtrByName(L"kltsk_ForbidTaskForGroup");
	if ( funcPtr==NULL ) return SOAP_NO_METHOD;
	else return ((kltsk_ForbidTaskForGroupFuncDef)funcPtr)(soap,nGroupId,nTaskId,r);
}

typedef int (* kltsk_RunTaskNowFuncDef)( struct soap *soap, 
    xsd__int nTaskId,
    xsd__wstring wstrDomainName,
    xsd__wstring wstrHostName,
    xsd__boolean bEvenIfAlreadySucceeded,
    struct kltsk_RunTaskNowResponse&r );

int kltsk_RunTaskNow( struct soap *soap, 
    xsd__int nTaskId,
    xsd__wstring wstrDomainName,
    xsd__wstring wstrHostName,
    xsd__boolean bEvenIfAlreadySucceeded,
    struct kltsk_RunTaskNowResponse&r )
{
	void *funcPtr = KLSTRT::GetFunctionPtrByName(L"kltsk_RunTaskNow");
	if ( funcPtr==NULL ) return SOAP_NO_METHOD;
	else return ((kltsk_RunTaskNowFuncDef)funcPtr)(soap,nTaskId,wstrDomainName,wstrHostName,bEvenIfAlreadySucceeded,r);
}

typedef int (* kltsk_SuspendTaskFuncDef)( struct soap *soap, 
    xsd__int nTaskId,
    struct kltsk_SuspendTaskResponse&r );

int kltsk_SuspendTask( struct soap *soap, 
    xsd__int nTaskId,
    struct kltsk_SuspendTaskResponse&r )
{
	void *funcPtr = KLSTRT::GetFunctionPtrByName(L"kltsk_SuspendTask");
	if ( funcPtr==NULL ) return SOAP_NO_METHOD;
	else return ((kltsk_SuspendTaskFuncDef)funcPtr)(soap,nTaskId,r);
}

typedef int (* kltsk_ResumeTaskFuncDef)( struct soap *soap, 
    xsd__int nTaskId,
    struct kltsk_ResumeTaskResponse&r );

int kltsk_ResumeTask( struct soap *soap, 
    xsd__int nTaskId,
    struct kltsk_ResumeTaskResponse&r )
{
	void *funcPtr = KLSTRT::GetFunctionPtrByName(L"kltsk_ResumeTask");
	if ( funcPtr==NULL ) return SOAP_NO_METHOD;
	else return ((kltsk_ResumeTaskFuncDef)funcPtr)(soap,nTaskId,r);
}

typedef int (* kltsk_CancelTaskFuncDef)( struct soap *soap, 
    xsd__int nTaskId,
    struct kltsk_CancelTaskResponse&r );

int kltsk_CancelTask( struct soap *soap, 
    xsd__int nTaskId,
    struct kltsk_CancelTaskResponse&r )
{
	void *funcPtr = KLSTRT::GetFunctionPtrByName(L"kltsk_CancelTask");
	if ( funcPtr==NULL ) return SOAP_NO_METHOD;
	else return ((kltsk_CancelTaskFuncDef)funcPtr)(soap,nTaskId,r);
}

typedef int (* kltsk_ResetTasksIteratorFuncDef)( struct soap *soap, 
    xsd__int            nGroupId,
    xsd__boolean        bGroupIdSignificant,
    struct kltsk_component_id  compIdFilter,
    xsd__wstring        taskName,
    xsd__boolean        bIncludeSupergroups,
    struct kltsk_ResetTasksIteratorResponse&r );

int kltsk_ResetTasksIterator( struct soap *soap, 
    xsd__int            nGroupId,
    xsd__boolean        bGroupIdSignificant,
    struct kltsk_component_id  compIdFilter,
    xsd__wstring        taskName,
    xsd__boolean        bIncludeSupergroups,
    struct kltsk_ResetTasksIteratorResponse&r )
{
	void *funcPtr = KLSTRT::GetFunctionPtrByName(L"kltsk_ResetTasksIterator");
	if ( funcPtr==NULL ) return SOAP_NO_METHOD;
	else return ((kltsk_ResetTasksIteratorFuncDef)funcPtr)(soap,nGroupId,bGroupIdSignificant,compIdFilter,taskName,bIncludeSupergroups,r);
}

typedef int (* kltsk_GetNextTaskFuncDef)( struct soap *soap, 
    xsd__wstring	iteratorId,
    struct kltsk_GetNextTaskResponse&r );

int kltsk_GetNextTask( struct soap *soap, 
    xsd__wstring	iteratorId,
    struct kltsk_GetNextTaskResponse&r )
{
	void *funcPtr = KLSTRT::GetFunctionPtrByName(L"kltsk_GetNextTask");
	if ( funcPtr==NULL ) return SOAP_NO_METHOD;
	else return ((kltsk_GetNextTaskFuncDef)funcPtr)(soap,iteratorId,r);
}

typedef int (* kltsk_GetTaskByIDFuncDef)( struct soap *soap, 
    xsd__int    nTaskId,
    struct kltsk_GetTaskByIDResponse&r );

int kltsk_GetTaskByID( struct soap *soap, 
    xsd__int    nTaskId,
    struct kltsk_GetTaskByIDResponse&r )
{
	void *funcPtr = KLSTRT::GetFunctionPtrByName(L"kltsk_GetTaskByID");
	if ( funcPtr==NULL ) return SOAP_NO_METHOD;
	else return ((kltsk_GetTaskByIDFuncDef)funcPtr)(soap,nTaskId,r);
}

typedef int (* kltsk_GetTaskStatisticsFuncDef)( struct soap *soap, 
    xsd__int    nTaskId,
    struct kltsk_GetTaskStatisticsResponse&r );

int kltsk_GetTaskStatistics( struct soap *soap, 
    xsd__int    nTaskId,
    struct kltsk_GetTaskStatisticsResponse&r )
{
	void *funcPtr = KLSTRT::GetFunctionPtrByName(L"kltsk_GetTaskStatistics");
	if ( funcPtr==NULL ) return SOAP_NO_METHOD;
	else return ((kltsk_GetTaskStatisticsFuncDef)funcPtr)(soap,nTaskId,r);
}

typedef int (* kltsk_AddTaskFuncDef)( struct soap *soap, 
    xsd__int            nGroupId,
    xsd__boolean        bGroupIdSignificant,
    param__params       parTaskData,
    struct kltsk_AddTaskResponse&r );

int kltsk_AddTask( struct soap *soap, 
    xsd__int            nGroupId,
    xsd__boolean        bGroupIdSignificant,
    param__params       parTaskData,
    struct kltsk_AddTaskResponse&r )
{
	void *funcPtr = KLSTRT::GetFunctionPtrByName(L"kltsk_AddTask");
	if ( funcPtr==NULL ) return SOAP_NO_METHOD;
	else return ((kltsk_AddTaskFuncDef)funcPtr)(soap,nGroupId,bGroupIdSignificant,parTaskData,r);
}

typedef int (* kltsk_UpdateTaskFuncDef)( struct soap *soap, 
    xsd__int            nTaskId,
    param__params       parTaskData,
    struct kltsk_UpdateTaskResponse&r );

int kltsk_UpdateTask( struct soap *soap, 
    xsd__int            nTaskId,
    param__params       parTaskData,
    struct kltsk_UpdateTaskResponse&r )
{
	void *funcPtr = KLSTRT::GetFunctionPtrByName(L"kltsk_UpdateTask");
	if ( funcPtr==NULL ) return SOAP_NO_METHOD;
	else return ((kltsk_UpdateTaskFuncDef)funcPtr)(soap,nTaskId,parTaskData,r);
}

typedef int (* kltsk_DeleteTaskFuncDef)( struct soap *soap, 
    xsd__int            nTaskId,
    struct kltsk_DeleteTaskResponse&r );

int kltsk_DeleteTask( struct soap *soap, 
    xsd__int            nTaskId,
    struct kltsk_DeleteTaskResponse&r )
{
	void *funcPtr = KLSTRT::GetFunctionPtrByName(L"kltsk_DeleteTask");
	if ( funcPtr==NULL ) return SOAP_NO_METHOD;
	else return ((kltsk_DeleteTaskFuncDef)funcPtr)(soap,nTaskId,r);
}

typedef int (* kltsk_SetTaskStartEventFuncDef)( struct soap *soap, 
    xsd__int            nTaskId,
    struct kltsk_component_id  compIdFilter,
    xsd__wstring        eventType,
    param__params       bodyFilter,
    struct kltsk_SetTaskStartEventResponse&r );

int kltsk_SetTaskStartEvent( struct soap *soap, 
    xsd__int            nTaskId,
    struct kltsk_component_id  compIdFilter,
    xsd__wstring        eventType,
    param__params       bodyFilter,
    struct kltsk_SetTaskStartEventResponse&r )
{
	void *funcPtr = KLSTRT::GetFunctionPtrByName(L"kltsk_SetTaskStartEvent");
	if ( funcPtr==NULL ) return SOAP_NO_METHOD;
	else return ((kltsk_SetTaskStartEventFuncDef)funcPtr)(soap,nTaskId,compIdFilter,eventType,bodyFilter,r);
}

typedef int (* kltsk_GetTaskStartEventFuncDef)( struct soap *soap, 
    xsd__int            nTaskId,
    struct kltsk_GetTaskStartEventResponse&r );

int kltsk_GetTaskStartEvent( struct soap *soap, 
    xsd__int            nTaskId,
    struct kltsk_GetTaskStartEventResponse&r )
{
	void *funcPtr = KLSTRT::GetFunctionPtrByName(L"kltsk_GetTaskStartEvent");
	if ( funcPtr==NULL ) return SOAP_NO_METHOD;
	else return ((kltsk_GetTaskStartEventFuncDef)funcPtr)(soap,nTaskId,r);
}

typedef int (* kltsk_ResetHostIteratorForTaskStatusFuncDef)( struct soap *soap, 
    xsd__wstring            wstrTaskId,
    xsd__wstring            wstrDomainName,
    xsd__wstring            wstrHostName,
    kltsk_wstring_array     arrFields,
    xsd__int                hsHostStateMask,
    xsd__int                nLifetime,
    struct kltsk_ResetHostIteratorForTaskStatusResponse&r );

int kltsk_ResetHostIteratorForTaskStatus( struct soap *soap, 
    xsd__wstring            wstrTaskId,
    xsd__wstring            wstrDomainName,
    xsd__wstring            wstrHostName,
    kltsk_wstring_array     arrFields,
    xsd__int                hsHostStateMask,
    xsd__int                nLifetime,
    struct kltsk_ResetHostIteratorForTaskStatusResponse&r )
{
	void *funcPtr = KLSTRT::GetFunctionPtrByName(L"kltsk_ResetHostIteratorForTaskStatus");
	if ( funcPtr==NULL ) return SOAP_NO_METHOD;
	else return ((kltsk_ResetHostIteratorForTaskStatusFuncDef)funcPtr)(soap,wstrTaskId,wstrDomainName,wstrHostName,arrFields,hsHostStateMask,nLifetime,r);
}

typedef int (* kltsk_GetNextHostStatusFuncDef)( struct soap *soap, 
	xsd__wstring	iteratorId,
	xsd__int		nCount,
    struct kltsk_GetNextHostStatusResponse&r );

int kltsk_GetNextHostStatus( struct soap *soap, 
	xsd__wstring	iteratorId,
	xsd__int		nCount,
    struct kltsk_GetNextHostStatusResponse&r )
{
	void *funcPtr = KLSTRT::GetFunctionPtrByName(L"kltsk_GetNextHostStatus");
	if ( funcPtr==NULL ) return SOAP_NO_METHOD;
	else return ((kltsk_GetNextHostStatusFuncDef)funcPtr)(soap,iteratorId,nCount,r);
}

typedef int (* kltsk_ResetHostIteratorForTaskStatusExFuncDef)( struct soap *soap, 
    xsd__wstring            wstrTaskId,
    xsd__wstring            wstrDomainName,
    xsd__wstring            wstrHostName,
    kltsk_wstring_array     arrFields,
	kltsk_field_order_array	arrFiledsToOrder,
    xsd__int                hsHostStateMask,
    xsd__int                nLifetime,
    struct kltsk_ResetHostIteratorForTaskStatusExResponse&r );

int kltsk_ResetHostIteratorForTaskStatusEx( struct soap *soap, 
    xsd__wstring            wstrTaskId,
    xsd__wstring            wstrDomainName,
    xsd__wstring            wstrHostName,
    kltsk_wstring_array     arrFields,
	kltsk_field_order_array	arrFiledsToOrder,
    xsd__int                hsHostStateMask,
    xsd__int                nLifetime,
    struct kltsk_ResetHostIteratorForTaskStatusExResponse&r )
{
	void *funcPtr = KLSTRT::GetFunctionPtrByName(L"kltsk_ResetHostIteratorForTaskStatusEx");
	if ( funcPtr==NULL ) return SOAP_NO_METHOD;
	else return ((kltsk_ResetHostIteratorForTaskStatusExFuncDef)funcPtr)(soap,wstrTaskId,wstrDomainName,wstrHostName,arrFields,arrFiledsToOrder,hsHostStateMask,nLifetime,r);
}

typedef int (* kltsk_GetHostStatusRecordsCountFuncDef)( struct soap *soap, 
	xsd__wstring	iteratorId,
    struct kltsk_GetHostStatusRecordsCountResponse&r );

int kltsk_GetHostStatusRecordsCount( struct soap *soap, 
	xsd__wstring	iteratorId,
    struct kltsk_GetHostStatusRecordsCountResponse&r )
{
	void *funcPtr = KLSTRT::GetFunctionPtrByName(L"kltsk_GetHostStatusRecordsCount");
	if ( funcPtr==NULL ) return SOAP_NO_METHOD;
	else return ((kltsk_GetHostStatusRecordsCountFuncDef)funcPtr)(soap,iteratorId,r);
}

typedef int (* kltsk_GetHostStatusRecordRangeFuncDef)( struct soap *soap, 
	xsd__wstring	iteratorId,
	xsd__int		nStart,
	xsd__int		nEnd,
    struct kltsk_GetHostStatusRecordRangeResponse&r );

int kltsk_GetHostStatusRecordRange( struct soap *soap, 
	xsd__wstring	iteratorId,
	xsd__int		nStart,
	xsd__int		nEnd,
    struct kltsk_GetHostStatusRecordRangeResponse&r )
{
	void *funcPtr = KLSTRT::GetFunctionPtrByName(L"kltsk_GetHostStatusRecordRange");
	if ( funcPtr==NULL ) return SOAP_NO_METHOD;
	else return ((kltsk_GetHostStatusRecordRangeFuncDef)funcPtr)(soap,iteratorId,nStart,nEnd,r);
}

typedef int (* kltsk_GetAllTasksOfHostFuncDef)( struct soap *soap, 
	xsd__wstring	wstrDomainName,
    xsd__wstring	wstrHostName,
    struct kltsk_GetAllTasksOfHostResponse&r );

int kltsk_GetAllTasksOfHost( struct soap *soap, 
	xsd__wstring	wstrDomainName,
    xsd__wstring	wstrHostName,
    struct kltsk_GetAllTasksOfHostResponse&r )
{
	void *funcPtr = KLSTRT::GetFunctionPtrByName(L"kltsk_GetAllTasksOfHost");
	if ( funcPtr==NULL ) return SOAP_NO_METHOD;
	else return ((kltsk_GetAllTasksOfHostFuncDef)funcPtr)(soap,wstrDomainName,wstrHostName,r);
}

typedef int (* kltsk_GetTaskGroupFuncDef)( struct soap *soap, 
    xsd__int    nTaskId,
    struct kltsk_GetTaskGroupResponse&r );

int kltsk_GetTaskGroup( struct soap *soap, 
    xsd__int    nTaskId,
    struct kltsk_GetTaskGroupResponse&r )
{
	void *funcPtr = KLSTRT::GetFunctionPtrByName(L"kltsk_GetTaskGroup");
	if ( funcPtr==NULL ) return SOAP_NO_METHOD;
	else return ((kltsk_GetTaskGroupFuncDef)funcPtr)(soap,nTaskId,r);
}

typedef int (* klpkg_GetPackagesFuncDef)( struct soap *soap,  
					void* _,
					struct klpkg_GetPackagesResponse&r);

int klpkg_GetPackages( struct soap *soap,  
					void* _,
					struct klpkg_GetPackagesResponse&r)
{
	void *funcPtr = KLSTRT::GetFunctionPtrByName(L"klpkg_GetPackages");
	if ( funcPtr==NULL ) return SOAP_NO_METHOD;
	else return ((klpkg_GetPackagesFuncDef)funcPtr)(soap, _,r);
}

typedef int (* klpkg_RenamePackageFuncDef)( struct soap *soap, 
					  xsd__int		    nPackageId,
					  xsd__wstring		wstrNewPackageName,
					  struct klpkg_RenamePackageResponse&r);

int klpkg_RenamePackage( struct soap *soap, 
					  xsd__int		    nPackageId,
					  xsd__wstring		wstrNewPackageName,
					  struct klpkg_RenamePackageResponse&r)
{
	void *funcPtr = KLSTRT::GetFunctionPtrByName(L"klpkg_RenamePackage");
	if ( funcPtr==NULL ) return SOAP_NO_METHOD;
	else return ((klpkg_RenamePackageFuncDef)funcPtr)(soap,nPackageId,wstrNewPackageName,r);
}

typedef int (* klpkg_GetIntranetFolderForNewPackageFuncDef)( struct soap *soap, 
					xsd__wstring		wstrProductName,
					xsd__wstring		wstrProductVersion,
					struct klpkg_GetIntranetFolderForNewPackageResponse&r);

int klpkg_GetIntranetFolderForNewPackage( struct soap *soap, 
					xsd__wstring		wstrProductName,
					xsd__wstring		wstrProductVersion,
					struct klpkg_GetIntranetFolderForNewPackageResponse&r)
{
	void *funcPtr = KLSTRT::GetFunctionPtrByName(L"klpkg_GetIntranetFolderForNewPackage");
	if ( funcPtr==NULL ) return SOAP_NO_METHOD;
	else return ((klpkg_GetIntranetFolderForNewPackageFuncDef)funcPtr)(soap,wstrProductName,wstrProductVersion,r);
}

typedef int (* klpkg_RecordNewPackageFuncDef)( struct soap *soap, 
                    xsd__wstring	    wstrName,
					xsd__wstring		wstrFolder,
					xsd__wstring		wstrProductName,
					xsd__wstring		wstrProductVersion,
					xsd__wstring		wstrProductDisplName,
					xsd__wstring		wstrProductDisplVersion,
					struct klpkg_RecordNewPackageResponse&r);

int klpkg_RecordNewPackage( struct soap *soap, 
                    xsd__wstring	    wstrName,
					xsd__wstring		wstrFolder,
					xsd__wstring		wstrProductName,
					xsd__wstring		wstrProductVersion,
					xsd__wstring		wstrProductDisplName,
					xsd__wstring		wstrProductDisplVersion,
					struct klpkg_RecordNewPackageResponse&r)
{
	void *funcPtr = KLSTRT::GetFunctionPtrByName(L"klpkg_RecordNewPackage");
	if ( funcPtr==NULL ) return SOAP_NO_METHOD;
	else return ((klpkg_RecordNewPackageFuncDef)funcPtr)(soap,wstrName,wstrFolder,wstrProductName,wstrProductVersion,wstrProductDisplName,wstrProductDisplVersion,r);
}

typedef int (* klpkg_RemovePackageFuncDef)( struct soap *soap, 
					xsd__int		    nPackageId,
					struct klpkg_RemovePackageResponse&r);

int klpkg_RemovePackage( struct soap *soap, 
					xsd__int		    nPackageId,
					struct klpkg_RemovePackageResponse&r)
{
	void *funcPtr = KLSTRT::GetFunctionPtrByName(L"klpkg_RemovePackage");
	if ( funcPtr==NULL ) return SOAP_NO_METHOD;
	else return ((klpkg_RemovePackageFuncDef)funcPtr)(soap,nPackageId,r);
}

typedef int (* klpkg_GetIntranetFolderForPackageFuncDef)( struct soap *soap, 
					xsd__int		    nPackageId,
					struct klpkg_GetIntranetFolderForPackageResponse&r);

int klpkg_GetIntranetFolderForPackage( struct soap *soap, 
					xsd__int		    nPackageId,
					struct klpkg_GetIntranetFolderForPackageResponse&r)
{
	void *funcPtr = KLSTRT::GetFunctionPtrByName(L"klpkg_GetIntranetFolderForPackage");
	if ( funcPtr==NULL ) return SOAP_NO_METHOD;
	else return ((klpkg_GetIntranetFolderForPackageFuncDef)funcPtr)(soap,nPackageId,r);
}

typedef int (* klpkg_SS_ReadFuncDef)( struct soap *soap, 
				  xsd__wstring	storage_descr,
				  xsd__wstring	name,
				  xsd__wstring	version,
				  xsd__wstring	section,
				  xsd__int		timeout,
				  struct klpkg_SS_ReadResponse&r);

int klpkg_SS_Read( struct soap *soap, 
				  xsd__wstring	storage_descr,
				  xsd__wstring	name,
				  xsd__wstring	version,
				  xsd__wstring	section,
				  xsd__int		timeout,
				  struct klpkg_SS_ReadResponse&r)
{
	void *funcPtr = KLSTRT::GetFunctionPtrByName(L"klpkg_SS_Read");
	if ( funcPtr==NULL ) return SOAP_NO_METHOD;
	else return ((klpkg_SS_ReadFuncDef)funcPtr)(soap,storage_descr,name,version,section,timeout,r);
}

typedef int (* klpkg_SS_WriteFuncDef)( struct soap *soap, 
					xsd__wstring	storage_descr,
					xsd__wstring	name,
					xsd__wstring	version,
					xsd__wstring	section,
					param__params	data,
					xsd__int		timeout,
					xsd__int		operation_type,  
					struct klpkg_SS_WriteResponse&r);

int klpkg_SS_Write( struct soap *soap, 
					xsd__wstring	storage_descr,
					xsd__wstring	name,
					xsd__wstring	version,
					xsd__wstring	section,
					param__params	data,
					xsd__int		timeout,
					xsd__int		operation_type,  
					struct klpkg_SS_WriteResponse&r)
{
	void *funcPtr = KLSTRT::GetFunctionPtrByName(L"klpkg_SS_Write");
	if ( funcPtr==NULL ) return SOAP_NO_METHOD;
	else return ((klpkg_SS_WriteFuncDef)funcPtr)(soap,storage_descr,name,version,section,data,timeout,operation_type,r);
}

typedef int (* klpkg_SS_SectionOpearationFuncDef)( struct soap *soap, 
					xsd__wstring	storage_descr,
					xsd__wstring	name,
					xsd__wstring	version,
					xsd__wstring	section,
					xsd__int		timeout,
					xsd__int		operation_type,
					struct klpkg_SS_SectionOpearationResponse&r);

int klpkg_SS_SectionOpearation( struct soap *soap, 
					xsd__wstring	storage_descr,
					xsd__wstring	name,
					xsd__wstring	version,
					xsd__wstring	section,
					xsd__int		timeout,
					xsd__int		operation_type,
					struct klpkg_SS_SectionOpearationResponse&r)
{
	void *funcPtr = KLSTRT::GetFunctionPtrByName(L"klpkg_SS_SectionOpearation");
	if ( funcPtr==NULL ) return SOAP_NO_METHOD;
	else return ((klpkg_SS_SectionOpearationFuncDef)funcPtr)(soap,storage_descr,name,version,section,timeout,operation_type,r);
}

typedef int (* klpkg_SS_GetNamesFuncDef)( struct soap *soap, 
					xsd__wstring	storage_descr,
					xsd__wstring	name,
					xsd__wstring	version,
					xsd__int		timeout,
					struct klpkg_SS_GetNamesResponse&r);

int klpkg_SS_GetNames( struct soap *soap, 
					xsd__wstring	storage_descr,
					xsd__wstring	name,
					xsd__wstring	version,
					xsd__int		timeout,
					struct klpkg_SS_GetNamesResponse&r)
{
	void *funcPtr = KLSTRT::GetFunctionPtrByName(L"klpkg_SS_GetNames");
	if ( funcPtr==NULL ) return SOAP_NO_METHOD;
	else return ((klpkg_SS_GetNamesFuncDef)funcPtr)(soap,storage_descr,name,version,timeout,r);
}

typedef int (* klpkg_RemovePackage2FuncDef)( struct soap *soap, 
					xsd__int		    nPackageId,
					struct klpkg_RemovePackage2Response&r);

int klpkg_RemovePackage2( struct soap *soap, 
					xsd__int		    nPackageId,
					struct klpkg_RemovePackage2Response&r)
{
	void *funcPtr = KLSTRT::GetFunctionPtrByName(L"klpkg_RemovePackage2");
	if ( funcPtr==NULL ) return SOAP_NO_METHOD;
	else return ((klpkg_RemovePackage2FuncDef)funcPtr)(soap,nPackageId,r);
}

typedef int (* klpkg_GetLoginScriptFuncDef)( struct soap *soap, 
					xsd__int		    nPackageId,
					xsd__wstring		wstrTaskId,
					struct klpkg_GetLoginScriptResponse&r);

int klpkg_GetLoginScript( struct soap *soap, 
					xsd__int		    nPackageId,
					xsd__wstring		wstrTaskId,
					struct klpkg_GetLoginScriptResponse&r)
{
	void *funcPtr = KLSTRT::GetFunctionPtrByName(L"klpkg_GetLoginScript");
	if ( funcPtr==NULL ) return SOAP_NO_METHOD;
	else return ((klpkg_GetLoginScriptFuncDef)funcPtr)(soap,nPackageId,wstrTaskId,r);
}

typedef int (* klpkg_SetRebootOptionsFuncDef)( struct soap *soap, 
					xsd__int		    nPackageId,
					xsd__boolean	    bRebootImmediately,
					xsd__boolean	    bAskForReboot,
					xsd__int		    nAskForRebootPeriodInMin,
					xsd__int		    nForceRebootTimeInMin,
					xsd__wstring		wstrAskRebootMsgText,
					struct klpkg_SetRebootOptionsResponse&r);

int klpkg_SetRebootOptions( struct soap *soap, 
					xsd__int		    nPackageId,
					xsd__boolean	    bRebootImmediately,
					xsd__boolean	    bAskForReboot,
					xsd__int		    nAskForRebootPeriodInMin,
					xsd__int		    nForceRebootTimeInMin,
					xsd__wstring		wstrAskRebootMsgText,
					struct klpkg_SetRebootOptionsResponse&r)
{
	void *funcPtr = KLSTRT::GetFunctionPtrByName(L"klpkg_SetRebootOptions");
	if ( funcPtr==NULL ) return SOAP_NO_METHOD;
	else return ((klpkg_SetRebootOptionsFuncDef)funcPtr)(soap,nPackageId,bRebootImmediately,bAskForReboot,nAskForRebootPeriodInMin,nForceRebootTimeInMin,wstrAskRebootMsgText,r);
}

typedef int (* klpkg_GetRebootOptionsFuncDef)( struct soap *soap, 
					xsd__int		    nPackageId,
					struct klpkg_GetRebootOptionsResponse&r);

int klpkg_GetRebootOptions( struct soap *soap, 
					xsd__int		    nPackageId,
					struct klpkg_GetRebootOptionsResponse&r)
{
	void *funcPtr = KLSTRT::GetFunctionPtrByName(L"klpkg_GetRebootOptions");
	if ( funcPtr==NULL ) return SOAP_NO_METHOD;
	else return ((klpkg_GetRebootOptionsFuncDef)funcPtr)(soap,nPackageId,r);
}

typedef int (* klpkg_RecordNewPackage2FuncDef)( struct soap *soap, 
                    xsd__wstring	    wstrName,
					xsd__wstring		wstrFileId,
					xsd__wstring		wstrProductName,
					xsd__wstring		wstrProductVersion,
					xsd__wstring		wstrProductDisplName,
					xsd__wstring		wstrProductDisplVersion,
					struct klpkg_RecordNewPackage2Response&r);

int klpkg_RecordNewPackage2( struct soap *soap, 
                    xsd__wstring	    wstrName,
					xsd__wstring		wstrFileId,
					xsd__wstring		wstrProductName,
					xsd__wstring		wstrProductVersion,
					xsd__wstring		wstrProductDisplName,
					xsd__wstring		wstrProductDisplVersion,
					struct klpkg_RecordNewPackage2Response&r)
{
	void *funcPtr = KLSTRT::GetFunctionPtrByName(L"klpkg_RecordNewPackage2");
	if ( funcPtr==NULL ) return SOAP_NO_METHOD;
	else return ((klpkg_RecordNewPackage2FuncDef)funcPtr)(soap,wstrName,wstrFileId,wstrProductName,wstrProductVersion,wstrProductDisplName,wstrProductDisplVersion,r);
}

typedef int (* klpkg_GetLicenseKeyFuncDef)( struct soap *soap, 
                    xsd__int			nPackageId,
					struct klpkg_GetLicenseKeyResponse&r);

int klpkg_GetLicenseKey( struct soap *soap, 
                    xsd__int			nPackageId,
					struct klpkg_GetLicenseKeyResponse&r)
{
	void *funcPtr = KLSTRT::GetFunctionPtrByName(L"klpkg_GetLicenseKey");
	if ( funcPtr==NULL ) return SOAP_NO_METHOD;
	else return ((klpkg_GetLicenseKeyFuncDef)funcPtr)(soap,nPackageId,r);
}

typedef int (* klpkg_SetLicenseKeyFuncDef)( struct soap *soap, 
                    xsd__int			nPackageId,
					xsd__wstring		wstrKeyFileName,
					xsd__hexBinary		data,
					xsd__boolean		bRemoveExisting,
					struct klpkg_SetLicenseKeyResponse&r);

int klpkg_SetLicenseKey( struct soap *soap, 
                    xsd__int			nPackageId,
					xsd__wstring		wstrKeyFileName,
					xsd__hexBinary		data,
					xsd__boolean		bRemoveExisting,
					struct klpkg_SetLicenseKeyResponse&r)
{
	void *funcPtr = KLSTRT::GetFunctionPtrByName(L"klpkg_SetLicenseKey");
	if ( funcPtr==NULL ) return SOAP_NO_METHOD;
	else return ((klpkg_SetLicenseKeyFuncDef)funcPtr)(soap,nPackageId,wstrKeyFileName,data,bRemoveExisting,r);
}

typedef int (* klpkg_ReadPkgCfgFileFuncDef)( struct soap *soap, 
					xsd__int		    nPackageId,
					xsd__wstring		wstrFileRelativePath,
					struct klpkg_ReadPkgCfgFileResponse&r);

int klpkg_ReadPkgCfgFile( struct soap *soap, 
					xsd__int		    nPackageId,
					xsd__wstring		wstrFileRelativePath,
					struct klpkg_ReadPkgCfgFileResponse&r)
{
	void *funcPtr = KLSTRT::GetFunctionPtrByName(L"klpkg_ReadPkgCfgFile");
	if ( funcPtr==NULL ) return SOAP_NO_METHOD;
	else return ((klpkg_ReadPkgCfgFileFuncDef)funcPtr)(soap,nPackageId,wstrFileRelativePath,r);
}

typedef int (* klpkg_WritePkgCfgFileFuncDef)( struct soap *soap, 
					xsd__int		    nPackageId,
					xsd__wstring		wstrFileRelativePath,
					xsd__hexBinary		data,
					struct klpkg_WritePkgCfgFileResponse&r);

int klpkg_WritePkgCfgFile( struct soap *soap, 
					xsd__int		    nPackageId,
					xsd__wstring		wstrFileRelativePath,
					xsd__hexBinary		data,
					struct klpkg_WritePkgCfgFileResponse&r)
{
	void *funcPtr = KLSTRT::GetFunctionPtrByName(L"klpkg_WritePkgCfgFile");
	if ( funcPtr==NULL ) return SOAP_NO_METHOD;
	else return ((klpkg_WritePkgCfgFileFuncDef)funcPtr)(soap,nPackageId,wstrFileRelativePath,data,r);
}

typedef int (* klpkg_ReadKpdFileFuncDef)( struct soap *soap, 
					xsd__int		    nPackageId,
					struct klpkg_ReadKpdFileResponse&r);

int klpkg_ReadKpdFile( struct soap *soap, 
					xsd__int		    nPackageId,
					struct klpkg_ReadKpdFileResponse&r)
{
	void *funcPtr = KLSTRT::GetFunctionPtrByName(L"klpkg_ReadKpdFile");
	if ( funcPtr==NULL ) return SOAP_NO_METHOD;
	else return ((klpkg_ReadKpdFileFuncDef)funcPtr)(soap,nPackageId,r);
}

typedef int (* klpkg_GetKpdProfileStringFuncDef)( struct soap *soap, 
					xsd__int		    nPackageId,
					xsd__wstring		wstrSection,
					xsd__wstring		wstrKey,
					xsd__wstring		wstrDefault,
					struct klpkg_GetKpdProfileStringResponse&r);

int klpkg_GetKpdProfileString( struct soap *soap, 
					xsd__int		    nPackageId,
					xsd__wstring		wstrSection,
					xsd__wstring		wstrKey,
					xsd__wstring		wstrDefault,
					struct klpkg_GetKpdProfileStringResponse&r)
{
	void *funcPtr = KLSTRT::GetFunctionPtrByName(L"klpkg_GetKpdProfileString");
	if ( funcPtr==NULL ) return SOAP_NO_METHOD;
	else return ((klpkg_GetKpdProfileStringFuncDef)funcPtr)(soap,nPackageId,wstrSection,wstrKey,wstrDefault,r);
}

typedef int (* klpkg_WriteKpdProfileStringFuncDef)( struct soap *soap, 
					xsd__int		    nPackageId,
					xsd__wstring		wstrSection,
					xsd__wstring		wstrKey,
					xsd__wstring		wstrValue,
					struct klpkg_WriteKpdProfileStringResponse&r);

int klpkg_WriteKpdProfileString( struct soap *soap, 
					xsd__int		    nPackageId,
					xsd__wstring		wstrSection,
					xsd__wstring		wstrKey,
					xsd__wstring		wstrValue,
					struct klpkg_WriteKpdProfileStringResponse&r)
{
	void *funcPtr = KLSTRT::GetFunctionPtrByName(L"klpkg_WriteKpdProfileString");
	if ( funcPtr==NULL ) return SOAP_NO_METHOD;
	else return ((klpkg_WriteKpdProfileStringFuncDef)funcPtr)(soap,nPackageId,wstrSection,wstrKey,wstrValue,r);
}

typedef int (* klpkg_SetRebootOptionsExFuncDef)( struct soap *soap, 
					xsd__int		    nPackageId,
					xsd__boolean	    bRebootImmediately,
					xsd__boolean	    bAskForReboot,
					xsd__int		    nAskForRebootPeriodInMin,
					xsd__int		    nForceRebootTimeInMin,
					xsd__wstring		wstrAskRebootMsgText,
					xsd__boolean		    bForceAppsClosed,
					param__params	    parParams,
					struct klpkg_SetRebootOptionsExResponse&r);

int klpkg_SetRebootOptionsEx( struct soap *soap, 
					xsd__int		    nPackageId,
					xsd__boolean	    bRebootImmediately,
					xsd__boolean	    bAskForReboot,
					xsd__int		    nAskForRebootPeriodInMin,
					xsd__int		    nForceRebootTimeInMin,
					xsd__wstring		wstrAskRebootMsgText,
					xsd__boolean		    bForceAppsClosed,
					param__params	    parParams,
					struct klpkg_SetRebootOptionsExResponse&r)
{
	void *funcPtr = KLSTRT::GetFunctionPtrByName(L"klpkg_SetRebootOptionsEx");
	if ( funcPtr==NULL ) return SOAP_NO_METHOD;
	else return ((klpkg_SetRebootOptionsExFuncDef)funcPtr)(soap,nPackageId,bRebootImmediately,bAskForReboot,nAskForRebootPeriodInMin,nForceRebootTimeInMin,wstrAskRebootMsgText,bForceAppsClosed,parParams,r);
}

typedef int (* klpkg_GetRebootOptionsExFuncDef)( struct soap *soap, 
					xsd__int		    nPackageId,
					struct klpkg_GetRebootOptionsExResponse&r);

int klpkg_GetRebootOptionsEx( struct soap *soap, 
					xsd__int		    nPackageId,
					struct klpkg_GetRebootOptionsExResponse&r)
{
	void *funcPtr = KLSTRT::GetFunctionPtrByName(L"klpkg_GetRebootOptionsEx");
	if ( funcPtr==NULL ) return SOAP_NO_METHOD;
	else return ((klpkg_GetRebootOptionsExFuncDef)funcPtr)(soap,nPackageId,r);
}

typedef int (* klpkg_RecordNewPackageAsyncFuncDef)( struct soap *soap, 
                    xsd__wstring	    wstrName,
					xsd__wstring		wstrFolder,
					xsd__wstring		wstrProductName,
					xsd__wstring		wstrProductVersion,
					xsd__wstring		wstrProductDisplName,
					xsd__wstring		wstrProductDisplVersion,
					xsd__wstring		wstrRequestId,
					struct klpkg_RecordNewPackageAsyncResponse&r);

int klpkg_RecordNewPackageAsync( struct soap *soap, 
                    xsd__wstring	    wstrName,
					xsd__wstring		wstrFolder,
					xsd__wstring		wstrProductName,
					xsd__wstring		wstrProductVersion,
					xsd__wstring		wstrProductDisplName,
					xsd__wstring		wstrProductDisplVersion,
					xsd__wstring		wstrRequestId,
					struct klpkg_RecordNewPackageAsyncResponse&r)
{
	void *funcPtr = KLSTRT::GetFunctionPtrByName(L"klpkg_RecordNewPackageAsync");
	if ( funcPtr==NULL ) return SOAP_NO_METHOD;
	else return ((klpkg_RecordNewPackageAsyncFuncDef)funcPtr)(soap,wstrName,wstrFolder,wstrProductName,wstrProductVersion,wstrProductDisplName,wstrProductDisplVersion,wstrRequestId,r);
}

typedef int (* klpkg_GetPackageInfoFuncDef)( struct soap *soap, 
                    xsd__int		    nPackageId,
					struct klpkg_GetPackageInfoResponse&r);

int klpkg_GetPackageInfo( struct soap *soap, 
                    xsd__int		    nPackageId,
					struct klpkg_GetPackageInfoResponse&r)
{
	void *funcPtr = KLSTRT::GetFunctionPtrByName(L"klpkg_GetPackageInfo");
	if ( funcPtr==NULL ) return SOAP_NO_METHOD;
	else return ((klpkg_GetPackageInfoFuncDef)funcPtr)(soap,nPackageId,r);
}

typedef int (* klpkg_GetIncompatibleAppsInfoFuncDef)( struct soap *soap, 
                    xsd__int			nPackageId,
					struct klpkg_GetIncompatibleAppsInfoResponse&r);

int klpkg_GetIncompatibleAppsInfo( struct soap *soap, 
                    xsd__int			nPackageId,
					struct klpkg_GetIncompatibleAppsInfoResponse&r)
{
	void *funcPtr = KLSTRT::GetFunctionPtrByName(L"klpkg_GetIncompatibleAppsInfo");
	if ( funcPtr==NULL ) return SOAP_NO_METHOD;
	else return ((klpkg_GetIncompatibleAppsInfoFuncDef)funcPtr)(soap,nPackageId,r);
}

typedef int (* klpkg_SetRemoveIncompatibleAppsFuncDef)( struct soap *soap, 
                    xsd__int		    nPackageId,
					xsd__boolean		bRemoveIncompatibleApps,
					struct klpkg_SetRemoveIncompatibleAppsResponse&r);

int klpkg_SetRemoveIncompatibleApps( struct soap *soap, 
                    xsd__int		    nPackageId,
					xsd__boolean		bRemoveIncompatibleApps,
					struct klpkg_SetRemoveIncompatibleAppsResponse&r)
{
	void *funcPtr = KLSTRT::GetFunctionPtrByName(L"klpkg_SetRemoveIncompatibleApps");
	if ( funcPtr==NULL ) return SOAP_NO_METHOD;
	else return ((klpkg_SetRemoveIncompatibleAppsFuncDef)funcPtr)(soap,nPackageId,bRemoveIncompatibleApps,r);
}

typedef int (* klrpt_GetReportTypesFuncDef)( struct soap *soap, 
    void* _,
	struct klrpt_GetReportTypesResponse&r );

int klrpt_GetReportTypes( struct soap *soap, 
    void* _,
	struct klrpt_GetReportTypesResponse&r )
{
	void *funcPtr = KLSTRT::GetFunctionPtrByName(L"klrpt_GetReportTypes");
	if ( funcPtr==NULL ) return SOAP_NO_METHOD;
	else return ((klrpt_GetReportTypesFuncDef)funcPtr)(soap, _,r);
}

typedef int (* klrpt_GetReportTypeDetailedDataFuncDef)( struct soap *soap, 
    xsd__int        reportType,
	struct klrpt_GetReportTypeDetailedDataResponse&r );

int klrpt_GetReportTypeDetailedData( struct soap *soap, 
    xsd__int        reportType,
	struct klrpt_GetReportTypeDetailedDataResponse&r )
{
	void *funcPtr = KLSTRT::GetFunctionPtrByName(L"klrpt_GetReportTypeDetailedData");
	if ( funcPtr==NULL ) return SOAP_NO_METHOD;
	else return ((klrpt_GetReportTypeDetailedDataFuncDef)funcPtr)(soap,reportType,r);
}

typedef int (* klrpt_GetReportIdsFuncDef)( struct soap *soap, 
    void* _,
	struct klrpt_GetReportIdsResponse&r );

int klrpt_GetReportIds( struct soap *soap, 
    void* _,
	struct klrpt_GetReportIdsResponse&r )
{
	void *funcPtr = KLSTRT::GetFunctionPtrByName(L"klrpt_GetReportIds");
	if ( funcPtr==NULL ) return SOAP_NO_METHOD;
	else return ((klrpt_GetReportIdsFuncDef)funcPtr)(soap, _,r);
}

typedef int (* klrpt_GetReportsFuncDef)( struct soap *soap, 
    void* _,
	struct klrpt_GetReportsResponse&r );

int klrpt_GetReports( struct soap *soap, 
    void* _,
	struct klrpt_GetReportsResponse&r )
{
	void *funcPtr = KLSTRT::GetFunctionPtrByName(L"klrpt_GetReports");
	if ( funcPtr==NULL ) return SOAP_NO_METHOD;
	else return ((klrpt_GetReportsFuncDef)funcPtr)(soap, _,r);
}

typedef int (* klrpt_GetReportCommonDataFuncDef)( struct soap *soap, 
    xsd__int  reportId,
	struct klrpt_GetReportCommonDataResponse&r );

int klrpt_GetReportCommonData( struct soap *soap, 
    xsd__int  reportId,
	struct klrpt_GetReportCommonDataResponse&r )
{
	void *funcPtr = KLSTRT::GetFunctionPtrByName(L"klrpt_GetReportCommonData");
	if ( funcPtr==NULL ) return SOAP_NO_METHOD;
	else return ((klrpt_GetReportCommonDataFuncDef)funcPtr)(soap,reportId,r);
}

typedef int (* klrpt_GetReportDetailedDataFuncDef)( struct soap *soap, 
    xsd__int        reportId,
	struct klrpt_GetReportDetailedDataResponse&r );

int klrpt_GetReportDetailedData( struct soap *soap, 
    xsd__int        reportId,
	struct klrpt_GetReportDetailedDataResponse&r )
{
	void *funcPtr = KLSTRT::GetFunctionPtrByName(L"klrpt_GetReportDetailedData");
	if ( funcPtr==NULL ) return SOAP_NO_METHOD;
	else return ((klrpt_GetReportDetailedDataFuncDef)funcPtr)(soap,reportId,r);
}

typedef int (* klrpt_AddReportFuncDef)( struct soap *soap, 
    struct klrpt_common    commonData,
    struct klrpt_details   details,
    struct klrpt_AddReportResponse&r );

int klrpt_AddReport( struct soap *soap, 
    struct klrpt_common    commonData,
    struct klrpt_details   details,
    struct klrpt_AddReportResponse&r )
{
	void *funcPtr = KLSTRT::GetFunctionPtrByName(L"klrpt_AddReport");
	if ( funcPtr==NULL ) return SOAP_NO_METHOD;
	else return ((klrpt_AddReportFuncDef)funcPtr)(soap,commonData,details,r);
}

typedef int (* klrpt_UpdateReportFuncDef)( struct soap *soap, 
    struct klrpt_common    commonData,
    struct klrpt_details   details,
    struct klrpt_UpdateReportResponse&r );

int klrpt_UpdateReport( struct soap *soap, 
    struct klrpt_common    commonData,
    struct klrpt_details   details,
    struct klrpt_UpdateReportResponse&r )
{
	void *funcPtr = KLSTRT::GetFunctionPtrByName(L"klrpt_UpdateReport");
	if ( funcPtr==NULL ) return SOAP_NO_METHOD;
	else return ((klrpt_UpdateReportFuncDef)funcPtr)(soap,commonData,details,r);
}

typedef int (* klrpt_DeleteReportFuncDef)( struct soap *soap, 
    xsd__int                reportId,
    struct klrpt_DeleteReportResponse&r );

int klrpt_DeleteReport( struct soap *soap, 
    xsd__int                reportId,
    struct klrpt_DeleteReportResponse&r )
{
	void *funcPtr = KLSTRT::GetFunctionPtrByName(L"klrpt_DeleteReport");
	if ( funcPtr==NULL ) return SOAP_NO_METHOD;
	else return ((klrpt_DeleteReportFuncDef)funcPtr)(soap,reportId,r);
}

typedef int (* klrpt_ExecuteReportFuncDef)( struct soap *soap, 
    xsd__int                reportId,
    struct klrpt_input      input,
    struct klrpt_ExecuteReportResponse&r );

int klrpt_ExecuteReport( struct soap *soap, 
    xsd__int                reportId,
    struct klrpt_input      input,
    struct klrpt_ExecuteReportResponse&r )
{
	void *funcPtr = KLSTRT::GetFunctionPtrByName(L"klrpt_ExecuteReport");
	if ( funcPtr==NULL ) return SOAP_NO_METHOD;
	else return ((klrpt_ExecuteReportFuncDef)funcPtr)(soap,reportId,input,r);
}

typedef int (* klrpt_GetConstantOutputForReportTypeFuncDef)( struct soap *soap, 
    xsd__int                reportType,
    xsd__int                xmlTargetType,
    struct klrpt_GetConstantOutputForReportTypeResponse&r );

int klrpt_GetConstantOutputForReportType( struct soap *soap, 
    xsd__int                reportType,
    xsd__int                xmlTargetType,
    struct klrpt_GetConstantOutputForReportTypeResponse&r )
{
	void *funcPtr = KLSTRT::GetFunctionPtrByName(L"klrpt_GetConstantOutputForReportType");
	if ( funcPtr==NULL ) return SOAP_NO_METHOD;
	else return ((klrpt_GetConstantOutputForReportTypeFuncDef)funcPtr)(soap,reportType,xmlTargetType,r);
}

typedef int (* klrpt_CreateDefaultReportDataFuncDef)( struct soap *soap, 
    xsd__int                reportType,
    struct klrpt_CreateDefaultReportDataResponse&r );

int klrpt_CreateDefaultReportData( struct soap *soap, 
    xsd__int                reportType,
    struct klrpt_CreateDefaultReportDataResponse&r )
{
	void *funcPtr = KLSTRT::GetFunctionPtrByName(L"klrpt_CreateDefaultReportData");
	if ( funcPtr==NULL ) return SOAP_NO_METHOD;
	else return ((klrpt_CreateDefaultReportDataFuncDef)funcPtr)(soap,reportType,r);
}

typedef int (* klrpt_ExecuteReportAsyncFuncDef)( struct soap *soap, 
    xsd__int                reportId,
    xsd__wstring			wstrAsyncRequestId,
    struct klrpt_input      input,
    struct klrpt_ExecuteReportAsyncResponse&r );

int klrpt_ExecuteReportAsync( struct soap *soap, 
    xsd__int                reportId,
    xsd__wstring			wstrAsyncRequestId,
    struct klrpt_input      input,
    struct klrpt_ExecuteReportAsyncResponse&r )
{
	void *funcPtr = KLSTRT::GetFunctionPtrByName(L"klrpt_ExecuteReportAsync");
	if ( funcPtr==NULL ) return SOAP_NO_METHOD;
	else return ((klrpt_ExecuteReportAsyncFuncDef)funcPtr)(soap,reportId,wstrAsyncRequestId,input,r);
}

typedef int (* klrpt_ExecuteReportAsyncCancelFuncDef)( struct soap *soap, 
    xsd__wstring			wstrAsyncRequestId,
    struct klrpt_ExecuteReportAsyncCancelResponse&r );

int klrpt_ExecuteReportAsyncCancel( struct soap *soap, 
    xsd__wstring			wstrAsyncRequestId,
    struct klrpt_ExecuteReportAsyncCancelResponse&r )
{
	void *funcPtr = KLSTRT::GetFunctionPtrByName(L"klrpt_ExecuteReportAsyncCancel");
	if ( funcPtr==NULL ) return SOAP_NO_METHOD;
	else return ((klrpt_ExecuteReportAsyncCancelFuncDef)funcPtr)(soap,wstrAsyncRequestId,r);
}

typedef int (* klrpt_ExecuteReportAsyncGetDataFuncDef)( struct soap *soap, 
    xsd__wstring			wstrAsyncRequestId,
    xsd__int                nMaxDataChunkSize,
    struct klrpt_ExecuteReportAsyncGetDataResponse&r );

int klrpt_ExecuteReportAsyncGetData( struct soap *soap, 
    xsd__wstring			wstrAsyncRequestId,
    xsd__int                nMaxDataChunkSize,
    struct klrpt_ExecuteReportAsyncGetDataResponse&r )
{
	void *funcPtr = KLSTRT::GetFunctionPtrByName(L"klrpt_ExecuteReportAsyncGetData");
	if ( funcPtr==NULL ) return SOAP_NO_METHOD;
	else return ((klrpt_ExecuteReportAsyncGetDataFuncDef)funcPtr)(soap,wstrAsyncRequestId,nMaxDataChunkSize,r);
}

typedef int (* klrpt_ExecuteSlaveReportAsyncFuncDef)( struct soap *soap, 
    struct klrpt_common		commonData,
    struct klrpt_details	details,
	param__params			paramLocalData,
    xsd__wstring			wstrAsyncRequestId,
	xsd__int				nTimeoutInSec,
    struct klrpt_ExecuteSlaveReportAsyncResponse&r );

int klrpt_ExecuteSlaveReportAsync( struct soap *soap, 
    struct klrpt_common		commonData,
    struct klrpt_details	details,
	param__params			paramLocalData,
    xsd__wstring			wstrAsyncRequestId,
	xsd__int				nTimeoutInSec,
    struct klrpt_ExecuteSlaveReportAsyncResponse&r )
{
	void *funcPtr = KLSTRT::GetFunctionPtrByName(L"klrpt_ExecuteSlaveReportAsync");
	if ( funcPtr==NULL ) return SOAP_NO_METHOD;
	else return ((klrpt_ExecuteSlaveReportAsyncFuncDef)funcPtr)(soap,commonData,details,paramLocalData,wstrAsyncRequestId,nTimeoutInSec,r);
}

typedef int (* klrpt_ExecuteSlaveReportAsyncCancelFuncDef)( struct soap *soap, 
    xsd__wstring			wstrAsyncRequestId,
    struct klrpt_ExecuteSlaveReportAsyncCancelResponse&r );

int klrpt_ExecuteSlaveReportAsyncCancel( struct soap *soap, 
    xsd__wstring			wstrAsyncRequestId,
    struct klrpt_ExecuteSlaveReportAsyncCancelResponse&r )
{
	void *funcPtr = KLSTRT::GetFunctionPtrByName(L"klrpt_ExecuteSlaveReportAsyncCancel");
	if ( funcPtr==NULL ) return SOAP_NO_METHOD;
	else return ((klrpt_ExecuteSlaveReportAsyncCancelFuncDef)funcPtr)(soap,wstrAsyncRequestId,r);
}

typedef int (* klrpt_ExecuteSlaveReportAsyncGetDataFuncDef)( struct soap *soap, 
    xsd__wstring			wstrAsyncRequestId,
	xsd__int				nRecordsCount,
    struct klrpt_ExecuteSlaveReportAsyncGetDataResponse&r );

int klrpt_ExecuteSlaveReportAsyncGetData( struct soap *soap, 
    xsd__wstring			wstrAsyncRequestId,
	xsd__int				nRecordsCount,
    struct klrpt_ExecuteSlaveReportAsyncGetDataResponse&r )
{
	void *funcPtr = KLSTRT::GetFunctionPtrByName(L"klrpt_ExecuteSlaveReportAsyncGetData");
	if ( funcPtr==NULL ) return SOAP_NO_METHOD;
	else return ((klrpt_ExecuteSlaveReportAsyncGetDataFuncDef)funcPtr)(soap,wstrAsyncRequestId,nRecordsCount,r);
}

typedef int (* klrpt_RequestStatisticsDataFuncDef)( struct soap *soap, 
	param__params	paramRequestParams,
    xsd__wstring	wstrRequestId,
    struct klrpt_RequestStatisticsDataResponse&r );

int klrpt_RequestStatisticsData( struct soap *soap, 
	param__params	paramRequestParams,
    xsd__wstring	wstrRequestId,
    struct klrpt_RequestStatisticsDataResponse&r )
{
	void *funcPtr = KLSTRT::GetFunctionPtrByName(L"klrpt_RequestStatisticsData");
	if ( funcPtr==NULL ) return SOAP_NO_METHOD;
	else return ((klrpt_RequestStatisticsDataFuncDef)funcPtr)(soap,paramRequestParams,wstrRequestId,r);
}

typedef int (* klrpt_CancelStatisticsRequestFuncDef)( struct soap *soap, 
    xsd__wstring	wstrRequestId,
    struct klrpt_CancelStatisticsRequestResponse&r );

int klrpt_CancelStatisticsRequest( struct soap *soap, 
    xsd__wstring	wstrRequestId,
    struct klrpt_CancelStatisticsRequestResponse&r )
{
	void *funcPtr = KLSTRT::GetFunctionPtrByName(L"klrpt_CancelStatisticsRequest");
	if ( funcPtr==NULL ) return SOAP_NO_METHOD;
	else return ((klrpt_CancelStatisticsRequestFuncDef)funcPtr)(soap,wstrRequestId,r);
}

typedef int (* klrpt_GetStatisticsDataFuncDef)( struct soap *soap, 
    xsd__wstring	wstrRequestId,
    struct klrpt_GetStatisticsDataResponse&r );

int klrpt_GetStatisticsData( struct soap *soap, 
    xsd__wstring	wstrRequestId,
    struct klrpt_GetStatisticsDataResponse&r )
{
	void *funcPtr = KLSTRT::GetFunctionPtrByName(L"klrpt_GetStatisticsData");
	if ( funcPtr==NULL ) return SOAP_NO_METHOD;
	else return ((klrpt_GetStatisticsDataFuncDef)funcPtr)(soap,wstrRequestId,r);
}

typedef int (* klrpt_GetFilterSettingsFuncDef)( struct soap *soap, 
    xsd__int                reportType,
    struct klrpt_GetFilterSettingsResponse&r );

int klrpt_GetFilterSettings( struct soap *soap, 
    xsd__int                reportType,
    struct klrpt_GetFilterSettingsResponse&r )
{
	void *funcPtr = KLSTRT::GetFunctionPtrByName(L"klrpt_GetFilterSettings");
	if ( funcPtr==NULL ) return SOAP_NO_METHOD;
	else return ((klrpt_GetFilterSettingsFuncDef)funcPtr)(soap,reportType,r);
}

typedef int (* klrpt_ExecuteReportAsyncCancelWaitingForSlavesFuncDef)( struct soap *soap, 
    xsd__wstring			wstrAsyncRequestId,
    struct klrpt_ExecuteReportAsyncCancelWaitingForSlavesResponse&r );

int klrpt_ExecuteReportAsyncCancelWaitingForSlaves( struct soap *soap, 
    xsd__wstring			wstrAsyncRequestId,
    struct klrpt_ExecuteReportAsyncCancelWaitingForSlavesResponse&r )
{
	void *funcPtr = KLSTRT::GetFunctionPtrByName(L"klrpt_ExecuteReportAsyncCancelWaitingForSlaves");
	if ( funcPtr==NULL ) return SOAP_NO_METHOD;
	else return ((klrpt_ExecuteReportAsyncCancelWaitingForSlavesFuncDef)funcPtr)(soap,wstrAsyncRequestId,r);
}

typedef int (* klrpt_ResetStatisticsDataFuncDef)( struct soap *soap, 
	param__params	paramRequestParams,
    struct klrpt_ResetStatisticsDataResponse&r );

int klrpt_ResetStatisticsData( struct soap *soap, 
	param__params	paramRequestParams,
    struct klrpt_ResetStatisticsDataResponse&r )
{
	void *funcPtr = KLSTRT::GetFunctionPtrByName(L"klrpt_ResetStatisticsData");
	if ( funcPtr==NULL ) return SOAP_NO_METHOD;
	else return ((klrpt_ResetStatisticsDataFuncDef)funcPtr)(soap,paramRequestParams,r);
}

typedef int (* klsrvh_GetChildServersFuncDef)( struct soap *soap, 
	xsd__int nGroupId,
	struct klsrvh_GetChildServersResponse&r);

int klsrvh_GetChildServers( struct soap *soap, 
	xsd__int nGroupId,
	struct klsrvh_GetChildServersResponse&r)
{
	void *funcPtr = KLSTRT::GetFunctionPtrByName(L"klsrvh_GetChildServers");
	if ( funcPtr==NULL ) return SOAP_NO_METHOD;
	else return ((klsrvh_GetChildServersFuncDef)funcPtr)(soap,nGroupId,r);
}

typedef int (* klsrvh_GetServerInfoFuncDef)( struct soap *soap, 
	xsd__int nId,
	klsrvh_wstrings	fields,
	struct klsrvh_GetServerInfoResponse&r);

int klsrvh_GetServerInfo( struct soap *soap, 
	xsd__int nId,
	klsrvh_wstrings	fields,
	struct klsrvh_GetServerInfoResponse&r)
{
	void *funcPtr = KLSTRT::GetFunctionPtrByName(L"klsrvh_GetServerInfo");
	if ( funcPtr==NULL ) return SOAP_NO_METHOD;
	else return ((klsrvh_GetServerInfoFuncDef)funcPtr)(soap,nId,fields,r);
}

typedef int (* klsrvh_RegisterServerFuncDef)( struct soap *soap, 
	param__params	baseInfo,
	param__params	addInfo,
	struct klsrvh_RegisterServerResponse&r);

int klsrvh_RegisterServer( struct soap *soap, 
	param__params	baseInfo,
	param__params	addInfo,
	struct klsrvh_RegisterServerResponse&r)
{
	void *funcPtr = KLSTRT::GetFunctionPtrByName(L"klsrvh_RegisterServer");
	if ( funcPtr==NULL ) return SOAP_NO_METHOD;
	else return ((klsrvh_RegisterServerFuncDef)funcPtr)(soap,baseInfo,addInfo,r);
}

typedef int (* klsrvh_DelServerFuncDef)( struct soap *soap, 
	xsd__int	nId,
	struct klsrvh_DelServerResponse&r);

int klsrvh_DelServer( struct soap *soap, 
	xsd__int	nId,
	struct klsrvh_DelServerResponse&r)
{
	void *funcPtr = KLSTRT::GetFunctionPtrByName(L"klsrvh_DelServer");
	if ( funcPtr==NULL ) return SOAP_NO_METHOD;
	else return ((klsrvh_DelServerFuncDef)funcPtr)(soap,nId,r);
}

typedef int (* klsrvh_UpdateServerFuncDef)( struct soap *soap, 
	  xsd__int		nId,
	  param__params	info,
	  struct klsrvh_UpdateServerResponse&r);

int klsrvh_UpdateServer( struct soap *soap, 
	  xsd__int		nId,
	  param__params	info,
	  struct klsrvh_UpdateServerResponse&r)
{
	void *funcPtr = KLSTRT::GetFunctionPtrByName(L"klsrvh_UpdateServer");
	if ( funcPtr==NULL ) return SOAP_NO_METHOD;
	else return ((klsrvh_UpdateServerFuncDef)funcPtr)(soap,nId,info,r);
}

typedef int (* klsrvh_InitialPingMasterFuncDef)( struct soap *soap, 
	param__params	info,
	struct klsrvh_InitialPingMasterResponse&r);

int klsrvh_InitialPingMaster( struct soap *soap, 
	param__params	info,
	struct klsrvh_InitialPingMasterResponse&r)
{
	void *funcPtr = KLSTRT::GetFunctionPtrByName(L"klsrvh_InitialPingMaster");
	if ( funcPtr==NULL ) return SOAP_NO_METHOD;
	else return ((klsrvh_InitialPingMasterFuncDef)funcPtr)(soap,info,r);
}

typedef int (* klsrvh_PingMasterFuncDef)( struct soap *soap, 
	param__params	info,
	struct klsrvh_PingMasterResponse&r);

int klsrvh_PingMaster( struct soap *soap, 
	param__params	info,
	struct klsrvh_PingMasterResponse&r)
{
	void *funcPtr = KLSTRT::GetFunctionPtrByName(L"klsrvh_PingMaster");
	if ( funcPtr==NULL ) return SOAP_NO_METHOD;
	else return ((klsrvh_PingMasterFuncDef)funcPtr)(soap,info,r);
}

typedef int (* klsrvh_PingSlaveFuncDef)( struct soap *soap, 
	param__params	info,
	struct klsrvh_PingSlaveResponse&r);

int klsrvh_PingSlave( struct soap *soap, 
	param__params	info,
	struct klsrvh_PingSlaveResponse&r)
{
	void *funcPtr = KLSTRT::GetFunctionPtrByName(L"klsrvh_PingSlave");
	if ( funcPtr==NULL ) return SOAP_NO_METHOD;
	else return ((klsrvh_PingSlaveFuncDef)funcPtr)(soap,info,r);
}

typedef int (* klsrvh_ForceRetranslateUpdatesFuncDef)( struct soap *soap, 
	param__params	info,
	struct klsrvh_ForceRetranslateUpdatesResponse&r);

int klsrvh_ForceRetranslateUpdates( struct soap *soap, 
	param__params	info,
	struct klsrvh_ForceRetranslateUpdatesResponse&r)
{
	void *funcPtr = KLSTRT::GetFunctionPtrByName(L"klsrvh_ForceRetranslateUpdates");
	if ( funcPtr==NULL ) return SOAP_NO_METHOD;
	else return ((klsrvh_ForceRetranslateUpdatesFuncDef)funcPtr)(soap,info,r);
}

typedef int (* klsrvh_DeliverReportFuncDef)( struct soap *soap, 
	xsd__wstring wstrRequestId,
	xsd__int nRecipientDeliverLevel,
	xsd__int nSenderDeliverLevel,
	xsd__wstring wstrSenderInstanceId,
	param__params parDeliveryParams,
	param__params parReportResult,
	struct klsrvh_DeliverReportResponse&r);

int klsrvh_DeliverReport( struct soap *soap, 
	xsd__wstring wstrRequestId,
	xsd__int nRecipientDeliverLevel,
	xsd__int nSenderDeliverLevel,
	xsd__wstring wstrSenderInstanceId,
	param__params parDeliveryParams,
	param__params parReportResult,
	struct klsrvh_DeliverReportResponse&r)
{
	void *funcPtr = KLSTRT::GetFunctionPtrByName(L"klsrvh_DeliverReport");
	if ( funcPtr==NULL ) return SOAP_NO_METHOD;
	else return ((klsrvh_DeliverReportFuncDef)funcPtr)(soap,wstrRequestId,nRecipientDeliverLevel,nSenderDeliverLevel,wstrSenderInstanceId,parDeliveryParams,parReportResult,r);
}

typedef int (* klsrvh_RecreateInstallationPackageFuncDef)( struct soap *soap, 						
	xsd__wstring wstrPackageGUID,
	xsd__wstring wstrNewPackageName,
	xsd__wstring wstrFileId,
	xsd__wstring wstrProductName,
	xsd__wstring wstrProductVersion,
	xsd__wstring wstrProductDisplName,
	xsd__wstring wstrProductDisplVersion,
	xsd__boolean bReplaceExisting,
	struct klsrvh_RecreateInstallationPackageResponse&r);

int klsrvh_RecreateInstallationPackage( struct soap *soap, 						
	xsd__wstring wstrPackageGUID,
	xsd__wstring wstrNewPackageName,
	xsd__wstring wstrFileId,
	xsd__wstring wstrProductName,
	xsd__wstring wstrProductVersion,
	xsd__wstring wstrProductDisplName,
	xsd__wstring wstrProductDisplVersion,
	xsd__boolean bReplaceExisting,
	struct klsrvh_RecreateInstallationPackageResponse&r)
{
	void *funcPtr = KLSTRT::GetFunctionPtrByName(L"klsrvh_RecreateInstallationPackage");
	if ( funcPtr==NULL ) return SOAP_NO_METHOD;
	else return ((klsrvh_RecreateInstallationPackageFuncDef)funcPtr)(soap,wstrPackageGUID,wstrNewPackageName,wstrFileId,wstrProductName,wstrProductVersion,wstrProductDisplName,wstrProductDisplVersion,bReplaceExisting,r);
}

typedef int (* klsrvh_StartTaskFuncDef)( struct soap *soap, 
	xsd__wstring wstrTaskTsId,
	xsd__wstring wstrTaskTypeName,
	param__params	parParams,
	struct klsrvh_StartTaskResponse&r);

int klsrvh_StartTask( struct soap *soap, 
	xsd__wstring wstrTaskTsId,
	xsd__wstring wstrTaskTypeName,
	param__params	parParams,
	struct klsrvh_StartTaskResponse&r)
{
	void *funcPtr = KLSTRT::GetFunctionPtrByName(L"klsrvh_StartTask");
	if ( funcPtr==NULL ) return SOAP_NO_METHOD;
	else return ((klsrvh_StartTaskFuncDef)funcPtr)(soap,wstrTaskTsId,wstrTaskTypeName,parParams,r);
}

typedef int (* klsrvh_StartRemoteInstallationFuncDef)( struct soap *soap, 						
	param__params parTaskInfo,
	param__params parTaskParams,
	struct klsrvh_StartRemoteInstallationResponse&r);

int klsrvh_StartRemoteInstallation( struct soap *soap, 						
	param__params parTaskInfo,
	param__params parTaskParams,
	struct klsrvh_StartRemoteInstallationResponse&r)
{
	void *funcPtr = KLSTRT::GetFunctionPtrByName(L"klsrvh_StartRemoteInstallation");
	if ( funcPtr==NULL ) return SOAP_NO_METHOD;
	else return ((klsrvh_StartRemoteInstallationFuncDef)funcPtr)(soap,parTaskInfo,parTaskParams,r);
}

typedef int (* klsrvh_ReportRemoteInstallationResultFuncDef)( struct soap *soap, 						
	xsd__wstring wstrTaskTsId,
	param__params parResultTaskStateEvent,
	struct klsrvh_ReportRemoteInstallationResultResponse&r);

int klsrvh_ReportRemoteInstallationResult( struct soap *soap, 						
	xsd__wstring wstrTaskTsId,
	param__params parResultTaskStateEvent,
	struct klsrvh_ReportRemoteInstallationResultResponse&r)
{
	void *funcPtr = KLSTRT::GetFunctionPtrByName(L"klsrvh_ReportRemoteInstallationResult");
	if ( funcPtr==NULL ) return SOAP_NO_METHOD;
	else return ((klsrvh_ReportRemoteInstallationResultFuncDef)funcPtr)(soap,wstrTaskTsId,parResultTaskStateEvent,r);
}

typedef int (* klsrvh_NotifyOnReportResultFuncDef)( struct soap *soap, 
    xsd__wstring	wstrRequestId,
	xsd__int		nResultCode,
	param__params	paramParams,
    struct klsrvh_NotifyOnReportResultResponse&r );

int klsrvh_NotifyOnReportResult( struct soap *soap, 
    xsd__wstring	wstrRequestId,
	xsd__int		nResultCode,
	param__params	paramParams,
    struct klsrvh_NotifyOnReportResultResponse&r )
{
	void *funcPtr = KLSTRT::GetFunctionPtrByName(L"klsrvh_NotifyOnReportResult");
	if ( funcPtr==NULL ) return SOAP_NO_METHOD;
	else return ((klsrvh_NotifyOnReportResultFuncDef)funcPtr)(soap,wstrRequestId,nResultCode,paramParams,r);
}

typedef int (* klsrvh_FindSlaveServersFuncDef)( struct soap *soap, 
                    xsd__wstring	            wstrFilter,
					klgrp_wstrings	            arrFields,
					klgrp_field_order_array     arrFieldsToOrder,
					param__params				params,
					xsd__int		            lTimeout,
                    xsd__wstring	            wstrRequestId,
					struct klsrvh_FindSlaveServersResponse& r);

int klsrvh_FindSlaveServers( struct soap *soap, 
                    xsd__wstring	            wstrFilter,
					klgrp_wstrings	            arrFields,
					klgrp_field_order_array     arrFieldsToOrder,
					param__params				params,
					xsd__int		            lTimeout,
                    xsd__wstring	            wstrRequestId,
					struct klsrvh_FindSlaveServersResponse& r)
{
	void *funcPtr = KLSTRT::GetFunctionPtrByName(L"klsrvh_FindSlaveServers");
	if ( funcPtr==NULL ) return SOAP_NO_METHOD;
	else return ((klsrvh_FindSlaveServersFuncDef)funcPtr)(soap,wstrFilter,arrFields,arrFieldsToOrder,params,lTimeout,wstrRequestId, r);
}

typedef int (* klsrvs_GetSharedFolderFuncDef)( struct soap *soap,  
					void* _,
					struct klsrvs_GetSharedFolderResponse&r);

int klsrvs_GetSharedFolder( struct soap *soap,  
					void* _,
					struct klsrvs_GetSharedFolderResponse&r)
{
	void *funcPtr = KLSTRT::GetFunctionPtrByName(L"klsrvs_GetSharedFolder");
	if ( funcPtr==NULL ) return SOAP_NO_METHOD;
	else return ((klsrvs_GetSharedFolderFuncDef)funcPtr)(soap, _,r);
}

typedef int (* klsrvs_ChangeSharedFolderFuncDef)( struct soap *soap, 
					xsd__wstring		wstrFolder,
					struct klsrvs_ChangeSharedFolderResponse&r);

int klsrvs_ChangeSharedFolder( struct soap *soap, 
					xsd__wstring		wstrFolder,
					struct klsrvs_ChangeSharedFolderResponse&r)
{
	void *funcPtr = KLSTRT::GetFunctionPtrByName(L"klsrvs_ChangeSharedFolder");
	if ( funcPtr==NULL ) return SOAP_NO_METHOD;
	else return ((klsrvs_ChangeSharedFolderFuncDef)funcPtr)(soap,wstrFolder,r);
}

typedef int (* klnlst_ResetIteratorFuncDef)( struct soap *soap, 
        xsd__wstring		        listName,
        param__params		        paramIteratorDescr,
		klnlst_wstring_array		fields,
		klnlst_field_order_array	fields_to_order,
		xsd__int					lifetime,
		struct klnlst_ResetIteratorResponse&r);

int klnlst_ResetIterator( struct soap *soap, 
        xsd__wstring		        listName,
        param__params		        paramIteratorDescr,
		klnlst_wstring_array		fields,
		klnlst_field_order_array	fields_to_order,
		xsd__int					lifetime,
		struct klnlst_ResetIteratorResponse&r)
{
	void *funcPtr = KLSTRT::GetFunctionPtrByName(L"klnlst_ResetIterator");
	if ( funcPtr==NULL ) return SOAP_NO_METHOD;
	else return ((klnlst_ResetIteratorFuncDef)funcPtr)(soap,listName,paramIteratorDescr,fields,fields_to_order,lifetime,r);
}

typedef int (* klnlst_GetRecordCountFuncDef)( struct soap *soap, 
		xsd__wstring	iteratorId,
		struct klnlst_GetRecordCountResponse&r);

int klnlst_GetRecordCount( struct soap *soap, 
		xsd__wstring	iteratorId,
		struct klnlst_GetRecordCountResponse&r)
{
	void *funcPtr = KLSTRT::GetFunctionPtrByName(L"klnlst_GetRecordCount");
	if ( funcPtr==NULL ) return SOAP_NO_METHOD;
	else return ((klnlst_GetRecordCountFuncDef)funcPtr)(soap,iteratorId,r);
}

typedef int (* klnlst_GetRecordRangeFuncDef)( struct soap *soap, 
		xsd__wstring	iteratorId,
		xsd__int		nStart,
        xsd__int		nEnd,
		struct klnlst_GetRecordRangeResponse&r);

int klnlst_GetRecordRange( struct soap *soap, 
		xsd__wstring	iteratorId,
		xsd__int		nStart,
        xsd__int		nEnd,
		struct klnlst_GetRecordRangeResponse&r)
{
	void *funcPtr = KLSTRT::GetFunctionPtrByName(L"klnlst_GetRecordRange");
	if ( funcPtr==NULL ) return SOAP_NO_METHOD;
	else return ((klnlst_GetRecordRangeFuncDef)funcPtr)(soap,iteratorId,nStart,nEnd,r);
}

typedef int (* klnlst_ReleaseIteratorFuncDef)( struct soap *soap, 
		xsd__wstring	iteratorId,
		struct klnlst_ReleaseIteratorResponse&r);

int klnlst_ReleaseIterator( struct soap *soap, 
		xsd__wstring	iteratorId,
		struct klnlst_ReleaseIteratorResponse&r)
{
	void *funcPtr = KLSTRT::GetFunctionPtrByName(L"klnlst_ReleaseIterator");
	if ( funcPtr==NULL ) return SOAP_NO_METHOD;
	else return ((klnlst_ReleaseIteratorFuncDef)funcPtr)(soap,iteratorId,r);
}

typedef int (* klnlst_UpdateHostNetworkListFuncDef)( struct soap *soap, 
		xsd__wstring					nagentTransportName,
		xsd__wstring					listName,
		xsd__wstring					listComponentName,
		klnlst_network_list_item_array	listsItemsArray,
		struct klnlst_UpdateHostNetworkListResponse&r);

int klnlst_UpdateHostNetworkList( struct soap *soap, 
		xsd__wstring					nagentTransportName,
		xsd__wstring					listName,
		xsd__wstring					listComponentName,
		klnlst_network_list_item_array	listsItemsArray,
		struct klnlst_UpdateHostNetworkListResponse&r)
{
	void *funcPtr = KLSTRT::GetFunctionPtrByName(L"klnlst_UpdateHostNetworkList");
	if ( funcPtr==NULL ) return SOAP_NO_METHOD;
	else return ((klnlst_UpdateHostNetworkListFuncDef)funcPtr)(soap,nagentTransportName,listName,listComponentName,listsItemsArray,r);
}

typedef int (* klnlst_AddListItemTaskFuncDef)( struct soap *soap, 
		long						itemId,
		param__params				taskParams,
		xsd__wstring				taskName,
		struct klnlst_AddListItemTaskResponse&r);

int klnlst_AddListItemTask( struct soap *soap, 
		long						itemId,
		param__params				taskParams,
		xsd__wstring				taskName,
		struct klnlst_AddListItemTaskResponse&r)
{
	void *funcPtr = KLSTRT::GetFunctionPtrByName(L"klnlst_AddListItemTask");
	if ( funcPtr==NULL ) return SOAP_NO_METHOD;
	else return ((klnlst_AddListItemTaskFuncDef)funcPtr)(soap,itemId,taskParams,taskName,r);
}

typedef int (* klnlst_AddTaskForListItemsFuncDef)( struct soap *soap, 
		klnlst_long_array			itemsIds,
		param__params				taskParams,
		xsd__wstring				taskName,
		struct klnlst_AddTaskForListItemsResponse&r);

int klnlst_AddTaskForListItems( struct soap *soap, 
		klnlst_long_array			itemsIds,
		param__params				taskParams,
		xsd__wstring				taskName,
		struct klnlst_AddTaskForListItemsResponse&r)
{
	void *funcPtr = KLSTRT::GetFunctionPtrByName(L"klnlst_AddTaskForListItems");
	if ( funcPtr==NULL ) return SOAP_NO_METHOD;
	else return ((klnlst_AddTaskForListItemsFuncDef)funcPtr)(soap,itemsIds,taskParams,taskName,r);
}

typedef int (* klnlst_GetItemInfoFuncDef)( struct soap *soap, 
		long						itemId,		
		struct klnlst_GetItemInfoResponse&r);

int klnlst_GetItemInfo( struct soap *soap, 
		long						itemId,		
		struct klnlst_GetItemInfoResponse&r)
{
	void *funcPtr = KLSTRT::GetFunctionPtrByName(L"klnlst_GetItemInfo");
	if ( funcPtr==NULL ) return SOAP_NO_METHOD;
	else return ((klnlst_GetItemInfoFuncDef)funcPtr)(soap,itemId,r);
}

typedef int (* klnagnlst_CallNetworkListTaskFuncDef)( struct soap *soap, 
		xsd__wstring				listName,
		xsd__wstring				itemId,
		xsd__wstring				taskName,
		param__params				taskParams,
		struct klnagnlst_CallNetworkListTaskResponse&r);

int klnagnlst_CallNetworkListTask( struct soap *soap, 
		xsd__wstring				listName,
		xsd__wstring				itemId,
		xsd__wstring				taskName,
		param__params				taskParams,
		struct klnagnlst_CallNetworkListTaskResponse&r)
{
	void *funcPtr = KLSTRT::GetFunctionPtrByName(L"klnagnlst_CallNetworkListTask");
	if ( funcPtr==NULL ) return SOAP_NO_METHOD;
	else return ((klnagnlst_CallNetworkListTaskFuncDef)funcPtr)(soap,listName,itemId,taskName,taskParams,r);
}

typedef int (* klnagnlst_GetItemFileInfoFuncDef)( struct soap *soap, 
		xsd__wstring				listName,
		xsd__wstring				itemId,
		struct klnagnlst_GetItemFileInfoResponse&r);

int klnagnlst_GetItemFileInfo( struct soap *soap, 
		xsd__wstring				listName,
		xsd__wstring				itemId,
		struct klnagnlst_GetItemFileInfoResponse&r)
{
	void *funcPtr = KLSTRT::GetFunctionPtrByName(L"klnagnlst_GetItemFileInfo");
	if ( funcPtr==NULL ) return SOAP_NO_METHOD;
	else return ((klnagnlst_GetItemFileInfoFuncDef)funcPtr)(soap,listName,itemId,r);
}

typedef int (* klnagnlst_GetItemFileChunkFuncDef)( struct soap *soap, 
		xsd__wstring				listName,
		xsd__wstring				itemId,
		xsd__unsignedLong			startPos,
		xsd__unsignedLong			neededSize,
		struct klnagnlst_GetItemFileChunkResponse&r);

int klnagnlst_GetItemFileChunk( struct soap *soap, 
		xsd__wstring				listName,
		xsd__wstring				itemId,
		xsd__unsignedLong			startPos,
		xsd__unsignedLong			neededSize,
		struct klnagnlst_GetItemFileChunkResponse&r)
{
	void *funcPtr = KLSTRT::GetFunctionPtrByName(L"klnagnlst_GetItemFileChunk");
	if ( funcPtr==NULL ) return SOAP_NO_METHOD;
	else return ((klnagnlst_GetItemFileChunkFuncDef)funcPtr)(soap,listName,itemId,startPos,neededSize,r);
}

typedef int (* klft_GetNextFileChunkFuncDef)( struct soap *soap, 
						xsd__wstring	remoteClientName,
						xsd__wstring	fileName,
						xsd__wstring	fileId,
						xsd__unsignedLong	startFilePos,
						xsd__unsignedLong	neededSize,
						xsd__boolean		useUpdaterFolder,	
						xsd__boolean		forUpdateAgent,
						struct klft_GetNextFileChunkOptions *options,
						struct klft_GetNextFileChunkResponse
							&r );

int klft_GetNextFileChunk( struct soap *soap, 
						xsd__wstring	remoteClientName,
						xsd__wstring	fileName,
						xsd__wstring	fileId,
						xsd__unsignedLong	startFilePos,
						xsd__unsignedLong	neededSize,
						xsd__boolean		useUpdaterFolder,	
						xsd__boolean		forUpdateAgent,
						struct klft_GetNextFileChunkOptions *options,
						struct klft_GetNextFileChunkResponse
							&r )
{
	void *funcPtr = KLSTRT::GetFunctionPtrByName(L"klft_GetNextFileChunk");
	if ( funcPtr==NULL ) return SOAP_NO_METHOD;
	else return ((klft_GetNextFileChunkFuncDef)funcPtr)(soap,remoteClientName,fileName,fileId,startFilePos,neededSize,useUpdaterFolder,forUpdateAgent,options,r);
}

typedef int (* klft_GetServerFilesListFuncDef)( struct soap *soap, 
						xsd__wstring clientName,
						struct klft_GetServerFilesListResponse
							&r );

int klft_GetServerFilesList( struct soap *soap, 
						xsd__wstring clientName,
						struct klft_GetServerFilesListResponse
							&r )
{
	void *funcPtr = KLSTRT::GetFunctionPtrByName(L"klft_GetServerFilesList");
	if ( funcPtr==NULL ) return SOAP_NO_METHOD;
	else return ((klft_GetServerFilesListFuncDef)funcPtr)(soap,clientName,r);
}

typedef int (* klft_GetUpdaterFolderFileInfoFuncDef)( struct soap *soap, 
						xsd__wstring	fileName,
						struct klft_GetUpdaterFolderFileInfoOptions *options,
						struct klft_GetUpdaterFolderFileInfoResponse
							&r );

int klft_GetUpdaterFolderFileInfo( struct soap *soap, 
						xsd__wstring	fileName,
						struct klft_GetUpdaterFolderFileInfoOptions *options,
						struct klft_GetUpdaterFolderFileInfoResponse
							&r )
{
	void *funcPtr = KLSTRT::GetFunctionPtrByName(L"klft_GetUpdaterFolderFileInfo");
	if ( funcPtr==NULL ) return SOAP_NO_METHOD;
	else return ((klft_GetUpdaterFolderFileInfoFuncDef)funcPtr)(soap,fileName,options,r);
}

typedef int (* klft_GetFullFileInfoFuncDef)( struct soap *soap, 
						xsd__wstring	fileId,						
						struct klft_GetFullFileInfoResponse
							&r );

int klft_GetFullFileInfo( struct soap *soap, 
						xsd__wstring	fileId,						
						struct klft_GetFullFileInfoResponse
							&r )
{
	void *funcPtr = KLSTRT::GetFunctionPtrByName(L"klft_GetFullFileInfo");
	if ( funcPtr==NULL ) return SOAP_NO_METHOD;
	else return ((klft_GetFullFileInfoFuncDef)funcPtr)(soap,fileId,r);
}

typedef int (* klft_GetHostUpdateAgentInfoFuncDef)( struct soap *soap, 
						xsd__wstring	hostId,
						struct klft_GetHostUpdateAgentInfoResponse
							&r );

int klft_GetHostUpdateAgentInfo( struct soap *soap, 
						xsd__wstring	hostId,
						struct klft_GetHostUpdateAgentInfoResponse
							&r )
{
	void *funcPtr = KLSTRT::GetFunctionPtrByName(L"klft_GetHostUpdateAgentInfo");
	if ( funcPtr==NULL ) return SOAP_NO_METHOD;
	else return ((klft_GetHostUpdateAgentInfoFuncDef)funcPtr)(soap,hostId,r);
}

typedef int (* klft_SendToClientFullSyncArchiveFuncDef)( struct soap *soap, 
						xsd__wstring	remoteClientName,
						xsd__wstring	syncFolderFileId,
						xsd__boolean	fileNamesHashed,
						struct SOAPFilesInfoList *filesList,
						struct SOAPSyncFolderOptions *syncFolderOptions,
						struct klft_SendToClientFullSyncArchiveResponse
							&r );

int klft_SendToClientFullSyncArchive( struct soap *soap, 
						xsd__wstring	remoteClientName,
						xsd__wstring	syncFolderFileId,
						xsd__boolean	fileNamesHashed,
						struct SOAPFilesInfoList *filesList,
						struct SOAPSyncFolderOptions *syncFolderOptions,
						struct klft_SendToClientFullSyncArchiveResponse
							&r )
{
	void *funcPtr = KLSTRT::GetFunctionPtrByName(L"klft_SendToClientFullSyncArchive");
	if ( funcPtr==NULL ) return SOAP_NO_METHOD;
	else return ((klft_SendToClientFullSyncArchiveFuncDef)funcPtr)(soap,remoteClientName,syncFolderFileId,fileNamesHashed,filesList,syncFolderOptions,r);
}

typedef int (* klfts_RegisterUpdateAgentFuncDef)( struct soap *soap, 
						klfts_update_agent_info			updateAgentInfo,
						xsd__boolean					checkExisting,
						struct klfts_RegisterUpdateAgentResponse
						&r);

int klfts_RegisterUpdateAgent( struct soap *soap, 
						klfts_update_agent_info			updateAgentInfo,
						xsd__boolean					checkExisting,
						struct klfts_RegisterUpdateAgentResponse
						&r)
{
	void *funcPtr = KLSTRT::GetFunctionPtrByName(L"klfts_RegisterUpdateAgent");
	if ( funcPtr==NULL ) return SOAP_NO_METHOD;
	else return ((klfts_RegisterUpdateAgentFuncDef)funcPtr)(soap,updateAgentInfo,checkExisting,r);
}

typedef int (* klfts_ModifyUpdateAgentFuncDef)( struct soap *soap, 
						klfts_update_agent_info			updateAgentInfo,
						struct klfts_ModifyUpdateAgentResponse
						&r);

int klfts_ModifyUpdateAgent( struct soap *soap, 
						klfts_update_agent_info			updateAgentInfo,
						struct klfts_ModifyUpdateAgentResponse
						&r)
{
	void *funcPtr = KLSTRT::GetFunctionPtrByName(L"klfts_ModifyUpdateAgent");
	if ( funcPtr==NULL ) return SOAP_NO_METHOD;
	else return ((klfts_ModifyUpdateAgentFuncDef)funcPtr)(soap,updateAgentInfo,r);
}

typedef int (* klfts_UnregisterUpdateAgentFuncDef)( struct soap *soap, 
						xsd__wstring					strAgentHostId,
						struct klfts_UnregisterUpdateAgentResponse
						&r);

int klfts_UnregisterUpdateAgent( struct soap *soap, 
						xsd__wstring					strAgentHostId,
						struct klfts_UnregisterUpdateAgentResponse
						&r)
{
	void *funcPtr = KLSTRT::GetFunctionPtrByName(L"klfts_UnregisterUpdateAgent");
	if ( funcPtr==NULL ) return SOAP_NO_METHOD;
	else return ((klfts_UnregisterUpdateAgentFuncDef)funcPtr)(soap,strAgentHostId,r);
}

typedef int (* klfts_GetDefaultUpdateAgentRegistrationInfoFuncDef)( struct soap *soap, 
						int								nGroupId,
						struct klfts_GetDefaultUpdateAgentRegistrationInfoResponse
						&r);

int klfts_GetDefaultUpdateAgentRegistrationInfo( struct soap *soap, 
						int								nGroupId,
						struct klfts_GetDefaultUpdateAgentRegistrationInfoResponse
						&r)
{
	void *funcPtr = KLSTRT::GetFunctionPtrByName(L"klfts_GetDefaultUpdateAgentRegistrationInfo");
	if ( funcPtr==NULL ) return SOAP_NO_METHOD;
	else return ((klfts_GetDefaultUpdateAgentRegistrationInfoFuncDef)funcPtr)(soap,nGroupId,r);
}

typedef int (* klfts_GetUpdateAgentsForGroupFuncDef)( struct soap *soap, 
						int								nGroupId,
						struct klfts_GetUpdateAgentsForGroupResponse
						&r);

int klfts_GetUpdateAgentsForGroup( struct soap *soap, 
						int								nGroupId,
						struct klfts_GetUpdateAgentsForGroupResponse
						&r)
{
	void *funcPtr = KLSTRT::GetFunctionPtrByName(L"klfts_GetUpdateAgentsForGroup");
	if ( funcPtr==NULL ) return SOAP_NO_METHOD;
	else return ((klfts_GetUpdateAgentsForGroupFuncDef)funcPtr)(soap,nGroupId,r);
}

typedef int (* klfts_GetUpdateAgentInfoFuncDef)( struct soap *soap, 
						xsd__wstring					strAgentHostId,
						struct klfts_GetUpdateAgentInfoResponse
						&r);

int klfts_GetUpdateAgentInfo( struct soap *soap, 
						xsd__wstring					strAgentHostId,
						struct klfts_GetUpdateAgentInfoResponse
						&r)
{
	void *funcPtr = KLSTRT::GetFunctionPtrByName(L"klfts_GetUpdateAgentInfo");
	if ( funcPtr==NULL ) return SOAP_NO_METHOD;
	else return ((klfts_GetUpdateAgentInfoFuncDef)funcPtr)(soap,strAgentHostId,r);
}

typedef int (* klfts_UseUAForSyncFolderFuncDef)( struct soap *soap, 
						xsd__wstring			strAgentHostId,
						xsd__wstring			strSyncFolderName,
						xsd__boolean			bUse,
						struct klfts_UseUAForSyncFolderResponse
						&r);

int klfts_UseUAForSyncFolder( struct soap *soap, 
						xsd__wstring			strAgentHostId,
						xsd__wstring			strSyncFolderName,
						xsd__boolean			bUse,
						struct klfts_UseUAForSyncFolderResponse
						&r)
{
	void *funcPtr = KLSTRT::GetFunctionPtrByName(L"klfts_UseUAForSyncFolder");
	if ( funcPtr==NULL ) return SOAP_NO_METHOD;
	else return ((klfts_UseUAForSyncFolderFuncDef)funcPtr)(soap,strAgentHostId,strSyncFolderName,bUse,r);
}

typedef int (* klfts_GetUseUAForSyncFolderFuncDef)( struct soap *soap, 
						xsd__wstring			strAgentHostId,
						xsd__wstring			strSyncFolderName,						
						struct klfts_GetUseUAForSyncFolderResponse
						&r);

int klfts_GetUseUAForSyncFolder( struct soap *soap, 
						xsd__wstring			strAgentHostId,
						xsd__wstring			strSyncFolderName,						
						struct klfts_GetUseUAForSyncFolderResponse
						&r)
{
	void *funcPtr = KLSTRT::GetFunctionPtrByName(L"klfts_GetUseUAForSyncFolder");
	if ( funcPtr==NULL ) return SOAP_NO_METHOD;
	else return ((klfts_GetUseUAForSyncFolderFuncDef)funcPtr)(soap,strAgentHostId,strSyncFolderName,r);
}

typedef int (* klcmptrsft_GetCompetitorSoftwareListFuncDef)( struct soap *soap,  
	struct klcmptrsft_GetCompetitorSoftwareLisResponse&r);

int klcmptrsft_GetCompetitorSoftwareList( struct soap *soap,  
	struct klcmptrsft_GetCompetitorSoftwareLisResponse&r)
{
	void *funcPtr = KLSTRT::GetFunctionPtrByName(L"klcmptrsft_GetCompetitorSoftwareList");
	if ( funcPtr==NULL ) return SOAP_NO_METHOD;
	else return ((klcmptrsft_GetCompetitorSoftwareListFuncDef)funcPtr)(soap,r);
}

typedef int (* klcmptrsft_GetHostCompetitorSoftwareListFuncDef)( struct soap *soap,  
	xsd__int	hostId,
	struct klcmptrsft_GetHostCompetitorSoftwareListResponse&r);

int klcmptrsft_GetHostCompetitorSoftwareList( struct soap *soap,  
	xsd__int	hostId,
	struct klcmptrsft_GetHostCompetitorSoftwareListResponse&r)
{
	void *funcPtr = KLSTRT::GetFunctionPtrByName(L"klcmptrsft_GetHostCompetitorSoftwareList");
	if ( funcPtr==NULL ) return SOAP_NO_METHOD;
	else return ((klcmptrsft_GetHostCompetitorSoftwareListFuncDef)funcPtr)(soap,hostId,r);
}

typedef int (* aklwngt__SessionBeginFuncDef)( struct soap *soap, 
						xsd__string     szDeviceId,
                        xsd__string     szPassword,
                        int             nProtocolVersion,
                        struct aklwngt__SessionBeginResponse
                        &r);

int aklwngt__SessionBegin( struct soap *soap, 
						xsd__string     szDeviceId,
                        xsd__string     szPassword,
                        int             nProtocolVersion,
                        struct aklwngt__SessionBeginResponse
                        &r)
{
	void *funcPtr = KLSTRT::GetFunctionPtrByName(L"aklwngt__SessionBegin");
	if ( funcPtr==NULL ) return SOAP_NO_METHOD;
	else return ((aklwngt__SessionBeginFuncDef)funcPtr)(soap,szDeviceId,szPassword,nProtocolVersion,r);
}

typedef int (* aklwngt__SessionEndFuncDef)( struct soap *soap, 
                        xsd__string         szSessionId,
                        struct aklwngt__SessionEndResponse
                        &r);

int aklwngt__SessionEnd( struct soap *soap, 
                        xsd__string         szSessionId,
                        struct aklwngt__SessionEndResponse
                        &r)
{
	void *funcPtr = KLSTRT::GetFunctionPtrByName(L"aklwngt__SessionEnd");
	if ( funcPtr==NULL ) return SOAP_NO_METHOD;
	else return ((aklwngt__SessionEndFuncDef)funcPtr)(soap,szSessionId,r);
}

typedef int (* aklwngt__HeartbeatFuncDef)( struct soap *soap, 
                        xsd__string     szSessionId,
                        struct aklwngt__sync_info* oMaySynchronize,
                        struct aklwngt__HeartbeatResponse&r);

int aklwngt__Heartbeat( struct soap *soap, 
                        xsd__string     szSessionId,
                        struct aklwngt__sync_info* oMaySynchronize,
                        struct aklwngt__HeartbeatResponse&r)
{
	void *funcPtr = KLSTRT::GetFunctionPtrByName(L"aklwngt__Heartbeat");
	if ( funcPtr==NULL ) return SOAP_NO_METHOD;
	else return ((aklwngt__HeartbeatFuncDef)funcPtr)(soap,szSessionId, oMaySynchronize,r);
}

typedef int (* aklwngt__PutResultFuncDef)( struct soap *soap, 
                        xsd__string     szSessionId,
                        struct aklwngt__command*    result,
                        struct aklwngt__PutResultResponse&r);

int aklwngt__PutResult( struct soap *soap, 
                        xsd__string     szSessionId,
                        struct aklwngt__command*    result,
                        struct aklwngt__PutResultResponse&r)
{
	void *funcPtr = KLSTRT::GetFunctionPtrByName(L"aklwngt__PutResult");
	if ( funcPtr==NULL ) return SOAP_NO_METHOD;
	else return ((aklwngt__PutResultFuncDef)funcPtr)(soap,szSessionId,    result,r);
}

typedef int (* aklwngt__PutEventsFuncDef)( struct soap *soap, 
                        xsd__string     szSessionId,
                        struct aklwngt__event_info_array* oEventsInfoArray,
                        struct aklwngt__PutEventsResponse&r);

int aklwngt__PutEvents( struct soap *soap, 
                        xsd__string     szSessionId,
                        struct aklwngt__event_info_array* oEventsInfoArray,
                        struct aklwngt__PutEventsResponse&r)
{
	void *funcPtr = KLSTRT::GetFunctionPtrByName(L"aklwngt__PutEvents");
	if ( funcPtr==NULL ) return SOAP_NO_METHOD;
	else return ((aklwngt__PutEventsFuncDef)funcPtr)(soap,szSessionId, oEventsInfoArray,r);
}

typedef int (* aklwngt__klft_GetFileInfoFuncDef)( struct soap *soap, 
                        xsd__string     szSessionId,
						xsd__wstring	fileName,
						struct aklwngt__klft_GetFileInfoResponse
						&r);

int aklwngt__klft_GetFileInfo( struct soap *soap, 
                        xsd__string     szSessionId,
						xsd__wstring	fileName,
						struct aklwngt__klft_GetFileInfoResponse
						&r)
{
	void *funcPtr = KLSTRT::GetFunctionPtrByName(L"aklwngt__klft_GetFileInfo");
	if ( funcPtr==NULL ) return SOAP_NO_METHOD;
	else return ((aklwngt__klft_GetFileInfoFuncDef)funcPtr)(soap,szSessionId,fileName,r);
}

typedef int (* aklwngt__klft_GetNextFileChunkFuncDef)( struct soap *soap, 
                        xsd__string     szSessionId,
						xsd__wstring	fileName,
						xsd__unsignedLong	startFilePos,
						xsd__unsignedLong	neededSize,
						struct aklwngt__klft_GetNextFileChunkResponse
						&r);

int aklwngt__klft_GetNextFileChunk( struct soap *soap, 
                        xsd__string     szSessionId,
						xsd__wstring	fileName,
						xsd__unsignedLong	startFilePos,
						xsd__unsignedLong	neededSize,
						struct aklwngt__klft_GetNextFileChunkResponse
						&r)
{
	void *funcPtr = KLSTRT::GetFunctionPtrByName(L"aklwngt__klft_GetNextFileChunk");
	if ( funcPtr==NULL ) return SOAP_NO_METHOD;
	else return ((aklwngt__klft_GetNextFileChunkFuncDef)funcPtr)(soap,szSessionId,fileName,startFilePos,neededSize,r);
}

typedef int (* klptch_get_nagent_latest_patch_infoFuncDef)( struct soap *soap, 
	param__params	nagent_data,
	struct klptch_get_nagent_latest_patch_infoResponse&r);

int klptch_get_nagent_latest_patch_info( struct soap *soap, 
	param__params	nagent_data,
	struct klptch_get_nagent_latest_patch_infoResponse&r)
{
	void *funcPtr = KLSTRT::GetFunctionPtrByName(L"klptch_get_nagent_latest_patch_info");
	if ( funcPtr==NULL ) return SOAP_NO_METHOD;
	else return ((klptch_get_nagent_latest_patch_infoFuncDef)funcPtr)(soap,nagent_data,r);
}

typedef int (* klinv_GetInvProductsListFuncDef)( struct soap *soap,  
	struct klinv_GetInvProductsListResponse&r);

int klinv_GetInvProductsList( struct soap *soap,  
	struct klinv_GetInvProductsListResponse&r)
{
	void *funcPtr = KLSTRT::GetFunctionPtrByName(L"klinv_GetInvProductsList");
	if ( funcPtr==NULL ) return SOAP_NO_METHOD;
	else return ((klinv_GetInvProductsListFuncDef)funcPtr)(soap,r);
}

typedef int (* klinv_GetInvPatchesListFuncDef)( struct soap *soap,  
	struct klinv_GetInvPatchesListResponse&r);

int klinv_GetInvPatchesList( struct soap *soap,  
	struct klinv_GetInvPatchesListResponse&r)
{
	void *funcPtr = KLSTRT::GetFunctionPtrByName(L"klinv_GetInvPatchesList");
	if ( funcPtr==NULL ) return SOAP_NO_METHOD;
	else return ((klinv_GetInvPatchesListFuncDef)funcPtr)(soap,r);
}

typedef int (* klinv_GetHostInvProductsListFuncDef)( struct soap *soap,  
	xsd__int	hostId,
	struct klinv_GetHostInvProductsListResponse&r);

int klinv_GetHostInvProductsList( struct soap *soap,  
	xsd__int	hostId,
	struct klinv_GetHostInvProductsListResponse&r)
{
	void *funcPtr = KLSTRT::GetFunctionPtrByName(L"klinv_GetHostInvProductsList");
	if ( funcPtr==NULL ) return SOAP_NO_METHOD;
	else return ((klinv_GetHostInvProductsListFuncDef)funcPtr)(soap,hostId,r);
}

typedef int (* klinv_GetHostInvPatchesListFuncDef)( struct soap *soap,  
	xsd__int	hostId,
	struct klinv_GetHostInvPatchesListResponse&r);

int klinv_GetHostInvPatchesList( struct soap *soap,  
	xsd__int	hostId,
	struct klinv_GetHostInvPatchesListResponse&r)
{
	void *funcPtr = KLSTRT::GetFunctionPtrByName(L"klinv_GetHostInvPatchesList");
	if ( funcPtr==NULL ) return SOAP_NO_METHOD;
	else return ((klinv_GetHostInvPatchesListFuncDef)funcPtr)(soap,hostId,r);
}

typedef int (* klinv_GetSrvCompetitorIniFileInfoListFuncDef)( struct soap *soap,  
		xsd__wstring	wstrType,
		struct klinv_GetSrvCompetitorIniFileInfoListResponse&r);

int klinv_GetSrvCompetitorIniFileInfoList( struct soap *soap,  
		xsd__wstring	wstrType,
		struct klinv_GetSrvCompetitorIniFileInfoListResponse&r)
{
	void *funcPtr = KLSTRT::GetFunctionPtrByName(L"klinv_GetSrvCompetitorIniFileInfoList");
	if ( funcPtr==NULL ) return SOAP_NO_METHOD;
	else return ((klinv_GetSrvCompetitorIniFileInfoListFuncDef)funcPtr)(soap,wstrType,r);
}

typedef int (* klinv_ResetIteratorFuncDef)( struct soap *soap, 
		xsd__wstring	wstrFilter,
		klinv_wstring_array		fields,
		klinv_field_order_array	fields_to_order,
		xsd__int					lifetime,
		struct klinv_ResetIteratorResponse&r);

int klinv_ResetIterator( struct soap *soap, 
		xsd__wstring	wstrFilter,
		klinv_wstring_array		fields,
		klinv_field_order_array	fields_to_order,
		xsd__int					lifetime,
		struct klinv_ResetIteratorResponse&r)
{
	void *funcPtr = KLSTRT::GetFunctionPtrByName(L"klinv_ResetIterator");
	if ( funcPtr==NULL ) return SOAP_NO_METHOD;
	else return ((klinv_ResetIteratorFuncDef)funcPtr)(soap,wstrFilter,fields,fields_to_order,lifetime,r);
}

typedef int (* klinv_GetRecordCountFuncDef)( struct soap *soap, 
		xsd__wstring	iteratorId,
		struct klinv_GetRecordCountResponse&r);

int klinv_GetRecordCount( struct soap *soap, 
		xsd__wstring	iteratorId,
		struct klinv_GetRecordCountResponse&r)
{
	void *funcPtr = KLSTRT::GetFunctionPtrByName(L"klinv_GetRecordCount");
	if ( funcPtr==NULL ) return SOAP_NO_METHOD;
	else return ((klinv_GetRecordCountFuncDef)funcPtr)(soap,iteratorId,r);
}

typedef int (* klinv_GetRecordRangeFuncDef)( struct soap *soap, 
		xsd__wstring	iteratorId,
		xsd__int		nStart,
        xsd__int		nEnd,
		struct klinv_GetRecordRangeResponse&r);

int klinv_GetRecordRange( struct soap *soap, 
		xsd__wstring	iteratorId,
		xsd__int		nStart,
        xsd__int		nEnd,
		struct klinv_GetRecordRangeResponse&r)
{
	void *funcPtr = KLSTRT::GetFunctionPtrByName(L"klinv_GetRecordRange");
	if ( funcPtr==NULL ) return SOAP_NO_METHOD;
	else return ((klinv_GetRecordRangeFuncDef)funcPtr)(soap,iteratorId,nStart,nEnd,r);
}

typedef int (* klinv_ReleaseIteratorFuncDef)( struct soap *soap, 
		xsd__wstring	iteratorId,
		struct klinv_ReleaseIteratorResponse&r);

int klinv_ReleaseIterator( struct soap *soap, 
		xsd__wstring	iteratorId,
		struct klinv_ReleaseIteratorResponse&r)
{
	void *funcPtr = KLSTRT::GetFunctionPtrByName(L"klinv_ReleaseIterator");
	if ( funcPtr==NULL ) return SOAP_NO_METHOD;
	else return ((klinv_ReleaseIteratorFuncDef)funcPtr)(soap,iteratorId,r);
}

typedef int (* kltrf_ReplaceRestrictionFuncDef)( struct soap *soap, 						
						kltrf_Restriction	restriction,
						struct kltrf_ReplaceRestrictionResponse
							&r );

int kltrf_ReplaceRestriction( struct soap *soap, 						
						kltrf_Restriction	restriction,
						struct kltrf_ReplaceRestrictionResponse
							&r )
{
	void *funcPtr = KLSTRT::GetFunctionPtrByName(L"kltrf_ReplaceRestriction");
	if ( funcPtr==NULL ) return SOAP_NO_METHOD;
	else return ((kltrf_ReplaceRestrictionFuncDef)funcPtr)(soap,restriction,r);
}

typedef int (* kltrf_DeleteRestrictionFuncDef)( struct soap *soap, 
						xsd__long		nRestrictionId,
						struct kltrf_DeleteRestrictionResponse
							&r );

int kltrf_DeleteRestriction( struct soap *soap, 
						xsd__long		nRestrictionId,
						struct kltrf_DeleteRestrictionResponse
							&r )
{
	void *funcPtr = KLSTRT::GetFunctionPtrByName(L"kltrf_DeleteRestriction");
	if ( funcPtr==NULL ) return SOAP_NO_METHOD;
	else return ((kltrf_DeleteRestrictionFuncDef)funcPtr)(soap,nRestrictionId,r);
}

typedef int (* kltrf_GetRestrictionsFuncDef)( struct soap *soap, 						
						struct kltrf_GetRestrictionsResponse
							&r );

int kltrf_GetRestrictions( struct soap *soap, 						
						struct kltrf_GetRestrictionsResponse
							&r )
{
	void *funcPtr = KLSTRT::GetFunctionPtrByName(L"kltrf_GetRestrictions");
	if ( funcPtr==NULL ) return SOAP_NO_METHOD;
	else return ((kltrf_GetRestrictionsFuncDef)funcPtr)(soap,r);
}

typedef int (* klnag_SendWakeOnLanOnSubnetsHostsFuncDef)( struct soap *soap, 
                        param__params macsList,
                        struct klnag_SendWakeOnLanOnSubnetsHostsResponse& r);

int klnag_SendWakeOnLanOnSubnetsHosts( struct soap *soap, 
                        param__params macsList,
                        struct klnag_SendWakeOnLanOnSubnetsHostsResponse& r)
{
	void *funcPtr = KLSTRT::GetFunctionPtrByName(L"klnag_SendWakeOnLanOnSubnetsHosts");
	if ( funcPtr==NULL ) return SOAP_NO_METHOD;
	else return ((klnag_SendWakeOnLanOnSubnetsHostsFuncDef)funcPtr)(soap,macsList, r);
}

typedef int (* klsnmpagt_PutServerEventFuncDef)( struct soap *soap, 
        struct klsnmpagt_event	event,
		struct klsnmpagt_PutServerEventResponse&r);

int klsnmpagt_PutServerEvent( struct soap *soap, 
        struct klsnmpagt_event	event,
		struct klsnmpagt_PutServerEventResponse&r)
{
	void *funcPtr = KLSTRT::GetFunctionPtrByName(L"klsnmpagt_PutServerEvent");
	if ( funcPtr==NULL ) return SOAP_NO_METHOD;
	else return ((klsnmpagt_PutServerEventFuncDef)funcPtr)(soap,event,r);
}

typedef int (* klsnmpagt_SetAgentConnectionFuncDef)( struct soap *soap, 
        xsd__wstring	wstrLocalName,
		xsd__wstring	wstrRemoteName,
		struct klsnmpagt_SetAgentConnectionResponse&r);

int klsnmpagt_SetAgentConnection( struct soap *soap, 
        xsd__wstring	wstrLocalName,
		xsd__wstring	wstrRemoteName,
		struct klsnmpagt_SetAgentConnectionResponse&r)
{
	void *funcPtr = KLSTRT::GetFunctionPtrByName(L"klsnmpagt_SetAgentConnection");
	if ( funcPtr==NULL ) return SOAP_NO_METHOD;
	else return ((klsnmpagt_SetAgentConnectionFuncDef)funcPtr)(soap,wstrLocalName,wstrRemoteName,r);
}

