# -*- Makefile -*- Time-stamp: <03/07/11 13:08:45 ptr>
# $Id: Makefile.inc,v 1.20 2004/04/08 09:20:26 ptr Exp $

PRGNAME = kcatest
MAJOR = 0
MINOR = 1
PATCH = 0
SRC_CC = ../../tst/kltester/data.cpp ../../tst/kltester/datareader.cpp\
	 ../../tst/kltester/main.cpp ../../tst/kltester/testdata.cpp\
	 ../../tst/kltester/testsset.cpp\
	 jrnl/jrnl_test.cpp\
	 prci/prci_main.cpp prci/prci_testing.cpp\
	 pres/pres_main.cpp pres/pres_test.cpp pres/pres_test2.cpp pres/pres_test3.cpp pres/pres_test4.cpp \
	 prss/prss_main.cpp prss/test_prss.cpp\
	 prts/prts_main.cpp prts/prts_test.cpp\
	 ../../std/test/testing/testing.cpp\
	 kcatest.cpp


	 


